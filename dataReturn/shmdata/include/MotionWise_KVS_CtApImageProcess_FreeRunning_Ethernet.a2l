ASAP2_VERSION 1 61
/begin PROJECT MotionWise_PerformanceHost00_XCPonEthernet ""
/begin MODULE CPP ""
/begin MOD_COMMON "" BYTE_ORDER MSB_LAST ALIGNMENT_BYTE 1 ALIGNMENT_WORD 2 ALIGNMENT_LONG 4 ALIGNMENT_INT64 1 ALIGNMENT_FLOAT32_IEEE 4 ALIGNMENT_FLOAT64_IEEE 8 /end MOD_COMMON
/begin CHARACTERISTIC CtApImageProcess_FreeRunning.PpImageProcess_Obstacle_60ms.DeObstacle.gstObjects[3].fAbsValY "" VALUE 0x3c0194 __FLOAT32_IEEE_S 0 NO_COMPU_METHOD 0 3.402823e+38 ECU_ADDRESS_EXTENSION 0x80 /end CHARACTERISTIC
/begin CHARACTERISTIC CtApImageProcess_FreeRunning.PpImageProcess_Obstacle_60ms.DeObstacle.gstObjects[3].nPoint1OnCar "" VALUE 0x3c0198 __UBYTE_S 0 NO_COMPU_METHOD 0 255 ECU_ADDRESS_EXTENSION 0x80 /end CHARACTERISTIC
/begin CHARACTERISTIC CtApImageProcess_FreeRunning.PpImageProcess_Obstacle_60ms.DeObstacle.gstObjects[3].nPoint2OnCar "" VALUE 0x3c0199 __UBYTE_S 0 NO_COMPU_METHOD 0 255 ECU_ADDRESS_EXTENSION 0x80 /end CHARACTERISTIC
/begin CHARACTERISTIC CtApImageProcess_FreeRunning.PpImageProcess_Obstacle_60ms.DeObstacle.gstObjects[3].fReserved "10 uint32 array" VAL_BLK 0x3c019c __ULONG_S 0 NO_COMPU_METHOD 0 4294967295 ECU_ADDRESS_EXTENSION 0x80 MATRIX_DIM 10 1 1 /end CHARACTERISTIC
/begin CHARACTERISTIC CtApImageProcess_FreeRunning.PpImageProcess_Obstacle_60ms.DeObstacle.gstObjects[3].n3D "" VALUE 0x3c01c4 __UBYTE_S 0 NO_COMPU_METHOD 0 255 ECU_ADDRESS_EXTENSION 0x80 /end CHARACTERISTIC
/begin CHARACTERISTIC CtApImageProcess_FreeRunning.PpImageProcess_Obstacle_60ms.DeObstacle.gstObjects[3].fPoint3X "" VALUE 0x3c01c8 __FLOAT32_IEEE_S 0 NO_COMPU_METHOD 0 3.402823e+38 ECU_ADDRESS_EXTENSION 0x80 /end CHARACTERISTIC
/begin CHARACTERISTIC CtApImageProcess_FreeRunning.PpImageProcess_Obstacle_60ms.DeObstacle.gstObjects[3].fPoint3Y "" VALUE 0x3c01cc __FLOAT32_IEEE_S 0 NO_COMPU_METHOD 0 3.402823e+38 ECU_ADDRESS_EXTENSION 0x80 /end CHARACTERISTIC
/begin CHARACTERISTIC CtApImageProcess_FreeRunning.PpImageProcess_Obstacle_60ms.DeObstacle.gstObjects[3].fPoint4X "" VALUE 0x3c01d0 __FLOAT32_IEEE_S 0 NO_COMPU_METHOD 0 3.402823e+38 ECU_ADDRESS_EXTENSION 0x80 /end CHARACTERISTIC
/begin CHARACTERISTIC CtApImageProcess_FreeRunning.PpImageProcess_Obstacle_60ms.DeObstacle.gstObjects[3].fPoint4Y "" VALUE 0x3c01d4 __FLOAT32_IEEE_S 0 NO_COMPU_METHOD 0 3.402823e+38 ECU_ADDRESS_EXTENSION 0x80 /end CHARACTERISTIC
/begin CHARACTERISTIC CtApImageProcess_FreeRunning.PpImageProcess_Obstacle_60ms.DeObstacle.gstObjects[4].nObjectID "" VALUE 0x3c01d8 __UWORD_S 0 NO_COMPU_METHOD 0 65535 ECU_ADDRESS_EXTENSION 0x80 /end CHARACTERISTIC
/begin CHARACTERISTIC CtApImageProcess_FreeRunning.PpImageProcess_Obstacle_60ms.DeObstacle.gstObjects[4].nType "" VALUE 0x3c01da __UBYTE_S 0 NO_COMPU_METHOD 0 255 ECU_ADDRESS_EXTENSION 0x80 /end CHARACTERISTIC
/begin CHARACTERISTIC CtApImageProcess_FreeRunning.PpImageProcess_Obstacle_60ms.DeObstacle.gstObjects[4].nAge "" VALUE 0x3c01db __UBYTE_S 0 NO_COMPU_METHOD 0 255 ECU_ADDRESS_EXTENSION 0x80 /end CHARACTERISTIC
/begin CHARACTERISTIC CtApImageProcess_FreeRunning.PpImageProcess_Obstacle_60ms.DeObstacle.gstObjects[4].nQuality "" VALUE 0x3c01dc __UBYTE_S 0 NO_COMPU_METHOD 0 255 ECU_ADDRESS_EXTENSION 0x80 /end CHARACTERISTIC
/begin CHARACTERISTIC CtApImageProcess_FreeRunning.PpImageProcess_Obstacle_60ms.DeObstacle.gstObjects[4].fHeight "" VALUE 0x3c01e0 __FLOAT32_IEEE_S 0 NO_COMPU_METHOD 0 3.402823e+38 ECU_ADDRESS_EXTENSION 0x80 /end CHARACTERISTIC
/begin CHARACTERISTIC CtApImageProcess_FreeRunning.PpImageProcess_Obstacle_60ms.DeObstacle.gstObjects[4].fPiont1X "" VALUE 0x3c01e4 __FLOAT32_IEEE_S 0 NO_COMPU_METHOD 0 3.402823e+38 ECU_ADDRESS_EXTENSION 0x80 /end CHARACTERISTIC
/begin CHARACTERISTIC CtApImageProcess_FreeRunning.PpImageProcess_Obstacle_60ms.DeObstacle.gstObjects[4].fPiont1Y "" VALUE 0x3c01e8 __FLOAT32_IEEE_S 0 NO_COMPU_METHOD 0 3.402823e+38 ECU_ADDRESS_EXTENSION 0x80 /end CHARACTERISTIC
/begin CHARACTERISTIC CtApImageProcess_FreeRunning.PpImageProcess_Obstacle_60ms.DeObstacle.gstObjects[4].fPiont2X "" VALUE 0x3c01ec __FLOAT32_IEEE_S 0 NO_COMPU_METHOD 0 3.402823e+38 ECU_ADDRESS_EXTENSION 0x80 /end CHARACTERISTIC
/begin CHARACTERISTIC CtApImageProcess_FreeRunning.PpImageProcess_Obstacle_60ms.DeObstacle.gstObjects[4].fPiont2Y "" VALUE 0x3c01f0 __FLOAT32_IEEE_S 0 NO_COMPU_METHOD 0 3.402823e+38 ECU_ADDRESS_EXTENSION 0x80 /end CHARACTERISTIC
/begin CHARACTERISTIC CtApImageProcess_FreeRunning.PpImageProcess_Obstacle_60ms.DeObstacle.gstObjects[4].fRelVelocityX "" VALUE 0x3c01f4 __FLOAT32_IEEE_S 0 NO_COMPU_METHOD 0 3.402823e+38 ECU_ADDRESS_EXTENSION 0x80 /end CHARACTERISTIC
/begin CHARACTERISTIC CtApImageProcess_FreeRunning.PpImageProcess_Obstacle_60ms.DeObstacle.gstObjects[4].fRelVelocityY "" VALUE 0x3c01f8 __FLOAT32_IEEE_S 0 NO_COMPU_METHOD 0 3.402823e+38 ECU_ADDRESS_EXTENSION 0x80 /end CHARACTERISTIC
/begin CHARACTERISTIC CtApImageProcess_FreeRunning.PpImageProcess_Obstacle_60ms.DeObstacle.gstObjects[4].fAblVelocityX "" VALUE 0x3c01fc __FLOAT32_IEEE_S 0 NO_COMPU_METHOD 0 3.402823e+38 ECU_ADDRESS_EXTENSION 0x80 /end CHARACTERISTIC
/begin CHARACTERISTIC CtApImageProcess_FreeRunning.PpImageProcess_Obstacle_60ms.DeObstacle.gstObjects[4].fAblVelocityY "" VALUE 0x3c0200 __FLOAT32_IEEE_S 0 NO_COMPU_METHOD 0 3.402823e+38 ECU_ADDRESS_EXTENSION 0x80 /end CHARACTERISTIC
/begin CHARACTERISTIC CtApImageProcess_FreeRunning.PpImageProcess_Obstacle_60ms.DeObstacle.gstObjects[4].fAbsValY "" VALUE 0x3c0204 __FLOAT32_IEEE_S 0 NO_COMPU_METHOD 0 3.402823e+38 ECU_ADDRESS_EXTENSION 0x80 /end CHARACTERISTIC
/begin CHARACTERISTIC CtApImageProcess_FreeRunning.PpImageProcess_Obstacle_60ms.DeObstacle.gstObjects[4].nPoint1OnCar "" VALUE 0x3c0208 __UBYTE_S 0 NO_COMPU_METHOD 0 255 ECU_ADDRESS_EXTENSION 0x80 /end CHARACTERISTIC
/begin CHARACTERISTIC CtApImageProcess_FreeRunning.PpImageProcess_Obstacle_60ms.DeObstacle.gstObjects[4].nPoint2OnCar "" VALUE 0x3c0209 __UBYTE_S 0 NO_COMPU_METHOD 0 255 ECU_ADDRESS_EXTENSION 0x80 /end CHARACTERISTIC
/begin CHARACTERISTIC CtApImageProcess_FreeRunning.PpImageProcess_Obstacle_60ms.DeObstacle.gstObjects[4].fReserved "10 uint32 array" VAL_BLK 0x3c020c __ULONG_S 0 NO_COMPU_METHOD 0 4294967295 ECU_ADDRESS_EXTENSION 0x80 MATRIX_DIM 10 1 1 /end CHARACTERISTIC
/begin CHARACTERISTIC CtApImageProcess_FreeRunning.PpImageProcess_Obstacle_60ms.DeObstacle.gstObjects[4].n3D "" VALUE 0x3c0234 __UBYTE_S 0 NO_COMPU_METHOD 0 255 ECU_ADDRESS_EXTENSION 0x80 /end CHARACTERISTIC
/begin CHARACTERISTIC CtApImageProcess_FreeRunning.PpImageProcess_Obstacle_60ms.DeObstacle.gstObjects[4].fPoint3X "" VALUE 0x3c0238 __FLOAT32_IEEE_S 0 NO_COMPU_METHOD 0 3.402823e+38 ECU_ADDRESS_EXTENSION 0x80 /end CHARACTERISTIC
/begin CHARACTERISTIC CtApImageProcess_FreeRunning.PpImageProcess_Obstacle_60ms.DeObstacle.gstObjects[4].fPoint3Y "" VALUE 0x3c023c __FLOAT32_IEEE_S 0 NO_COMPU_METHOD 0 3.402823e+38 ECU_ADDRESS_EXTENSION 0x80 /end CHARACTERISTIC
/begin CHARACTERISTIC CtApImageProcess_FreeRunning.PpImageProcess_Obstacle_60ms.DeObstacle.gstObjects[4].fPoint4X "" VALUE 0x3c0240 __FLOAT32_IEEE_S 0 NO_COMPU_METHOD 0 3.402823e+38 ECU_ADDRESS_EXTENSION 0x80 /end CHARACTERISTIC
/begin CHARACTERISTIC CtApImageProcess_FreeRunning.PpImageProcess_Obstacle_60ms.DeObstacle.gstObjects[4].fPoint4Y "" VALUE 0x3c0244 __FLOAT32_IEEE_S 0 NO_COMPU_METHOD 0 3.402823e+38 ECU_ADDRESS_EXTENSION 0x80 /end CHARACTERISTIC
/begin CHARACTERISTIC CtApImageProcess_FreeRunning.PpImageProcess_Obstacle_60ms.DeObstacle.gstObjects[5].nObjectID "" VALUE 0x3c0248 __UWORD_S 0 NO_COMPU_METHOD 0 65535 ECU_ADDRESS_EXTENSION 0x80 /end CHARACTERISTIC
/begin CHARACTERISTIC CtApImageProcess_FreeRunning.PpImageProcess_Obstacle_60ms.DeObstacle.gstObjects[5].nType "" VALUE 0x3c024a __UBYTE_S 0 NO_COMPU_METHOD 0 255 ECU_ADDRESS_EXTENSION 0x80 /end CHARACTERISTIC
/begin CHARACTERISTIC CtApImageProcess_FreeRunning.PpImageProcess_Obstacle_60ms.DeObstacle.gstObjects[5].nAge "" VALUE 0x3c024b __UBYTE_S 0 NO_COMPU_METHOD 0 255 ECU_ADDRESS_EXTENSION 0x80 /end CHARACTERISTIC
/begin CHARACTERISTIC CtApImageProcess_FreeRunning.PpImageProcess_Obstacle_60ms.DeObstacle.gstObjects[5].nQuality "" VALUE 0x3c024c __UBYTE_S 0 NO_COMPU_METHOD 0 255 ECU_ADDRESS_EXTENSION 0x80 /end CHARACTERISTIC
/begin CHARACTERISTIC CtApImageProcess_FreeRunning.PpImageProcess_Obstacle_60ms.DeObstacle.gstObjects[5].fHeight "" VALUE 0x3c0250 __FLOAT32_IEEE_S 0 NO_COMPU_METHOD 0 3.402823e+38 ECU_ADDRESS_EXTENSION 0x80 /end CHARACTERISTIC
/begin CHARACTERISTIC CtApImageProcess_FreeRunning.PpImageProcess_Obstacle_60ms.DeObstacle.gstObjects[5].fPiont1X "" VALUE 0x3c0254 __FLOAT32_IEEE_S 0 NO_COMPU_METHOD 0 3.402823e+38 ECU_ADDRESS_EXTENSION 0x80 /end CHARACTERISTIC
/begin CHARACTERISTIC CtApImageProcess_FreeRunning.PpImageProcess_Obstacle_60ms.DeObstacle.gstObjects[5].fPiont1Y "" VALUE 0x3c0258 __FLOAT32_IEEE_S 0 NO_COMPU_METHOD 0 3.402823e+38 ECU_ADDRESS_EXTENSION 0x80 /end CHARACTERISTIC
/begin CHARACTERISTIC CtApImageProcess_FreeRunning.PpImageProcess_Obstacle_60ms.DeObstacle.gstObjects[5].fPiont2X "" VALUE 0x3c025c __FLOAT32_IEEE_S 0 NO_COMPU_METHOD 0 3.402823e+38 ECU_ADDRESS_EXTENSION 0x80 /end CHARACTERISTIC
/begin CHARACTERISTIC CtApImageProcess_FreeRunning.PpImageProcess_Obstacle_60ms.DeObstacle.gstObjects[5].fPiont2Y "" VALUE 0x3c0260 __FLOAT32_IEEE_S 0 NO_COMPU_METHOD 0 3.402823e+38 ECU_ADDRESS_EXTENSION 0x80 /end CHARACTERISTIC
/begin CHARACTERISTIC CtApImageProcess_FreeRunning.PpImageProcess_Obstacle_60ms.DeObstacle.gstObjects[5].fRelVelocityX "" VALUE 0x3c0264 __FLOAT32_IEEE_S 0 NO_COMPU_METHOD 0 3.402823e+38 ECU_ADDRESS_EXTENSION 0x80 /end CHARACTERISTIC
/begin CHARACTERISTIC CtApImageProcess_FreeRunning.PpImageProcess_Obstacle_60ms.DeObstacle.gstObjects[5].fRelVelocityY "" VALUE 0x3c0268 __FLOAT32_IEEE_S 0 NO_COMPU_METHOD 0 3.402823e+38 ECU_ADDRESS_EXTENSION 0x80 /end CHARACTERISTIC
/begin CHARACTERISTIC CtApImageProcess_FreeRunning.PpImageProcess_Obstacle_60ms.DeObstacle.gstObjects[5].fAblVelocityX "" VALUE 0x3c026c __FLOAT32_IEEE_S 0 NO_COMPU_METHOD 0 3.402823e+38 ECU_ADDRESS_EXTENSION 0x80 /end CHARACTERISTIC
/begin CHARACTERISTIC CtApImageProcess_FreeRunning.PpImageProcess_Obstacle_60ms.DeObstacle.gstObjects[5].fAblVelocityY "" VALUE 0x3c0270 __FLOAT32_IEEE_S 0 NO_COMPU_METHOD 0 3.402823e+38 ECU_ADDRESS_EXTENSION 0x80 /end CHARACTERISTIC
/begin CHARACTERISTIC CtApImageProcess_FreeRunning.PpImageProcess_Obstacle_60ms.DeObstacle.gstObjects[5].fAbsValY "" VALUE 0x3c0274 __FLOAT32_IEEE_S 0 NO_COMPU_METHOD 0 3.402823e+38 ECU_ADDRESS_EXTENSION 0x80 /end CHARACTERISTIC
/begin CHARACTERISTIC CtApImageProcess_FreeRunning.PpImageProcess_Obstacle_60ms.DeObstacle.gstObjects[5].nPoint1OnCar "" VALUE 0x3c0278 __UBYTE_S 0 NO_COMPU_METHOD 0 255 ECU_ADDRESS_EXTENSION 0x80 /end CHARACTERISTIC
/begin CHARACTERISTIC CtApImageProcess_FreeRunning.PpImageProcess_Obstacle_60ms.DeObstacle.gstObjects[5].nPoint2OnCar "" VALUE 0x3c0279 __UBYTE_S 0 NO_COMPU_METHOD 0 255 ECU_ADDRESS_EXTENSION 0x80 /end CHARACTERISTIC
/begin CHARACTERISTIC CtApImageProcess_FreeRunning.PpImageProcess_Obstacle_60ms.DeObstacle.gstObjects[5].fReserved "10 uint32 array" VAL_BLK 0x3c027c __ULONG_S 0 NO_COMPU_METHOD 0 4294967295 ECU_ADDRESS_EXTENSION 0x80 MATRIX_DIM 10 1 1 /end CHARACTERISTIC
/begin CHARACTERISTIC CtApImageProcess_FreeRunning.PpImageProcess_Obstacle_60ms.DeObstacle.gstObjects[5].n3D "" VALUE 0x3c02a4 __UBYTE_S 0 NO_COMPU_METHOD 0 255 ECU_ADDRESS_EXTENSION 0x80 /end CHARACTERISTIC
/begin CHARACTERISTIC CtApImageProcess_FreeRunning.PpImageProcess_Obstacle_60ms.DeObstacle.gstObjects[5].fPoint3X "" VALUE 0x3c02a8 __FLOAT32_IEEE_S 0 NO_COMPU_METHOD 0 3.402823e+38 ECU_ADDRESS_EXTENSION 0x80 /end CHARACTERISTIC
/begin CHARACTERISTIC CtApImageProcess_FreeRunning.PpImageProcess_Obstacle_60ms.DeObstacle.gstObjects[5].fPoint3Y "" VALUE 0x3c02ac __FLOAT32_IEEE_S 0 NO_COMPU_METHOD 0 3.402823e+38 ECU_ADDRESS_EXTENSION 0x80 /end CHARACTERISTIC
/begin CHARACTERISTIC CtApImageProcess_FreeRunning.PpImageProcess_Obstacle_60ms.DeObstacle.gstObjects[5].fPoint4X "" VALUE 0x3c02b0 __FLOAT32_IEEE_S 0 NO_COMPU_METHOD 0 3.402823e+38 ECU_ADDRESS_EXTENSION 0x80 /end CHARACTERISTIC
/begin CHARACTERISTIC CtApImageProcess_FreeRunning.PpImageProcess_Obstacle_60ms.DeObstacle.gstObjects[5].fPoint4Y "" VALUE 0x3c02b4 __FLOAT32_IEEE_S 0 NO_COMPU_METHOD 0 3.402823e+38 ECU_ADDRESS_EXTENSION 0x80 /end CHARACTERISTIC
/begin CHARACTERISTIC CtApImageProcess_FreeRunning.PpImageProcess_Obstacle_60ms.DeObstacle.gstObjects[6].nObjectID "" VALUE 0x3c02b8 __UWORD_S 0 NO_COMPU_METHOD 0 65535 ECU_ADDRESS_EXTENSION 0x80 /end CHARACTERISTIC
/begin CHARACTERISTIC CtApImageProcess_FreeRunning.PpImageProcess_Obstacle_60ms.DeObstacle.gstObjects[6].nType "" VALUE 0x3c02ba __UBYTE_S 0 NO_COMPU_METHOD 0 255 ECU_ADDRESS_EXTENSION 0x80 /end CHARACTERISTIC
/begin CHARACTERISTIC CtApImageProcess_FreeRunning.PpImageProcess_Obstacle_60ms.DeObstacle.gstObjects[6].nAge "" VALUE 0x3c02bb __UBYTE_S 0 NO_COMPU_METHOD 0 255 ECU_ADDRESS_EXTENSION 0x80 /end CHARACTERISTIC
/begin CHARACTERISTIC CtApImageProcess_FreeRunning.PpImageProcess_Obstacle_60ms.DeObstacle.gstObjects[6].nQuality "" VALUE 0x3c02bc __UBYTE_S 0 NO_COMPU_METHOD 0 255 ECU_ADDRESS_EXTENSION 0x80 /end CHARACTERISTIC
/begin CHARACTERISTIC CtApImageProcess_FreeRunning.PpImageProcess_Obstacle_60ms.DeObstacle.gstObjects[6].fHeight "" VALUE 0x3c02c0 __FLOAT32_IEEE_S 0 NO_COMPU_METHOD 0 3.402823e+38 ECU_ADDRESS_EXTENSION 0x80 /end CHARACTERISTIC
/begin CHARACTERISTIC CtApImageProcess_FreeRunning.PpImageProcess_Obstacle_60ms.DeObstacle.gstObjects[6].fPiont1X "" VALUE 0x3c02c4 __FLOAT32_IEEE_S 0 NO_COMPU_METHOD 0 3.402823e+38 ECU_ADDRESS_EXTENSION 0x80 /end CHARACTERISTIC
/begin CHARACTERISTIC CtApImageProcess_FreeRunning.PpImageProcess_Obstacle_60ms.DeObstacle.gstObjects[6].fPiont1Y "" VALUE 0x3c02c8 __FLOAT32_IEEE_S 0 NO_COMPU_METHOD 0 3.402823e+38 ECU_ADDRESS_EXTENSION 0x80 /end CHARACTERISTIC
/begin CHARACTERISTIC CtApImageProcess_FreeRunning.PpImageProcess_Obstacle_60ms.DeObstacle.gstObjects[6].fPiont2X "" VALUE 0x3c02cc __FLOAT32_IEEE_S 0 NO_COMPU_METHOD 0 3.402823e+38 ECU_ADDRESS_EXTENSION 0x80 /end CHARACTERISTIC
/begin CHARACTERISTIC CtApImageProcess_FreeRunning.PpImageProcess_Obstacle_60ms.DeObstacle.gstObjects[6].fPiont2Y "" VALUE 0x3c02d0 __FLOAT32_IEEE_S 0 NO_COMPU_METHOD 0 3.402823e+38 ECU_ADDRESS_EXTENSION 0x80 /end CHARACTERISTIC
/begin CHARACTERISTIC CtApImageProcess_FreeRunning.PpImageProcess_Obstacle_60ms.DeObstacle.gstObjects[6].fRelVelocityX "" VALUE 0x3c02d4 __FLOAT32_IEEE_S 0 NO_COMPU_METHOD 0 3.402823e+38 ECU_ADDRESS_EXTENSION 0x80 /end CHARACTERISTIC
/begin CHARACTERISTIC CtApImageProcess_FreeRunning.PpImageProcess_Obstacle_60ms.DeObstacle.gstObjects[6].fRelVelocityY "" VALUE 0x3c02d8 __FLOAT32_IEEE_S 0 NO_COMPU_METHOD 0 3.402823e+38 ECU_ADDRESS_EXTENSION 0x80 /end CHARACTERISTIC
/begin CHARACTERISTIC CtApImageProcess_FreeRunning.PpImageProcess_Obstacle_60ms.DeObstacle.gstObjects[6].fAblVelocityX "" VALUE 0x3c02dc __FLOAT32_IEEE_S 0 NO_COMPU_METHOD 0 3.402823e+38 ECU_ADDRESS_EXTENSION 0x80 /end CHARACTERISTIC
/begin CHARACTERISTIC CtApImageProcess_FreeRunning.PpImageProcess_Obstacle_60ms.DeObstacle.gstObjects[6].fAblVelocityY "" VALUE 0x3c02e0 __FLOAT32_IEEE_S 0 NO_COMPU_METHOD 0 3.402823e+38 ECU_ADDRESS_EXTENSION 0x80 /end CHARACTERISTIC
/begin CHARACTERISTIC CtApImageProcess_FreeRunning.PpImageProcess_Obstacle_60ms.DeObstacle.gstObjects[6].fAbsValY "" VALUE 0x3c02e4 __FLOAT32_IEEE_S 0 NO_COMPU_METHOD 0 3.402823e+38 ECU_ADDRESS_EXTENSION 0x80 /end CHARACTERISTIC
/begin CHARACTERISTIC CtApImageProcess_FreeRunning.PpImageProcess_Obstacle_60ms.DeObstacle.gstObjects[6].nPoint1OnCar "" VALUE 0x3c02e8 __UBYTE_S 0 NO_COMPU_METHOD 0 255 ECU_ADDRESS_EXTENSION 0x80 /end CHARACTERISTIC
/begin CHARACTERISTIC CtApImageProcess_FreeRunning.PpImageProcess_Obstacle_60ms.DeObstacle.gstObjects[6].nPoint2OnCar "" VALUE 0x3c02e9 __UBYTE_S 0 NO_COMPU_METHOD 0 255 ECU_ADDRESS_EXTENSION 0x80 /end CHARACTERISTIC
/begin CHARACTERISTIC CtApImageProcess_FreeRunning.PpImageProcess_Obstacle_60ms.DeObstacle.gstObjects[6].fReserved "10 uint32 array" VAL_BLK 0x3c02ec __ULONG_S 0 NO_COMPU_METHOD 0 4294967295 ECU_ADDRESS_EXTENSION 0x80 MATRIX_DIM 10 1 1 /end CHARACTERISTIC
/begin CHARACTERISTIC CtApImageProcess_FreeRunning.PpImageProcess_Obstacle_60ms.DeObstacle.gstObjects[6].n3D "" VALUE 0x3c0314 __UBYTE_S 0 NO_COMPU_METHOD 0 255 ECU_ADDRESS_EXTENSION 0x80 /end CHARACTERISTIC
/begin CHARACTERISTIC CtApImageProcess_FreeRunning.PpImageProcess_Obstacle_60ms.DeObstacle.gstObjects[6].fPoint3X "" VALUE 0x3c0318 __FLOAT32_IEEE_S 0 NO_COMPU_METHOD 0 3.402823e+38 ECU_ADDRESS_EXTENSION 0x80 /end CHARACTERISTIC
/begin CHARACTERISTIC CtApImageProcess_FreeRunning.PpImageProcess_Obstacle_60ms.DeObstacle.gstObjects[6].fPoint3Y "" VALUE 0x3c031c __FLOAT32_IEEE_S 0 NO_COMPU_METHOD 0 3.402823e+38 ECU_ADDRESS_EXTENSION 0x80 /end CHARACTERISTIC
/begin CHARACTERISTIC CtApImageProcess_FreeRunning.PpImageProcess_Obstacle_60ms.DeObstacle.gstObjects[6].fPoint4X "" VALUE 0x3c0320 __FLOAT32_IEEE_S 0 NO_COMPU_METHOD 0 3.402823e+38 ECU_ADDRESS_EXTENSION 0x80 /end CHARACTERISTIC
/begin CHARACTERISTIC CtApImageProcess_FreeRunning.PpImageProcess_Obstacle_60ms.DeObstacle.gstObjects[6].fPoint4Y "" VALUE 0x3c0324 __FLOAT32_IEEE_S 0 NO_COMPU_METHOD 0 3.402823e+38 ECU_ADDRESS_EXTENSION 0x80 /end CHARACTERISTIC
/begin CHARACTERISTIC CtApImageProcess_FreeRunning.PpImageProcess_Obstacle_60ms.DeObstacle.gstObjects[7].nObjectID "" VALUE 0x3c0328 __UWORD_S 0 NO_COMPU_METHOD 0 65535 ECU_ADDRESS_EXTENSION 0x80 /end CHARACTERISTIC
/begin CHARACTERISTIC CtApImageProcess_FreeRunning.PpImageProcess_Obstacle_60ms.DeObstacle.gstObjects[7].nType "" VALUE 0x3c032a __UBYTE_S 0 NO_COMPU_METHOD 0 255 ECU_ADDRESS_EXTENSION 0x80 /end CHARACTERISTIC
/begin CHARACTERISTIC CtApImageProcess_FreeRunning.PpImageProcess_Obstacle_60ms.DeObstacle.gstObjects[7].nAge "" VALUE 0x3c032b __UBYTE_S 0 NO_COMPU_METHOD 0 255 ECU_ADDRESS_EXTENSION 0x80 /end CHARACTERISTIC
/begin CHARACTERISTIC CtApImageProcess_FreeRunning.PpImageProcess_Obstacle_60ms.DeObstacle.gstObjects[7].nQuality "" VALUE 0x3c032c __UBYTE_S 0 NO_COMPU_METHOD 0 255 ECU_ADDRESS_EXTENSION 0x80 /end CHARACTERISTIC
/begin CHARACTERISTIC CtApImageProcess_FreeRunning.PpImageProcess_Obstacle_60ms.DeObstacle.gstObjects[7].fHeight "" VALUE 0x3c0330 __FLOAT32_IEEE_S 0 NO_COMPU_METHOD 0 3.402823e+38 ECU_ADDRESS_EXTENSION 0x80 /end CHARACTERISTIC
/begin CHARACTERISTIC CtApImageProcess_FreeRunning.PpImageProcess_Obstacle_60ms.DeObstacle.gstObjects[7].fPiont1X "" VALUE 0x3c0334 __FLOAT32_IEEE_S 0 NO_COMPU_METHOD 0 3.402823e+38 ECU_ADDRESS_EXTENSION 0x80 /end CHARACTERISTIC
/begin CHARACTERISTIC CtApImageProcess_FreeRunning.PpImageProcess_Obstacle_60ms.DeObstacle.gstObjects[7].fPiont1Y "" VALUE 0x3c0338 __FLOAT32_IEEE_S 0 NO_COMPU_METHOD 0 3.402823e+38 ECU_ADDRESS_EXTENSION 0x80 /end CHARACTERISTIC
/begin CHARACTERISTIC CtApImageProcess_FreeRunning.PpImageProcess_Obstacle_60ms.DeObstacle.gstObjects[7].fPiont2X "" VALUE 0x3c033c __FLOAT32_IEEE_S 0 NO_COMPU_METHOD 0 3.402823e+38 ECU_ADDRESS_EXTENSION 0x80 /end CHARACTERISTIC
/begin CHARACTERISTIC CtApImageProcess_FreeRunning.PpImageProcess_Obstacle_60ms.DeObstacle.gstObjects[7].fPiont2Y "" VALUE 0x3c0340 __FLOAT32_IEEE_S 0 NO_COMPU_METHOD 0 3.402823e+38 ECU_ADDRESS_EXTENSION 0x80 /end CHARACTERISTIC
/begin CHARACTERISTIC CtApImageProcess_FreeRunning.PpImageProcess_Obstacle_60ms.DeObstacle.gstObjects[7].fRelVelocityX "" VALUE 0x3c0344 __FLOAT32_IEEE_S 0 NO_COMPU_METHOD 0 3.402823e+38 ECU_ADDRESS_EXTENSION 0x80 /end CHARACTERISTIC
/begin CHARACTERISTIC CtApImageProcess_FreeRunning.PpImageProcess_Obstacle_60ms.DeObstacle.gstObjects[7].fRelVelocityY "" VALUE 0x3c0348 __FLOAT32_IEEE_S 0 NO_COMPU_METHOD 0 3.402823e+38 ECU_ADDRESS_EXTENSION 0x80 /end CHARACTERISTIC
/begin CHARACTERISTIC CtApImageProcess_FreeRunning.PpImageProcess_Obstacle_60ms.DeObstacle.gstObjects[7].fAblVelocityX "" VALUE 0x3c034c __FLOAT32_IEEE_S 0 NO_COMPU_METHOD 0 3.402823e+38 ECU_ADDRESS_EXTENSION 0x80 /end CHARACTERISTIC
/begin CHARACTERISTIC CtApImageProcess_FreeRunning.PpImageProcess_Obstacle_60ms.DeObstacle.gstObjects[7].fAblVelocityY "" VALUE 0x3c0350 __FLOAT32_IEEE_S 0 NO_COMPU_METHOD 0 3.402823e+38 ECU_ADDRESS_EXTENSION 0x80 /end CHARACTERISTIC
/begin CHARACTERISTIC CtApImageProcess_FreeRunning.PpImageProcess_Obstacle_60ms.DeObstacle.gstObjects[7].fAbsValY "" VALUE 0x3c0354 __FLOAT32_IEEE_S 0 NO_COMPU_METHOD 0 3.402823e+38 ECU_ADDRESS_EXTENSION 0x80 /end CHARACTERISTIC
/begin CHARACTERISTIC CtApImageProcess_FreeRunning.PpImageProcess_Obstacle_60ms.DeObstacle.gstObjects[7].nPoint1OnCar "" VALUE 0x3c0358 __UBYTE_S 0 NO_COMPU_METHOD 0 255 ECU_ADDRESS_EXTENSION 0x80 /end CHARACTERISTIC
/begin CHARACTERISTIC CtApImageProcess_FreeRunning.PpImageProcess_Obstacle_60ms.DeObstacle.gstObjects[7].nPoint2OnCar "" VALUE 0x3c0359 __UBYTE_S 0 NO_COMPU_METHOD 0 255 ECU_ADDRESS_EXTENSION 0x80 /end CHARACTERISTIC
/begin CHARACTERISTIC CtApImageProcess_FreeRunning.PpImageProcess_Obstacle_60ms.DeObstacle.gstObjects[7].fReserved "10 uint32 array" VAL_BLK 0x3c035c __ULONG_S 0 NO_COMPU_METHOD 0 4294967295 ECU_ADDRESS_EXTENSION 0x80 MATRIX_DIM 10 1 1 /end CHARACTERISTIC
/begin CHARACTERISTIC CtApImageProcess_FreeRunning.PpImageProcess_Obstacle_60ms.DeObstacle.gstObjects[7].n3D "" VALUE 0x3c0384 __UBYTE_S 0 NO_COMPU_METHOD 0 255 ECU_ADDRESS_EXTENSION 0x80 /end CHARACTERISTIC
/begin CHARACTERISTIC CtApImageProcess_FreeRunning.PpImageProcess_Obstacle_60ms.DeObstacle.gstObjects[7].fPoint3X "" VALUE 0x3c0388 __FLOAT32_IEEE_S 0 NO_COMPU_METHOD 0 3.402823e+38 ECU_ADDRESS_EXTENSION 0x80 /end CHARACTERISTIC
/begin CHARACTERISTIC CtApImageProcess_FreeRunning.PpImageProcess_Obstacle_60ms.DeObstacle.gstObjects[7].fPoint3Y "" VALUE 0x3c038c __FLOAT32_IEEE_S 0 NO_COMPU_METHOD 0 3.402823e+38 ECU_ADDRESS_EXTENSION 0x80 /end CHARACTERISTIC
/begin CHARACTERISTIC CtApImageProcess_FreeRunning.PpImageProcess_Obstacle_60ms.DeObstacle.gstObjects[7].fPoint4X "" VALUE 0x3c0390 __FLOAT32_IEEE_S 0 NO_COMPU_METHOD 0 3.402823e+38 ECU_ADDRESS_EXTENSION 0x80 /end CHARACTERISTIC
/begin CHARACTERISTIC CtApImageProcess_FreeRunning.PpImageProcess_Obstacle_60ms.DeObstacle.gstObjects[7].fPoint4Y "" VALUE 0x3c0394 __FLOAT32_IEEE_S 0 NO_COMPU_METHOD 0 3.402823e+38 ECU_ADDRESS_EXTENSION 0x80 /end CHARACTERISTIC
/begin CHARACTERISTIC CtApImageProcess_FreeRunning.PpImageProcess_Obstacle_60ms.DeObstacle.gstObjects[8].nObjectID "" VALUE 0x3c0398 __UWORD_S 0 NO_COMPU_METHOD 0 65535 ECU_ADDRESS_EXTENSION 0x80 /end CHARACTERISTIC
/begin CHARACTERISTIC CtApImageProcess_FreeRunning.PpImageProcess_Obstacle_60ms.DeObstacle.gstObjects[8].nType "" VALUE 0x3c039a __UBYTE_S 0 NO_COMPU_METHOD 0 255 ECU_ADDRESS_EXTENSION 0x80 /end CHARACTERISTIC
/begin CHARACTERISTIC CtApImageProcess_FreeRunning.PpImageProcess_Obstacle_60ms.DeObstacle.gstObjects[8].nAge "" VALUE 0x3c039b __UBYTE_S 0 NO_COMPU_METHOD 0 255 ECU_ADDRESS_EXTENSION 0x80 /end CHARACTERISTIC
/begin CHARACTERISTIC CtApImageProcess_FreeRunning.PpImageProcess_Obstacle_60ms.DeObstacle.gstObjects[8].nQuality "" VALUE 0x3c039c __UBYTE_S 0 NO_COMPU_METHOD 0 255 ECU_ADDRESS_EXTENSION 0x80 /end CHARACTERISTIC
/begin CHARACTERISTIC CtApImageProcess_FreeRunning.PpImageProcess_Obstacle_60ms.DeObstacle.gstObjects[8].fHeight "" VALUE 0x3c03a0 __FLOAT32_IEEE_S 0 NO_COMPU_METHOD 0 3.402823e+38 ECU_ADDRESS_EXTENSION 0x80 /end CHARACTERISTIC
/begin CHARACTERISTIC CtApImageProcess_FreeRunning.PpImageProcess_Obstacle_60ms.DeObstacle.gstObjects[8].fPiont1X "" VALUE 0x3c03a4 __FLOAT32_IEEE_S 0 NO_COMPU_METHOD 0 3.402823e+38 ECU_ADDRESS_EXTENSION 0x80 /end CHARACTERISTIC
/begin CHARACTERISTIC CtApImageProcess_FreeRunning.PpImageProcess_Obstacle_60ms.DeObstacle.gstObjects[8].fPiont1Y "" VALUE 0x3c03a8 __FLOAT32_IEEE_S 0 NO_COMPU_METHOD 0 3.402823e+38 ECU_ADDRESS_EXTENSION 0x80 /end CHARACTERISTIC
/begin CHARACTERISTIC CtApImageProcess_FreeRunning.PpImageProcess_Obstacle_60ms.DeObstacle.gstObjects[8].fPiont2X "" VALUE 0x3c03ac __FLOAT32_IEEE_S 0 NO_COMPU_METHOD 0 3.402823e+38 ECU_ADDRESS_EXTENSION 0x80 /end CHARACTERISTIC
/begin CHARACTERISTIC CtApImageProcess_FreeRunning.PpImageProcess_Obstacle_60ms.DeObstacle.gstObjects[8].fPiont2Y "" VALUE 0x3c03b0 __FLOAT32_IEEE_S 0 NO_COMPU_METHOD 0 3.402823e+38 ECU_ADDRESS_EXTENSION 0x80 /end CHARACTERISTIC
/begin CHARACTERISTIC CtApImageProcess_FreeRunning.PpImageProcess_Obstacle_60ms.DeObstacle.gstObjects[8].fRelVelocityX "" VALUE 0x3c03b4 __FLOAT32_IEEE_S 0 NO_COMPU_METHOD 0 3.402823e+38 ECU_ADDRESS_EXTENSION 0x80 /end CHARACTERISTIC
/begin CHARACTERISTIC CtApImageProcess_FreeRunning.PpImageProcess_Obstacle_60ms.DeObstacle.gstObjects[8].fRelVelocityY "" VALUE 0x3c03b8 __FLOAT32_IEEE_S 0 NO_COMPU_METHOD 0 3.402823e+38 ECU_ADDRESS_EXTENSION 0x80 /end CHARACTERISTIC
/begin CHARACTERISTIC CtApImageProcess_FreeRunning.PpImageProcess_Obstacle_60ms.DeObstacle.gstObjects[8].fAblVelocityX "" VALUE 0x3c03bc __FLOAT32_IEEE_S 0 NO_COMPU_METHOD 0 3.402823e+38 ECU_ADDRESS_EXTENSION 0x80 /end CHARACTERISTIC
/begin CHARACTERISTIC CtApImageProcess_FreeRunning.PpImageProcess_Obstacle_60ms.DeObstacle.gstObjects[8].fAblVelocityY "" VALUE 0x3c03c0 __FLOAT32_IEEE_S 0 NO_COMPU_METHOD 0 3.402823e+38 ECU_ADDRESS_EXTENSION 0x80 /end CHARACTERISTIC
/begin CHARACTERISTIC CtApImageProcess_FreeRunning.PpImageProcess_Obstacle_60ms.DeObstacle.gstObjects[8].fAbsValY "" VALUE 0x3c03c4 __FLOAT32_IEEE_S 0 NO_COMPU_METHOD 0 3.402823e+38 ECU_ADDRESS_EXTENSION 0x80 /end CHARACTERISTIC
/begin CHARACTERISTIC CtApImageProcess_FreeRunning.PpImageProcess_Obstacle_60ms.DeObstacle.gstObjects[8].nPoint1OnCar "" VALUE 0x3c03c8 __UBYTE_S 0 NO_COMPU_METHOD 0 255 ECU_ADDRESS_EXTENSION 0x80 /end CHARACTERISTIC
/begin CHARACTERISTIC CtApImageProcess_FreeRunning.PpImageProcess_Obstacle_60ms.DeObstacle.gstObjects[8].nPoint2OnCar "" VALUE 0x3c03c9 __UBYTE_S 0 NO_COMPU_METHOD 0 255 ECU_ADDRESS_EXTENSION 0x80 /end CHARACTERISTIC
/begin CHARACTERISTIC CtApImageProcess_FreeRunning.PpImageProcess_Obstacle_60ms.DeObstacle.gstObjects[8].fReserved "10 uint32 array" VAL_BLK 0x3c03cc __ULONG_S 0 NO_COMPU_METHOD 0 4294967295 ECU_ADDRESS_EXTENSION 0x80 MATRIX_DIM 10 1 1 /end CHARACTERISTIC
/begin CHARACTERISTIC CtApImageProcess_FreeRunning.PpImageProcess_Obstacle_60ms.DeObstacle.gstObjects[8].n3D "" VALUE 0x3c03f4 __UBYTE_S 0 NO_COMPU_METHOD 0 255 ECU_ADDRESS_EXTENSION 0x80 /end CHARACTERISTIC
/begin CHARACTERISTIC CtApImageProcess_FreeRunning.PpImageProcess_Obstacle_60ms.DeObstacle.gstObjects[8].fPoint3X "" VALUE 0x3c03f8 __FLOAT32_IEEE_S 0 NO_COMPU_METHOD 0 3.402823e+38 ECU_ADDRESS_EXTENSION 0x80 /end CHARACTERISTIC
/begin CHARACTERISTIC CtApImageProcess_FreeRunning.PpImageProcess_Obstacle_60ms.DeObstacle.gstObjects[8].fPoint3Y "" VALUE 0x3c03fc __FLOAT32_IEEE_S 0 NO_COMPU_METHOD 0 3.402823e+38 ECU_ADDRESS_EXTENSION 0x80 /end CHARACTERISTIC
/begin CHARACTERISTIC CtApImageProcess_FreeRunning.PpImageProcess_Obstacle_60ms.DeObstacle.gstObjects[8].fPoint4X "" VALUE 0x3c0400 __FLOAT32_IEEE_S 0 NO_COMPU_METHOD 0 3.402823e+38 ECU_ADDRESS_EXTENSION 0x80 /end CHARACTERISTIC
/begin CHARACTERISTIC CtApImageProcess_FreeRunning.PpImageProcess_Obstacle_60ms.DeObstacle.gstObjects[8].fPoint4Y "" VALUE 0x3c0404 __FLOAT32_IEEE_S 0 NO_COMPU_METHOD 0 3.402823e+38 ECU_ADDRESS_EXTENSION 0x80 /end CHARACTERISTIC
/begin CHARACTERISTIC CtApImageProcess_FreeRunning.PpImageProcess_Obstacle_60ms.DeObstacle.gstObjects[9].nObjectID "" VALUE 0x3c0408 __UWORD_S 0 NO_COMPU_METHOD 0 65535 ECU_ADDRESS_EXTENSION 0x80 /end CHARACTERISTIC
/begin CHARACTERISTIC CtApImageProcess_FreeRunning.PpImageProcess_Obstacle_60ms.DeObstacle.gstObjects[9].nType "" VALUE 0x3c040a __UBYTE_S 0 NO_COMPU_METHOD 0 255 ECU_ADDRESS_EXTENSION 0x80 /end CHARACTERISTIC
/begin CHARACTERISTIC CtApImageProcess_FreeRunning.PpImageProcess_Obstacle_60ms.DeObstacle.gstObjects[9].nAge "" VALUE 0x3c040b __UBYTE_S 0 NO_COMPU_METHOD 0 255 ECU_ADDRESS_EXTENSION 0x80 /end CHARACTERISTIC
/begin CHARACTERISTIC CtApImageProcess_FreeRunning.PpImageProcess_Obstacle_60ms.DeObstacle.gstObjects[9].nQuality "" VALUE 0x3c040c __UBYTE_S 0 NO_COMPU_METHOD 0 255 ECU_ADDRESS_EXTENSION 0x80 /end CHARACTERISTIC
/begin CHARACTERISTIC CtApImageProcess_FreeRunning.PpImageProcess_Obstacle_60ms.DeObstacle.gstObjects[9].fHeight "" VALUE 0x3c0410 __FLOAT32_IEEE_S 0 NO_COMPU_METHOD 0 3.402823e+38 ECU_ADDRESS_EXTENSION 0x80 /end CHARACTERISTIC
/begin CHARACTERISTIC CtApImageProcess_FreeRunning.PpImageProcess_Obstacle_60ms.DeObstacle.gstObjects[9].fPiont1X "" VALUE 0x3c0414 __FLOAT32_IEEE_S 0 NO_COMPU_METHOD 0 3.402823e+38 ECU_ADDRESS_EXTENSION 0x80 /end CHARACTERISTIC
/begin CHARACTERISTIC CtApImageProcess_FreeRunning.PpImageProcess_Obstacle_60ms.DeObstacle.gstObjects[9].fPiont1Y "" VALUE 0x3c0418 __FLOAT32_IEEE_S 0 NO_COMPU_METHOD 0 3.402823e+38 ECU_ADDRESS_EXTENSION 0x80 /end CHARACTERISTIC
/begin CHARACTERISTIC CtApImageProcess_FreeRunning.PpImageProcess_Obstacle_60ms.DeObstacle.gstObjects[9].fPiont2X "" VALUE 0x3c041c __FLOAT32_IEEE_S 0 NO_COMPU_METHOD 0 3.402823e+38 ECU_ADDRESS_EXTENSION 0x80 /end CHARACTERISTIC
/begin CHARACTERISTIC CtApImageProcess_FreeRunning.PpImageProcess_Obstacle_60ms.DeObstacle.gstObjects[9].fPiont2Y "" VALUE 0x3c0420 __FLOAT32_IEEE_S 0 NO_COMPU_METHOD 0 3.402823e+38 ECU_ADDRESS_EXTENSION 0x80 /end CHARACTERISTIC
/begin CHARACTERISTIC CtApImageProcess_FreeRunning.PpImageProcess_Obstacle_60ms.DeObstacle.gstObjects[9].fRelVelocityX "" VALUE 0x3c0424 __FLOAT32_IEEE_S 0 NO_COMPU_METHOD 0 3.402823e+38 ECU_ADDRESS_EXTENSION 0x80 /end CHARACTERISTIC
/begin CHARACTERISTIC CtApImageProcess_FreeRunning.PpImageProcess_Obstacle_60ms.DeObstacle.gstObjects[9].fRelVelocityY "" VALUE 0x3c0428 __FLOAT32_IEEE_S 0 NO_COMPU_METHOD 0 3.402823e+38 ECU_ADDRESS_EXTENSION 0x80 /end CHARACTERISTIC
/begin CHARACTERISTIC CtApImageProcess_FreeRunning.PpImageProcess_Obstacle_60ms.DeObstacle.gstObjects[9].fAblVelocityX "" VALUE 0x3c042c __FLOAT32_IEEE_S 0 NO_COMPU_METHOD 0 3.402823e+38 ECU_ADDRESS_EXTENSION 0x80 /end CHARACTERISTIC
/begin CHARACTERISTIC CtApImageProcess_FreeRunning.PpImageProcess_Obstacle_60ms.DeObstacle.gstObjects[9].fAblVelocityY "" VALUE 0x3c0430 __FLOAT32_IEEE_S 0 NO_COMPU_METHOD 0 3.402823e+38 ECU_ADDRESS_EXTENSION 0x80 /end CHARACTERISTIC
/begin CHARACTERISTIC CtApImageProcess_FreeRunning.PpImageProcess_Obstacle_60ms.DeObstacle.gstObjects[9].fAbsValY "" VALUE 0x3c0434 __FLOAT32_IEEE_S 0 NO_COMPU_METHOD 0 3.402823e+38 ECU_ADDRESS_EXTENSION 0x80 /end CHARACTERISTIC
/begin CHARACTERISTIC CtApImageProcess_FreeRunning.PpImageProcess_Obstacle_60ms.DeObstacle.gstObjects[9].nPoint1OnCar "" VALUE 0x3c0438 __UBYTE_S 0 NO_COMPU_METHOD 0 255 ECU_ADDRESS_EXTENSION 0x80 /end CHARACTERISTIC
/begin CHARACTERISTIC CtApImageProcess_FreeRunning.PpImageProcess_Obstacle_60ms.DeObstacle.gstObjects[9].nPoint2OnCar "" VALUE 0x3c0439 __UBYTE_S 0 NO_COMPU_METHOD 0 255 ECU_ADDRESS_EXTENSION 0x80 /end CHARACTERISTIC
/begin CHARACTERISTIC CtApImageProcess_FreeRunning.PpImageProcess_Obstacle_60ms.DeObstacle.gstObjects[9].fReserved "10 uint32 array" VAL_BLK 0x3c043c __ULONG_S 0 NO_COMPU_METHOD 0 4294967295 ECU_ADDRESS_EXTENSION 0x80 MATRIX_DIM 10 1 1 /end CHARACTERISTIC
/begin CHARACTERISTIC CtApImageProcess_FreeRunning.PpImageProcess_Obstacle_60ms.DeObstacle.gstObjects[9].n3D "" VALUE 0x3c0464 __UBYTE_S 0 NO_COMPU_METHOD 0 255 ECU_ADDRESS_EXTENSION 0x80 /end CHARACTERISTIC
/begin CHARACTERISTIC CtApImageProcess_FreeRunning.PpImageProcess_Obstacle_60ms.DeObstacle.gstObjects[9].fPoint3X "" VALUE 0x3c0468 __FLOAT32_IEEE_S 0 NO_COMPU_METHOD 0 3.402823e+38 ECU_ADDRESS_EXTENSION 0x80 /end CHARACTERISTIC
/begin CHARACTERISTIC CtApImageProcess_FreeRunning.PpImageProcess_Obstacle_60ms.DeObstacle.gstObjects[9].fPoint3Y "" VALUE 0x3c046c __FLOAT32_IEEE_S 0 NO_COMPU_METHOD 0 3.402823e+38 ECU_ADDRESS_EXTENSION 0x80 /end CHARACTERISTIC
/begin CHARACTERISTIC CtApImageProcess_FreeRunning.PpImageProcess_Obstacle_60ms.DeObstacle.gstObjects[9].fPoint4X "" VALUE 0x3c0470 __FLOAT32_IEEE_S 0 NO_COMPU_METHOD 0 3.402823e+38 ECU_ADDRESS_EXTENSION 0x80 /end CHARACTERISTIC
/begin CHARACTERISTIC CtApImageProcess_FreeRunning.PpImageProcess_Obstacle_60ms.DeObstacle.gstObjects[9].fPoint4Y "" VALUE 0x3c0474 __FLOAT32_IEEE_S 0 NO_COMPU_METHOD 0 3.402823e+38 ECU_ADDRESS_EXTENSION 0x80 /end CHARACTERISTIC
/begin CHARACTERISTIC CtApImageProcess_FreeRunning.PpImageProcess_Obstacle_60ms.DeObstacle.gstObjects[10].nObjectID "" VALUE 0x3c0478 __UWORD_S 0 NO_COMPU_METHOD 0 65535 ECU_ADDRESS_EXTENSION 0x80 /end CHARACTERISTIC
/begin CHARACTERISTIC CtApImageProcess_FreeRunning.PpImageProcess_Obstacle_60ms.DeObstacle.gstObjects[10].nType "" VALUE 0x3c047a __UBYTE_S 0 NO_COMPU_METHOD 0 255 ECU_ADDRESS_EXTENSION 0x80 /end CHARACTERISTIC
/begin CHARACTERISTIC CtApImageProcess_FreeRunning.PpImageProcess_Obstacle_60ms.DeObstacle.gstObjects[10].nAge "" VALUE 0x3c047b __UBYTE_S 0 NO_COMPU_METHOD 0 255 ECU_ADDRESS_EXTENSION 0x80 /end CHARACTERISTIC
/begin CHARACTERISTIC CtApImageProcess_FreeRunning.PpImageProcess_Obstacle_60ms.DeObstacle.gstObjects[10].nQuality "" VALUE 0x3c047c __UBYTE_S 0 NO_COMPU_METHOD 0 255 ECU_ADDRESS_EXTENSION 0x80 /end CHARACTERISTIC
/begin CHARACTERISTIC CtApImageProcess_FreeRunning.PpImageProcess_Obstacle_60ms.DeObstacle.gstObjects[10].fHeight "" VALUE 0x3c0480 __FLOAT32_IEEE_S 0 NO_COMPU_METHOD 0 3.402823e+38 ECU_ADDRESS_EXTENSION 0x80 /end CHARACTERISTIC
/begin CHARACTERISTIC CtApImageProcess_FreeRunning.PpImageProcess_Obstacle_60ms.DeObstacle.gstObjects[10].fPiont1X "" VALUE 0x3c0484 __FLOAT32_IEEE_S 0 NO_COMPU_METHOD 0 3.402823e+38 ECU_ADDRESS_EXTENSION 0x80 /end CHARACTERISTIC
/begin CHARACTERISTIC CtApImageProcess_FreeRunning.PpImageProcess_Obstacle_60ms.DeObstacle.gstObjects[10].fPiont1Y "" VALUE 0x3c0488 __FLOAT32_IEEE_S 0 NO_COMPU_METHOD 0 3.402823e+38 ECU_ADDRESS_EXTENSION 0x80 /end CHARACTERISTIC
/begin CHARACTERISTIC CtApImageProcess_FreeRunning.PpImageProcess_Obstacle_60ms.DeObstacle.gstObjects[10].fPiont2X "" VALUE 0x3c048c __FLOAT32_IEEE_S 0 NO_COMPU_METHOD 0 3.402823e+38 ECU_ADDRESS_EXTENSION 0x80 /end CHARACTERISTIC
/begin CHARACTERISTIC CtApImageProcess_FreeRunning.PpImageProcess_Obstacle_60ms.DeObstacle.gstObjects[10].fPiont2Y "" VALUE 0x3c0490 __FLOAT32_IEEE_S 0 NO_COMPU_METHOD 0 3.402823e+38 ECU_ADDRESS_EXTENSION 0x80 /end CHARACTERISTIC
/begin CHARACTERISTIC CtApImageProcess_FreeRunning.PpImageProcess_Obstacle_60ms.DeObstacle.gstObjects[10].fRelVelocityX "" VALUE 0x3c0494 __FLOAT32_IEEE_S 0 NO_COMPU_METHOD 0 3.402823e+38 ECU_ADDRESS_EXTENSION 0x80 /end CHARACTERISTIC
/begin CHARACTERISTIC CtApImageProcess_FreeRunning.PpImageProcess_Obstacle_60ms.DeObstacle.gstObjects[10].fRelVelocityY "" VALUE 0x3c0498 __FLOAT32_IEEE_S 0 NO_COMPU_METHOD 0 3.402823e+38 ECU_ADDRESS_EXTENSION 0x80 /end CHARACTERISTIC
/begin CHARACTERISTIC CtApImageProcess_FreeRunning.PpImageProcess_Obstacle_60ms.DeObstacle.gstObjects[10].fAblVelocityX "" VALUE 0x3c049c __FLOAT32_IEEE_S 0 NO_COMPU_METHOD 0 3.402823e+38 ECU_ADDRESS_EXTENSION 0x80 /end CHARACTERISTIC
/begin CHARACTERISTIC CtApImageProcess_FreeRunning.PpImageProcess_Obstacle_60ms.DeObstacle.gstObjects[10].fAblVelocityY "" VALUE 0x3c04a0 __FLOAT32_IEEE_S 0 NO_COMPU_METHOD 0 3.402823e+38 ECU_ADDRESS_EXTENSION 0x80 /end CHARACTERISTIC
/begin CHARACTERISTIC CtApImageProcess_FreeRunning.PpImageProcess_Obstacle_60ms.DeObstacle.gstObjects[10].fAbsValY "" VALUE 0x3c04a4 __FLOAT32_IEEE_S 0 NO_COMPU_METHOD 0 3.402823e+38 ECU_ADDRESS_EXTENSION 0x80 /end CHARACTERISTIC
/begin CHARACTERISTIC CtApImageProcess_FreeRunning.PpImageProcess_Obstacle_60ms.DeObstacle.gstObjects[10].nPoint1OnCar "" VALUE 0x3c04a8 __UBYTE_S 0 NO_COMPU_METHOD 0 255 ECU_ADDRESS_EXTENSION 0x80 /end CHARACTERISTIC
/begin CHARACTERISTIC CtApImageProcess_FreeRunning.PpImageProcess_Obstacle_60ms.DeObstacle.gstObjects[10].nPoint2OnCar "" VALUE 0x3c04a9 __UBYTE_S 0 NO_COMPU_METHOD 0 255 ECU_ADDRESS_EXTENSION 0x80 /end CHARACTERISTIC
/begin CHARACTERISTIC CtApImageProcess_FreeRunning.PpImageProcess_Obstacle_60ms.DeObstacle.gstObjects[10].fReserved "10 uint32 array" VAL_BLK 0x3c04ac __ULONG_S 0 NO_COMPU_METHOD 0 4294967295 ECU_ADDRESS_EXTENSION 0x80 MATRIX_DIM 10 1 1 /end CHARACTERISTIC
/begin CHARACTERISTIC CtApImageProcess_FreeRunning.PpImageProcess_Obstacle_60ms.DeObstacle.gstObjects[10].n3D "" VALUE 0x3c04d4 __UBYTE_S 0 NO_COMPU_METHOD 0 255 ECU_ADDRESS_EXTENSION 0x80 /end CHARACTERISTIC
/begin CHARACTERISTIC CtApImageProcess_FreeRunning.PpImageProcess_Obstacle_60ms.DeObstacle.gstObjects[10].fPoint3X "" VALUE 0x3c04d8 __FLOAT32_IEEE_S 0 NO_COMPU_METHOD 0 3.402823e+38 ECU_ADDRESS_EXTENSION 0x80 /end CHARACTERISTIC
/begin CHARACTERISTIC CtApImageProcess_FreeRunning.PpImageProcess_Obstacle_60ms.DeObstacle.gstObjects[10].fPoint3Y "" VALUE 0x3c04dc __FLOAT32_IEEE_S 0 NO_COMPU_METHOD 0 3.402823e+38 ECU_ADDRESS_EXTENSION 0x80 /end CHARACTERISTIC
/begin CHARACTERISTIC CtApImageProcess_FreeRunning.PpImageProcess_Obstacle_60ms.DeObstacle.gstObjects[10].fPoint4X "" VALUE 0x3c04e0 __FLOAT32_IEEE_S 0 NO_COMPU_METHOD 0 3.402823e+38 ECU_ADDRESS_EXTENSION 0x80 /end CHARACTERISTIC
/begin CHARACTERISTIC CtApImageProcess_FreeRunning.PpImageProcess_Obstacle_60ms.DeObstacle.gstObjects[10].fPoint4Y "" VALUE 0x3c04e4 __FLOAT32_IEEE_S 0 NO_COMPU_METHOD 0 3.402823e+38 ECU_ADDRESS_EXTENSION 0x80 /end CHARACTERISTIC
/begin CHARACTERISTIC CtApImageProcess_FreeRunning.PpImageProcess_Obstacle_60ms.DeObstacle.gstObjects[11].nObjectID "" VALUE 0x3c04e8 __UWORD_S 0 NO_COMPU_METHOD 0 65535 ECU_ADDRESS_EXTENSION 0x80 /end CHARACTERISTIC
/begin CHARACTERISTIC CtApImageProcess_FreeRunning.PpImageProcess_Obstacle_60ms.DeObstacle.gstObjects[11].nType "" VALUE 0x3c04ea __UBYTE_S 0 NO_COMPU_METHOD 0 255 ECU_ADDRESS_EXTENSION 0x80 /end CHARACTERISTIC
/begin CHARACTERISTIC CtApImageProcess_FreeRunning.PpImageProcess_Obstacle_60ms.DeObstacle.gstObjects[11].nAge "" VALUE 0x3c04eb __UBYTE_S 0 NO_COMPU_METHOD 0 255 ECU_ADDRESS_EXTENSION 0x80 /end CHARACTERISTIC
/begin CHARACTERISTIC CtApImageProcess_FreeRunning.PpImageProcess_Obstacle_60ms.DeObstacle.gstObjects[11].nQuality "" VALUE 0x3c04ec __UBYTE_S 0 NO_COMPU_METHOD 0 255 ECU_ADDRESS_EXTENSION 0x80 /end CHARACTERISTIC
/begin CHARACTERISTIC CtApImageProcess_FreeRunning.PpImageProcess_Obstacle_60ms.DeObstacle.gstObjects[11].fHeight "" VALUE 0x3c04f0 __FLOAT32_IEEE_S 0 NO_COMPU_METHOD 0 3.402823e+38 ECU_ADDRESS_EXTENSION 0x80 /end CHARACTERISTIC
/begin CHARACTERISTIC CtApImageProcess_FreeRunning.PpImageProcess_Obstacle_60ms.DeObstacle.gstObjects[11].fPiont1X "" VALUE 0x3c04f4 __FLOAT32_IEEE_S 0 NO_COMPU_METHOD 0 3.402823e+38 ECU_ADDRESS_EXTENSION 0x80 /end CHARACTERISTIC
/begin CHARACTERISTIC CtApImageProcess_FreeRunning.PpImageProcess_Obstacle_60ms.DeObstacle.gstObjects[11].fPiont1Y "" VALUE 0x3c04f8 __FLOAT32_IEEE_S 0 NO_COMPU_METHOD 0 3.402823e+38 ECU_ADDRESS_EXTENSION 0x80 /end CHARACTERISTIC
/begin CHARACTERISTIC CtApImageProcess_FreeRunning.PpImageProcess_Obstacle_60ms.DeObstacle.gstObjects[11].fPiont2X "" VALUE 0x3c04fc __FLOAT32_IEEE_S 0 NO_COMPU_METHOD 0 3.402823e+38 ECU_ADDRESS_EXTENSION 0x80 /end CHARACTERISTIC
/begin CHARACTERISTIC CtApImageProcess_FreeRunning.PpImageProcess_Obstacle_60ms.DeObstacle.gstObjects[11].fPiont2Y "" VALUE 0x3c0500 __FLOAT32_IEEE_S 0 NO_COMPU_METHOD 0 3.402823e+38 ECU_ADDRESS_EXTENSION 0x80 /end CHARACTERISTIC
/begin CHARACTERISTIC CtApImageProcess_FreeRunning.PpImageProcess_Obstacle_60ms.DeObstacle.gstObjects[11].fRelVelocityX "" VALUE 0x3c0504 __FLOAT32_IEEE_S 0 NO_COMPU_METHOD 0 3.402823e+38 ECU_ADDRESS_EXTENSION 0x80 /end CHARACTERISTIC
/begin CHARACTERISTIC CtApImageProcess_FreeRunning.PpImageProcess_Obstacle_60ms.DeObstacle.gstObjects[11].fRelVelocityY "" VALUE 0x3c0508 __FLOAT32_IEEE_S 0 NO_COMPU_METHOD 0 3.402823e+38 ECU_ADDRESS_EXTENSION 0x80 /end CHARACTERISTIC
/begin CHARACTERISTIC CtApImageProcess_FreeRunning.PpImageProcess_Obstacle_60ms.DeObstacle.gstObjects[11].fAblVelocityX "" VALUE 0x3c050c __FLOAT32_IEEE_S 0 NO_COMPU_METHOD 0 3.402823e+38 ECU_ADDRESS_EXTENSION 0x80 /end CHARACTERISTIC
/begin CHARACTERISTIC CtApImageProcess_FreeRunning.PpImageProcess_Obstacle_60ms.DeObstacle.gstObjects[11].fAblVelocityY "" VALUE 0x3c0510 __FLOAT32_IEEE_S 0 NO_COMPU_METHOD 0 3.402823e+38 ECU_ADDRESS_EXTENSION 0x80 /end CHARACTERISTIC
/begin CHARACTERISTIC CtApImageProcess_FreeRunning.PpImageProcess_Obstacle_60ms.DeObstacle.gstObjects[11].fAbsValY "" VALUE 0x3c0514 __FLOAT32_IEEE_S 0 NO_COMPU_METHOD 0 3.402823e+38 ECU_ADDRESS_EXTENSION 0x80 /end CHARACTERISTIC
/begin CHARACTERISTIC CtApImageProcess_FreeRunning.PpImageProcess_Obstacle_60ms.DeObstacle.gstObjects[11].nPoint1OnCar "" VALUE 0x3c0518 __UBYTE_S 0 NO_COMPU_METHOD 0 255 ECU_ADDRESS_EXTENSION 0x80 /end CHARACTERISTIC
/begin CHARACTERISTIC CtApImageProcess_FreeRunning.PpImageProcess_Obstacle_60ms.DeObstacle.gstObjects[11].nPoint2OnCar "" VALUE 0x3c0519 __UBYTE_S 0 NO_COMPU_METHOD 0 255 ECU_ADDRESS_EXTENSION 0x80 /end CHARACTERISTIC
/begin CHARACTERISTIC CtApImageProcess_FreeRunning.PpImageProcess_Obstacle_60ms.DeObstacle.gstObjects[11].fReserved "10 uint32 array" VAL_BLK 0x3c051c __ULONG_S 0 NO_COMPU_METHOD 0 4294967295 ECU_ADDRESS_EXTENSION 0x80 MATRIX_DIM 10 1 1 /end CHARACTERISTIC
/begin CHARACTERISTIC CtApImageProcess_FreeRunning.PpImageProcess_Obstacle_60ms.DeObstacle.gstObjects[11].n3D "" VALUE 0x3c0544 __UBYTE_S 0 NO_COMPU_METHOD 0 255 ECU_ADDRESS_EXTENSION 0x80 /end CHARACTERISTIC
/begin CHARACTERISTIC CtApImageProcess_FreeRunning.PpImageProcess_Obstacle_60ms.DeObstacle.gstObjects[11].fPoint3X "" VALUE 0x3c0548 __FLOAT32_IEEE_S 0 NO_COMPU_METHOD 0 3.402823e+38 ECU_ADDRESS_EXTENSION 0x80 /end CHARACTERISTIC
/begin CHARACTERISTIC CtApImageProcess_FreeRunning.PpImageProcess_Obstacle_60ms.DeObstacle.gstObjects[11].fPoint3Y "" VALUE 0x3c054c __FLOAT32_IEEE_S 0 NO_COMPU_METHOD 0 3.402823e+38 ECU_ADDRESS_EXTENSION 0x80 /end CHARACTERISTIC
/begin CHARACTERISTIC CtApImageProcess_FreeRunning.PpImageProcess_Obstacle_60ms.DeObstacle.gstObjects[11].fPoint4X "" VALUE 0x3c0550 __FLOAT32_IEEE_S 0 NO_COMPU_METHOD 0 3.402823e+38 ECU_ADDRESS_EXTENSION 0x80 /end CHARACTERISTIC
/begin CHARACTERISTIC CtApImageProcess_FreeRunning.PpImageProcess_Obstacle_60ms.DeObstacle.gstObjects[11].fPoint4Y "" VALUE 0x3c0554 __FLOAT32_IEEE_S 0 NO_COMPU_METHOD 0 3.402823e+38 ECU_ADDRESS_EXTENSION 0x80 /end CHARACTERISTIC
/begin CHARACTERISTIC CtApImageProcess_FreeRunning.PpImageProcess_Obstacle_60ms.DeObstacle.gstObjects[12].nObjectID "" VALUE 0x3c0558 __UWORD_S 0 NO_COMPU_METHOD 0 65535 ECU_ADDRESS_EXTENSION 0x80 /end CHARACTERISTIC
/begin CHARACTERISTIC CtApImageProcess_FreeRunning.PpImageProcess_Obstacle_60ms.DeObstacle.gstObjects[12].nType "" VALUE 0x3c055a __UBYTE_S 0 NO_COMPU_METHOD 0 255 ECU_ADDRESS_EXTENSION 0x80 /end CHARACTERISTIC
/begin CHARACTERISTIC CtApImageProcess_FreeRunning.PpImageProcess_Obstacle_60ms.DeObstacle.gstObjects[12].nAge "" VALUE 0x3c055b __UBYTE_S 0 NO_COMPU_METHOD 0 255 ECU_ADDRESS_EXTENSION 0x80 /end CHARACTERISTIC
/begin CHARACTERISTIC CtApImageProcess_FreeRunning.PpImageProcess_Obstacle_60ms.DeObstacle.gstObjects[12].nQuality "" VALUE 0x3c055c __UBYTE_S 0 NO_COMPU_METHOD 0 255 ECU_ADDRESS_EXTENSION 0x80 /end CHARACTERISTIC
/begin CHARACTERISTIC CtApImageProcess_FreeRunning.PpImageProcess_Obstacle_60ms.DeObstacle.gstObjects[12].fHeight "" VALUE 0x3c0560 __FLOAT32_IEEE_S 0 NO_COMPU_METHOD 0 3.402823e+38 ECU_ADDRESS_EXTENSION 0x80 /end CHARACTERISTIC
/begin CHARACTERISTIC CtApImageProcess_FreeRunning.PpImageProcess_Obstacle_60ms.DeObstacle.gstObjects[12].fPiont1X "" VALUE 0x3c0564 __FLOAT32_IEEE_S 0 NO_COMPU_METHOD 0 3.402823e+38 ECU_ADDRESS_EXTENSION 0x80 /end CHARACTERISTIC
/begin CHARACTERISTIC CtApImageProcess_FreeRunning.PpImageProcess_Obstacle_60ms.DeObstacle.gstObjects[12].fPiont1Y "" VALUE 0x3c0568 __FLOAT32_IEEE_S 0 NO_COMPU_METHOD 0 3.402823e+38 ECU_ADDRESS_EXTENSION 0x80 /end CHARACTERISTIC
/begin CHARACTERISTIC CtApImageProcess_FreeRunning.PpImageProcess_Obstacle_60ms.DeObstacle.gstObjects[12].fPiont2X "" VALUE 0x3c056c __FLOAT32_IEEE_S 0 NO_COMPU_METHOD 0 3.402823e+38 ECU_ADDRESS_EXTENSION 0x80 /end CHARACTERISTIC
/begin CHARACTERISTIC CtApImageProcess_FreeRunning.PpImageProcess_Obstacle_60ms.DeObstacle.gstObjects[12].fPiont2Y "" VALUE 0x3c0570 __FLOAT32_IEEE_S 0 NO_COMPU_METHOD 0 3.402823e+38 ECU_ADDRESS_EXTENSION 0x80 /end CHARACTERISTIC
/begin CHARACTERISTIC CtApImageProcess_FreeRunning.PpImageProcess_Obstacle_60ms.DeObstacle.gstObjects[12].fRelVelocityX "" VALUE 0x3c0574 __FLOAT32_IEEE_S 0 NO_COMPU_METHOD 0 3.402823e+38 ECU_ADDRESS_EXTENSION 0x80 /end CHARACTERISTIC
/begin CHARACTERISTIC CtApImageProcess_FreeRunning.PpImageProcess_Obstacle_60ms.DeObstacle.gstObjects[12].fRelVelocityY "" VALUE 0x3c0578 __FLOAT32_IEEE_S 0 NO_COMPU_METHOD 0 3.402823e+38 ECU_ADDRESS_EXTENSION 0x80 /end CHARACTERISTIC
/begin CHARACTERISTIC CtApImageProcess_FreeRunning.PpImageProcess_Obstacle_60ms.DeObstacle.gstObjects[12].fAblVelocityX "" VALUE 0x3c057c __FLOAT32_IEEE_S 0 NO_COMPU_METHOD 0 3.402823e+38 ECU_ADDRESS_EXTENSION 0x80 /end CHARACTERISTIC
/begin CHARACTERISTIC CtApImageProcess_FreeRunning.PpImageProcess_Obstacle_60ms.DeObstacle.gstObjects[12].fAblVelocityY "" VALUE 0x3c0580 __FLOAT32_IEEE_S 0 NO_COMPU_METHOD 0 3.402823e+38 ECU_ADDRESS_EXTENSION 0x80 /end CHARACTERISTIC
/begin CHARACTERISTIC CtApImageProcess_FreeRunning.PpImageProcess_Obstacle_60ms.DeObstacle.gstObjects[12].fAbsValY "" VALUE 0x3c0584 __FLOAT32_IEEE_S 0 NO_COMPU_METHOD 0 3.402823e+38 ECU_ADDRESS_EXTENSION 0x80 /end CHARACTERISTIC
/begin CHARACTERISTIC CtApImageProcess_FreeRunning.PpImageProcess_Obstacle_60ms.DeObstacle.gstObjects[12].nPoint1OnCar "" VALUE 0x3c0588 __UBYTE_S 0 NO_COMPU_METHOD 0 255 ECU_ADDRESS_EXTENSION 0x80 /end CHARACTERISTIC
/begin CHARACTERISTIC CtApImageProcess_FreeRunning.PpImageProcess_Obstacle_60ms.DeObstacle.gstObjects[12].nPoint2OnCar "" VALUE 0x3c0589 __UBYTE_S 0 NO_COMPU_METHOD 0 255 ECU_ADDRESS_EXTENSION 0x80 /end CHARACTERISTIC
/begin CHARACTERISTIC CtApImageProcess_FreeRunning.PpImageProcess_Obstacle_60ms.DeObstacle.gstObjects[12].fReserved "10 uint32 array" VAL_BLK 0x3c058c __ULONG_S 0 NO_COMPU_METHOD 0 4294967295 ECU_ADDRESS_EXTENSION 0x80 MATRIX_DIM 10 1 1 /end CHARACTERISTIC
/begin CHARACTERISTIC CtApImageProcess_FreeRunning.PpImageProcess_Obstacle_60ms.DeObstacle.gstObjects[12].n3D "" VALUE 0x3c05b4 __UBYTE_S 0 NO_COMPU_METHOD 0 255 ECU_ADDRESS_EXTENSION 0x80 /end CHARACTERISTIC
/begin CHARACTERISTIC CtApImageProcess_FreeRunning.PpImageProcess_Obstacle_60ms.DeObstacle.gstObjects[12].fPoint3X "" VALUE 0x3c05b8 __FLOAT32_IEEE_S 0 NO_COMPU_METHOD 0 3.402823e+38 ECU_ADDRESS_EXTENSION 0x80 /end CHARACTERISTIC
/begin CHARACTERISTIC CtApImageProcess_FreeRunning.PpImageProcess_Obstacle_60ms.DeObstacle.gstObjects[12].fPoint3Y "" VALUE 0x3c05bc __FLOAT32_IEEE_S 0 NO_COMPU_METHOD 0 3.402823e+38 ECU_ADDRESS_EXTENSION 0x80 /end CHARACTERISTIC
/begin CHARACTERISTIC CtApImageProcess_FreeRunning.PpImageProcess_Obstacle_60ms.DeObstacle.gstObjects[12].fPoint4X "" VALUE 0x3c05c0 __FLOAT32_IEEE_S 0 NO_COMPU_METHOD 0 3.402823e+38 ECU_ADDRESS_EXTENSION 0x80 /end CHARACTERISTIC
/begin CHARACTERISTIC CtApImageProcess_FreeRunning.PpImageProcess_Obstacle_60ms.DeObstacle.gstObjects[12].fPoint4Y "" VALUE 0x3c05c4 __FLOAT32_IEEE_S 0 NO_COMPU_METHOD 0 3.402823e+38 ECU_ADDRESS_EXTENSION 0x80 /end CHARACTERISTIC
/begin CHARACTERISTIC CtApImageProcess_FreeRunning.PpImageProcess_Obstacle_60ms.DeObstacle.gstObjects[13].nObjectID "" VALUE 0x3c05c8 __UWORD_S 0 NO_COMPU_METHOD 0 65535 ECU_ADDRESS_EXTENSION 0x80 /end CHARACTERISTIC
/begin CHARACTERISTIC CtApImageProcess_FreeRunning.PpImageProcess_Obstacle_60ms.DeObstacle.gstObjects[13].nType "" VALUE 0x3c05ca __UBYTE_S 0 NO_COMPU_METHOD 0 255 ECU_ADDRESS_EXTENSION 0x80 /end CHARACTERISTIC
/begin CHARACTERISTIC CtApImageProcess_FreeRunning.PpImageProcess_Obstacle_60ms.DeObstacle.gstObjects[13].nAge "" VALUE 0x3c05cb __UBYTE_S 0 NO_COMPU_METHOD 0 255 ECU_ADDRESS_EXTENSION 0x80 /end CHARACTERISTIC
/begin CHARACTERISTIC CtApImageProcess_FreeRunning.PpImageProcess_Obstacle_60ms.DeObstacle.gstObjects[13].nQuality "" VALUE 0x3c05cc __UBYTE_S 0 NO_COMPU_METHOD 0 255 ECU_ADDRESS_EXTENSION 0x80 /end CHARACTERISTIC
/begin CHARACTERISTIC CtApImageProcess_FreeRunning.PpImageProcess_Obstacle_60ms.DeObstacle.gstObjects[13].fHeight "" VALUE 0x3c05d0 __FLOAT32_IEEE_S 0 NO_COMPU_METHOD 0 3.402823e+38 ECU_ADDRESS_EXTENSION 0x80 /end CHARACTERISTIC
/begin CHARACTERISTIC CtApImageProcess_FreeRunning.PpImageProcess_Obstacle_60ms.DeObstacle.gstObjects[13].fPiont1X "" VALUE 0x3c05d4 __FLOAT32_IEEE_S 0 NO_COMPU_METHOD 0 3.402823e+38 ECU_ADDRESS_EXTENSION 0x80 /end CHARACTERISTIC
/begin CHARACTERISTIC CtApImageProcess_FreeRunning.PpImageProcess_Obstacle_60ms.DeObstacle.gstObjects[13].fPiont1Y "" VALUE 0x3c05d8 __FLOAT32_IEEE_S 0 NO_COMPU_METHOD 0 3.402823e+38 ECU_ADDRESS_EXTENSION 0x80 /end CHARACTERISTIC
/begin CHARACTERISTIC CtApImageProcess_FreeRunning.PpImageProcess_Obstacle_60ms.DeObstacle.gstObjects[13].fPiont2X "" VALUE 0x3c05dc __FLOAT32_IEEE_S 0 NO_COMPU_METHOD 0 3.402823e+38 ECU_ADDRESS_EXTENSION 0x80 /end CHARACTERISTIC
/begin CHARACTERISTIC CtApImageProcess_FreeRunning.PpImageProcess_Obstacle_60ms.DeObstacle.gstObjects[13].fPiont2Y "" VALUE 0x3c05e0 __FLOAT32_IEEE_S 0 NO_COMPU_METHOD 0 3.402823e+38 ECU_ADDRESS_EXTENSION 0x80 /end CHARACTERISTIC
/begin CHARACTERISTIC CtApImageProcess_FreeRunning.PpImageProcess_Obstacle_60ms.DeObstacle.gstObjects[13].fRelVelocityX "" VALUE 0x3c05e4 __FLOAT32_IEEE_S 0 NO_COMPU_METHOD 0 3.402823e+38 ECU_ADDRESS_EXTENSION 0x80 /end CHARACTERISTIC
/begin CHARACTERISTIC CtApImageProcess_FreeRunning.PpImageProcess_Obstacle_60ms.DeObstacle.gstObjects[13].fRelVelocityY "" VALUE 0x3c05e8 __FLOAT32_IEEE_S 0 NO_COMPU_METHOD 0 3.402823e+38 ECU_ADDRESS_EXTENSION 0x80 /end CHARACTERISTIC
/begin CHARACTERISTIC CtApImageProcess_FreeRunning.PpImageProcess_Obstacle_60ms.DeObstacle.gstObjects[13].fAblVelocityX "" VALUE 0x3c05ec __FLOAT32_IEEE_S 0 NO_COMPU_METHOD 0 3.402823e+38 ECU_ADDRESS_EXTENSION 0x80 /end CHARACTERISTIC
/begin CHARACTERISTIC CtApImageProcess_FreeRunning.PpImageProcess_Obstacle_60ms.DeObstacle.gstObjects[13].fAblVelocityY "" VALUE 0x3c05f0 __FLOAT32_IEEE_S 0 NO_COMPU_METHOD 0 3.402823e+38 ECU_ADDRESS_EXTENSION 0x80 /end CHARACTERISTIC
/begin CHARACTERISTIC CtApImageProcess_FreeRunning.PpImageProcess_Obstacle_60ms.DeObstacle.gstObjects[13].fAbsValY "" VALUE 0x3c05f4 __FLOAT32_IEEE_S 0 NO_COMPU_METHOD 0 3.402823e+38 ECU_ADDRESS_EXTENSION 0x80 /end CHARACTERISTIC
/begin CHARACTERISTIC CtApImageProcess_FreeRunning.PpImageProcess_Obstacle_60ms.DeObstacle.gstObjects[13].nPoint1OnCar "" VALUE 0x3c05f8 __UBYTE_S 0 NO_COMPU_METHOD 0 255 ECU_ADDRESS_EXTENSION 0x80 /end CHARACTERISTIC
/begin CHARACTERISTIC CtApImageProcess_FreeRunning.PpImageProcess_Obstacle_60ms.DeObstacle.gstObjects[13].nPoint2OnCar "" VALUE 0x3c05f9 __UBYTE_S 0 NO_COMPU_METHOD 0 255 ECU_ADDRESS_EXTENSION 0x80 /end CHARACTERISTIC
/begin CHARACTERISTIC CtApImageProcess_FreeRunning.PpImageProcess_Obstacle_60ms.DeObstacle.gstObjects[13].fReserved "10 uint32 array" VAL_BLK 0x3c05fc __ULONG_S 0 NO_COMPU_METHOD 0 4294967295 ECU_ADDRESS_EXTENSION 0x80 MATRIX_DIM 10 1 1 /end CHARACTERISTIC
/begin CHARACTERISTIC CtApImageProcess_FreeRunning.PpImageProcess_Obstacle_60ms.DeObstacle.gstObjects[13].n3D "" VALUE 0x3c0624 __UBYTE_S 0 NO_COMPU_METHOD 0 255 ECU_ADDRESS_EXTENSION 0x80 /end CHARACTERISTIC
/begin CHARACTERISTIC CtApImageProcess_FreeRunning.PpImageProcess_Obstacle_60ms.DeObstacle.gstObjects[13].fPoint3X "" VALUE 0x3c0628 __FLOAT32_IEEE_S 0 NO_COMPU_METHOD 0 3.402823e+38 ECU_ADDRESS_EXTENSION 0x80 /end CHARACTERISTIC
/begin CHARACTERISTIC CtApImageProcess_FreeRunning.PpImageProcess_Obstacle_60ms.DeObstacle.gstObjects[13].fPoint3Y "" VALUE 0x3c062c __FLOAT32_IEEE_S 0 NO_COMPU_METHOD 0 3.402823e+38 ECU_ADDRESS_EXTENSION 0x80 /end CHARACTERISTIC
/begin CHARACTERISTIC CtApImageProcess_FreeRunning.PpImageProcess_Obstacle_60ms.DeObstacle.gstObjects[13].fPoint4X "" VALUE 0x3c0630 __FLOAT32_IEEE_S 0 NO_COMPU_METHOD 0 3.402823e+38 ECU_ADDRESS_EXTENSION 0x80 /end CHARACTERISTIC
/begin CHARACTERISTIC CtApImageProcess_FreeRunning.PpImageProcess_Obstacle_60ms.DeObstacle.gstObjects[13].fPoint4Y "" VALUE 0x3c0634 __FLOAT32_IEEE_S 0 NO_COMPU_METHOD 0 3.402823e+38 ECU_ADDRESS_EXTENSION 0x80 /end CHARACTERISTIC
/begin CHARACTERISTIC CtApImageProcess_FreeRunning.PpImageProcess_Obstacle_60ms.DeObstacle.gstObjects[14].nObjectID "" VALUE 0x3c0638 __UWORD_S 0 NO_COMPU_METHOD 0 65535 ECU_ADDRESS_EXTENSION 0x80 /end CHARACTERISTIC
/begin CHARACTERISTIC CtApImageProcess_FreeRunning.PpImageProcess_Obstacle_60ms.DeObstacle.gstObjects[14].nType "" VALUE 0x3c063a __UBYTE_S 0 NO_COMPU_METHOD 0 255 ECU_ADDRESS_EXTENSION 0x80 /end CHARACTERISTIC
/begin CHARACTERISTIC CtApImageProcess_FreeRunning.PpImageProcess_Obstacle_60ms.DeObstacle.gstObjects[14].nAge "" VALUE 0x3c063b __UBYTE_S 0 NO_COMPU_METHOD 0 255 ECU_ADDRESS_EXTENSION 0x80 /end CHARACTERISTIC
/begin CHARACTERISTIC CtApImageProcess_FreeRunning.PpImageProcess_Obstacle_60ms.DeObstacle.gstObjects[14].nQuality "" VALUE 0x3c063c __UBYTE_S 0 NO_COMPU_METHOD 0 255 ECU_ADDRESS_EXTENSION 0x80 /end CHARACTERISTIC
/begin CHARACTERISTIC CtApImageProcess_FreeRunning.PpImageProcess_Obstacle_60ms.DeObstacle.gstObjects[14].fHeight "" VALUE 0x3c0640 __FLOAT32_IEEE_S 0 NO_COMPU_METHOD 0 3.402823e+38 ECU_ADDRESS_EXTENSION 0x80 /end CHARACTERISTIC
/begin CHARACTERISTIC CtApImageProcess_FreeRunning.PpImageProcess_Obstacle_60ms.DeObstacle.gstObjects[14].fPiont1X "" VALUE 0x3c0644 __FLOAT32_IEEE_S 0 NO_COMPU_METHOD 0 3.402823e+38 ECU_ADDRESS_EXTENSION 0x80 /end CHARACTERISTIC
/begin CHARACTERISTIC CtApImageProcess_FreeRunning.PpImageProcess_Obstacle_60ms.DeObstacle.gstObjects[14].fPiont1Y "" VALUE 0x3c0648 __FLOAT32_IEEE_S 0 NO_COMPU_METHOD 0 3.402823e+38 ECU_ADDRESS_EXTENSION 0x80 /end CHARACTERISTIC
/begin CHARACTERISTIC CtApImageProcess_FreeRunning.PpImageProcess_Obstacle_60ms.DeObstacle.gstObjects[14].fPiont2X "" VALUE 0x3c064c __FLOAT32_IEEE_S 0 NO_COMPU_METHOD 0 3.402823e+38 ECU_ADDRESS_EXTENSION 0x80 /end CHARACTERISTIC
/begin CHARACTERISTIC CtApImageProcess_FreeRunning.PpImageProcess_Obstacle_60ms.DeObstacle.gstObjects[14].fPiont2Y "" VALUE 0x3c0650 __FLOAT32_IEEE_S 0 NO_COMPU_METHOD 0 3.402823e+38 ECU_ADDRESS_EXTENSION 0x80 /end CHARACTERISTIC
/begin CHARACTERISTIC CtApImageProcess_FreeRunning.PpImageProcess_Obstacle_60ms.DeObstacle.gstObjects[14].fRelVelocityX "" VALUE 0x3c0654 __FLOAT32_IEEE_S 0 NO_COMPU_METHOD 0 3.402823e+38 ECU_ADDRESS_EXTENSION 0x80 /end CHARACTERISTIC
/begin CHARACTERISTIC CtApImageProcess_FreeRunning.PpImageProcess_Obstacle_60ms.DeObstacle.gstObjects[14].fRelVelocityY "" VALUE 0x3c0658 __FLOAT32_IEEE_S 0 NO_COMPU_METHOD 0 3.402823e+38 ECU_ADDRESS_EXTENSION 0x80 /end CHARACTERISTIC
/begin CHARACTERISTIC CtApImageProcess_FreeRunning.PpImageProcess_Obstacle_60ms.DeObstacle.gstObjects[14].fAblVelocityX "" VALUE 0x3c065c __FLOAT32_IEEE_S 0 NO_COMPU_METHOD 0 3.402823e+38 ECU_ADDRESS_EXTENSION 0x80 /end CHARACTERISTIC
/begin CHARACTERISTIC CtApImageProcess_FreeRunning.PpImageProcess_Obstacle_60ms.DeObstacle.gstObjects[14].fAblVelocityY "" VALUE 0x3c0660 __FLOAT32_IEEE_S 0 NO_COMPU_METHOD 0 3.402823e+38 ECU_ADDRESS_EXTENSION 0x80 /end CHARACTERISTIC
/begin CHARACTERISTIC CtApImageProcess_FreeRunning.PpImageProcess_Obstacle_60ms.DeObstacle.gstObjects[14].fAbsValY "" VALUE 0x3c0664 __FLOAT32_IEEE_S 0 NO_COMPU_METHOD 0 3.402823e+38 ECU_ADDRESS_EXTENSION 0x80 /end CHARACTERISTIC
/begin CHARACTERISTIC CtApImageProcess_FreeRunning.PpImageProcess_Obstacle_60ms.DeObstacle.gstObjects[14].nPoint1OnCar "" VALUE 0x3c0668 __UBYTE_S 0 NO_COMPU_METHOD 0 255 ECU_ADDRESS_EXTENSION 0x80 /end CHARACTERISTIC
/begin CHARACTERISTIC CtApImageProcess_FreeRunning.PpImageProcess_Obstacle_60ms.DeObstacle.gstObjects[14].nPoint2OnCar "" VALUE 0x3c0669 __UBYTE_S 0 NO_COMPU_METHOD 0 255 ECU_ADDRESS_EXTENSION 0x80 /end CHARACTERISTIC
/begin CHARACTERISTIC CtApImageProcess_FreeRunning.PpImageProcess_Obstacle_60ms.DeObstacle.gstObjects[14].fReserved "10 uint32 array" VAL_BLK 0x3c066c __ULONG_S 0 NO_COMPU_METHOD 0 4294967295 ECU_ADDRESS_EXTENSION 0x80 MATRIX_DIM 10 1 1 /end CHARACTERISTIC
/begin CHARACTERISTIC CtApImageProcess_FreeRunning.PpImageProcess_Obstacle_60ms.DeObstacle.gstObjects[14].n3D "" VALUE 0x3c0694 __UBYTE_S 0 NO_COMPU_METHOD 0 255 ECU_ADDRESS_EXTENSION 0x80 /end CHARACTERISTIC
/begin CHARACTERISTIC CtApImageProcess_FreeRunning.PpImageProcess_Obstacle_60ms.DeObstacle.gstObjects[14].fPoint3X "" VALUE 0x3c0698 __FLOAT32_IEEE_S 0 NO_COMPU_METHOD 0 3.402823e+38 ECU_ADDRESS_EXTENSION 0x80 /end CHARACTERISTIC
/begin CHARACTERISTIC CtApImageProcess_FreeRunning.PpImageProcess_Obstacle_60ms.DeObstacle.gstObjects[14].fPoint3Y "" VALUE 0x3c069c __FLOAT32_IEEE_S 0 NO_COMPU_METHOD 0 3.402823e+38 ECU_ADDRESS_EXTENSION 0x80 /end CHARACTERISTIC
/begin CHARACTERISTIC CtApImageProcess_FreeRunning.PpImageProcess_Obstacle_60ms.DeObstacle.gstObjects[14].fPoint4X "" VALUE 0x3c06a0 __FLOAT32_IEEE_S 0 NO_COMPU_METHOD 0 3.402823e+38 ECU_ADDRESS_EXTENSION 0x80 /end CHARACTERISTIC
/begin CHARACTERISTIC CtApImageProcess_FreeRunning.PpImageProcess_Obstacle_60ms.DeObstacle.gstObjects[14].fPoint4Y "" VALUE 0x3c06a4 __FLOAT32_IEEE_S 0 NO_COMPU_METHOD 0 3.402823e+38 ECU_ADDRESS_EXTENSION 0x80 /end CHARACTERISTIC
/begin CHARACTERISTIC CtApImageProcess_FreeRunning.PpImageProcess_Obstacle_60ms.DeObstacle.gstObjects[15].nObjectID "" VALUE 0x3c06a8 __UWORD_S 0 NO_COMPU_METHOD 0 65535 ECU_ADDRESS_EXTENSION 0x80 /end CHARACTERISTIC
/begin CHARACTERISTIC CtApImageProcess_FreeRunning.PpImageProcess_Obstacle_60ms.DeObstacle.gstObjects[15].nType "" VALUE 0x3c06aa __UBYTE_S 0 NO_COMPU_METHOD 0 255 ECU_ADDRESS_EXTENSION 0x80 /end CHARACTERISTIC
/begin CHARACTERISTIC CtApImageProcess_FreeRunning.PpImageProcess_Obstacle_60ms.DeObstacle.gstObjects[15].nAge "" VALUE 0x3c06ab __UBYTE_S 0 NO_COMPU_METHOD 0 255 ECU_ADDRESS_EXTENSION 0x80 /end CHARACTERISTIC
/begin CHARACTERISTIC CtApImageProcess_FreeRunning.PpImageProcess_Obstacle_60ms.DeObstacle.gstObjects[15].nQuality "" VALUE 0x3c06ac __UBYTE_S 0 NO_COMPU_METHOD 0 255 ECU_ADDRESS_EXTENSION 0x80 /end CHARACTERISTIC
/begin CHARACTERISTIC CtApImageProcess_FreeRunning.PpImageProcess_Obstacle_60ms.DeObstacle.gstObjects[15].fHeight "" VALUE 0x3c06b0 __FLOAT32_IEEE_S 0 NO_COMPU_METHOD 0 3.402823e+38 ECU_ADDRESS_EXTENSION 0x80 /end CHARACTERISTIC
/begin CHARACTERISTIC CtApImageProcess_FreeRunning.PpImageProcess_Obstacle_60ms.DeObstacle.gstObjects[15].fPiont1X "" VALUE 0x3c06b4 __FLOAT32_IEEE_S 0 NO_COMPU_METHOD 0 3.402823e+38 ECU_ADDRESS_EXTENSION 0x80 /end CHARACTERISTIC
/begin CHARACTERISTIC CtApImageProcess_FreeRunning.PpImageProcess_Obstacle_60ms.DeObstacle.gstObjects[15].fPiont1Y "" VALUE 0x3c06b8 __FLOAT32_IEEE_S 0 NO_COMPU_METHOD 0 3.402823e+38 ECU_ADDRESS_EXTENSION 0x80 /end CHARACTERISTIC
/begin CHARACTERISTIC CtApImageProcess_FreeRunning.PpImageProcess_Obstacle_60ms.DeObstacle.gstObjects[15].fPiont2X "" VALUE 0x3c06bc __FLOAT32_IEEE_S 0 NO_COMPU_METHOD 0 3.402823e+38 ECU_ADDRESS_EXTENSION 0x80 /end CHARACTERISTIC
/begin CHARACTERISTIC CtApImageProcess_FreeRunning.PpImageProcess_Obstacle_60ms.DeObstacle.gstObjects[15].fPiont2Y "" VALUE 0x3c06c0 __FLOAT32_IEEE_S 0 NO_COMPU_METHOD 0 3.402823e+38 ECU_ADDRESS_EXTENSION 0x80 /end CHARACTERISTIC
/begin CHARACTERISTIC CtApImageProcess_FreeRunning.PpImageProcess_Obstacle_60ms.DeObstacle.gstObjects[15].fRelVelocityX "" VALUE 0x3c06c4 __FLOAT32_IEEE_S 0 NO_COMPU_METHOD 0 3.402823e+38 ECU_ADDRESS_EXTENSION 0x80 /end CHARACTERISTIC
/begin CHARACTERISTIC CtApImageProcess_FreeRunning.PpImageProcess_Obstacle_60ms.DeObstacle.gstObjects[15].fRelVelocityY "" VALUE 0x3c06c8 __FLOAT32_IEEE_S 0 NO_COMPU_METHOD 0 3.402823e+38 ECU_ADDRESS_EXTENSION 0x80 /end CHARACTERISTIC
/begin CHARACTERISTIC CtApImageProcess_FreeRunning.PpImageProcess_Obstacle_60ms.DeObstacle.gstObjects[15].fAblVelocityX "" VALUE 0x3c06cc __FLOAT32_IEEE_S 0 NO_COMPU_METHOD 0 3.402823e+38 ECU_ADDRESS_EXTENSION 0x80 /end CHARACTERISTIC
/begin CHARACTERISTIC CtApImageProcess_FreeRunning.PpImageProcess_Obstacle_60ms.DeObstacle.gstObjects[15].fAblVelocityY "" VALUE 0x3c06d0 __FLOAT32_IEEE_S 0 NO_COMPU_METHOD 0 3.402823e+38 ECU_ADDRESS_EXTENSION 0x80 /end CHARACTERISTIC
/begin CHARACTERISTIC CtApImageProcess_FreeRunning.PpImageProcess_Obstacle_60ms.DeObstacle.gstObjects[15].fAbsValY "" VALUE 0x3c06d4 __FLOAT32_IEEE_S 0 NO_COMPU_METHOD 0 3.402823e+38 ECU_ADDRESS_EXTENSION 0x80 /end CHARACTERISTIC
/begin CHARACTERISTIC CtApImageProcess_FreeRunning.PpImageProcess_Obstacle_60ms.DeObstacle.gstObjects[15].nPoint1OnCar "" VALUE 0x3c06d8 __UBYTE_S 0 NO_COMPU_METHOD 0 255 ECU_ADDRESS_EXTENSION 0x80 /end CHARACTERISTIC
/begin CHARACTERISTIC CtApImageProcess_FreeRunning.PpImageProcess_Obstacle_60ms.DeObstacle.gstObjects[15].nPoint2OnCar "" VALUE 0x3c06d9 __UBYTE_S 0 NO_COMPU_METHOD 0 255 ECU_ADDRESS_EXTENSION 0x80 /end CHARACTERISTIC
/begin CHARACTERISTIC CtApImageProcess_FreeRunning.PpImageProcess_Obstacle_60ms.DeObstacle.gstObjects[15].fReserved "10 uint32 array" VAL_BLK 0x3c06dc __ULONG_S 0 NO_COMPU_METHOD 0 4294967295 ECU_ADDRESS_EXTENSION 0x80 MATRIX_DIM 10 1 1 /end CHARACTERISTIC
/begin CHARACTERISTIC CtApImageProcess_FreeRunning.PpImageProcess_Obstacle_60ms.DeObstacle.gstObjects[15].n3D "" VALUE 0x3c0704 __UBYTE_S 0 NO_COMPU_METHOD 0 255 ECU_ADDRESS_EXTENSION 0x80 /end CHARACTERISTIC
/begin CHARACTERISTIC CtApImageProcess_FreeRunning.PpImageProcess_Obstacle_60ms.DeObstacle.gstObjects[15].fPoint3X "" VALUE 0x3c0708 __FLOAT32_IEEE_S 0 NO_COMPU_METHOD 0 3.402823e+38 ECU_ADDRESS_EXTENSION 0x80 /end CHARACTERISTIC
/begin CHARACTERISTIC CtApImageProcess_FreeRunning.PpImageProcess_Obstacle_60ms.DeObstacle.gstObjects[15].fPoint3Y "" VALUE 0x3c070c __FLOAT32_IEEE_S 0 NO_COMPU_METHOD 0 3.402823e+38 ECU_ADDRESS_EXTENSION 0x80 /end CHARACTERISTIC
/begin CHARACTERISTIC CtApImageProcess_FreeRunning.PpImageProcess_Obstacle_60ms.DeObstacle.gstObjects[15].fPoint4X "" VALUE 0x3c0710 __FLOAT32_IEEE_S 0 NO_COMPU_METHOD 0 3.402823e+38 ECU_ADDRESS_EXTENSION 0x80 /end CHARACTERISTIC
/begin CHARACTERISTIC CtApImageProcess_FreeRunning.PpImageProcess_Obstacle_60ms.DeObstacle.gstObjects[15].fPoint4Y "" VALUE 0x3c0714 __FLOAT32_IEEE_S 0 NO_COMPU_METHOD 0 3.402823e+38 ECU_ADDRESS_EXTENSION 0x80 /end CHARACTERISTIC
/begin CHARACTERISTIC CtApImageProcess_FreeRunning.PpImageProcess_Obstacle_60ms.DeObstacle.gstObjects[16].nObjectID "" VALUE 0x3c0718 __UWORD_S 0 NO_COMPU_METHOD 0 65535 ECU_ADDRESS_EXTENSION 0x80 /end CHARACTERISTIC
/begin CHARACTERISTIC CtApImageProcess_FreeRunning.PpImageProcess_Obstacle_60ms.DeObstacle.gstObjects[16].nType "" VALUE 0x3c071a __UBYTE_S 0 NO_COMPU_METHOD 0 255 ECU_ADDRESS_EXTENSION 0x80 /end CHARACTERISTIC
/begin CHARACTERISTIC CtApImageProcess_FreeRunning.PpImageProcess_Obstacle_60ms.DeObstacle.gstObjects[16].nAge "" VALUE 0x3c071b __UBYTE_S 0 NO_COMPU_METHOD 0 255 ECU_ADDRESS_EXTENSION 0x80 /end CHARACTERISTIC
/begin CHARACTERISTIC CtApImageProcess_FreeRunning.PpImageProcess_Obstacle_60ms.DeObstacle.gstObjects[16].nQuality "" VALUE 0x3c071c __UBYTE_S 0 NO_COMPU_METHOD 0 255 ECU_ADDRESS_EXTENSION 0x80 /end CHARACTERISTIC
/begin CHARACTERISTIC CtApImageProcess_FreeRunning.PpImageProcess_Obstacle_60ms.DeObstacle.gstObjects[16].fHeight "" VALUE 0x3c0720 __FLOAT32_IEEE_S 0 NO_COMPU_METHOD 0 3.402823e+38 ECU_ADDRESS_EXTENSION 0x80 /end CHARACTERISTIC
/begin CHARACTERISTIC CtApImageProcess_FreeRunning.PpImageProcess_Obstacle_60ms.DeObstacle.gstObjects[16].fPiont1X "" VALUE 0x3c0724 __FLOAT32_IEEE_S 0 NO_COMPU_METHOD 0 3.402823e+38 ECU_ADDRESS_EXTENSION 0x80 /end CHARACTERISTIC
/begin CHARACTERISTIC CtApImageProcess_FreeRunning.PpImageProcess_Obstacle_60ms.DeObstacle.gstObjects[16].fPiont1Y "" VALUE 0x3c0728 __FLOAT32_IEEE_S 0 NO_COMPU_METHOD 0 3.402823e+38 ECU_ADDRESS_EXTENSION 0x80 /end CHARACTERISTIC
/begin CHARACTERISTIC CtApImageProcess_FreeRunning.PpImageProcess_Obstacle_60ms.DeObstacle.gstObjects[16].fPiont2X "" VALUE 0x3c072c __FLOAT32_IEEE_S 0 NO_COMPU_METHOD 0 3.402823e+38 ECU_ADDRESS_EXTENSION 0x80 /end CHARACTERISTIC
/begin CHARACTERISTIC CtApImageProcess_FreeRunning.PpImageProcess_Obstacle_60ms.DeObstacle.gstObjects[16].fPiont2Y "" VALUE 0x3c0730 __FLOAT32_IEEE_S 0 NO_COMPU_METHOD 0 3.402823e+38 ECU_ADDRESS_EXTENSION 0x80 /end CHARACTERISTIC
/begin CHARACTERISTIC CtApImageProcess_FreeRunning.PpImageProcess_Obstacle_60ms.DeObstacle.gstObjects[16].fRelVelocityX "" VALUE 0x3c0734 __FLOAT32_IEEE_S 0 NO_COMPU_METHOD 0 3.402823e+38 ECU_ADDRESS_EXTENSION 0x80 /end CHARACTERISTIC
/begin CHARACTERISTIC CtApImageProcess_FreeRunning.PpImageProcess_Obstacle_60ms.DeObstacle.gstObjects[16].fRelVelocityY "" VALUE 0x3c0738 __FLOAT32_IEEE_S 0 NO_COMPU_METHOD 0 3.402823e+38 ECU_ADDRESS_EXTENSION 0x80 /end CHARACTERISTIC
/begin CHARACTERISTIC CtApImageProcess_FreeRunning.PpImageProcess_Obstacle_60ms.DeObstacle.gstObjects[16].fAblVelocityX "" VALUE 0x3c073c __FLOAT32_IEEE_S 0 NO_COMPU_METHOD 0 3.402823e+38 ECU_ADDRESS_EXTENSION 0x80 /end CHARACTERISTIC
/begin CHARACTERISTIC CtApImageProcess_FreeRunning.PpImageProcess_Obstacle_60ms.DeObstacle.gstObjects[16].fAblVelocityY "" VALUE 0x3c0740 __FLOAT32_IEEE_S 0 NO_COMPU_METHOD 0 3.402823e+38 ECU_ADDRESS_EXTENSION 0x80 /end CHARACTERISTIC
/begin CHARACTERISTIC CtApImageProcess_FreeRunning.PpImageProcess_Obstacle_60ms.DeObstacle.gstObjects[16].fAbsValY "" VALUE 0x3c0744 __FLOAT32_IEEE_S 0 NO_COMPU_METHOD 0 3.402823e+38 ECU_ADDRESS_EXTENSION 0x80 /end CHARACTERISTIC
/begin CHARACTERISTIC CtApImageProcess_FreeRunning.PpImageProcess_Obstacle_60ms.DeObstacle.gstObjects[16].nPoint1OnCar "" VALUE 0x3c0748 __UBYTE_S 0 NO_COMPU_METHOD 0 255 ECU_ADDRESS_EXTENSION 0x80 /end CHARACTERISTIC
/begin CHARACTERISTIC CtApImageProcess_FreeRunning.PpImageProcess_Obstacle_60ms.DeObstacle.gstObjects[16].nPoint2OnCar "" VALUE 0x3c0749 __UBYTE_S 0 NO_COMPU_METHOD 0 255 ECU_ADDRESS_EXTENSION 0x80 /end CHARACTERISTIC
/begin CHARACTERISTIC CtApImageProcess_FreeRunning.PpImageProcess_Obstacle_60ms.DeObstacle.gstObjects[16].fReserved "10 uint32 array" VAL_BLK 0x3c074c __ULONG_S 0 NO_COMPU_METHOD 0 4294967295 ECU_ADDRESS_EXTENSION 0x80 MATRIX_DIM 10 1 1 /end CHARACTERISTIC
/begin CHARACTERISTIC CtApImageProcess_FreeRunning.PpImageProcess_Obstacle_60ms.DeObstacle.gstObjects[16].n3D "" VALUE 0x3c0774 __UBYTE_S 0 NO_COMPU_METHOD 0 255 ECU_ADDRESS_EXTENSION 0x80 /end CHARACTERISTIC
/begin CHARACTERISTIC CtApImageProcess_FreeRunning.PpImageProcess_Obstacle_60ms.DeObstacle.gstObjects[16].fPoint3X "" VALUE 0x3c0778 __FLOAT32_IEEE_S 0 NO_COMPU_METHOD 0 3.402823e+38 ECU_ADDRESS_EXTENSION 0x80 /end CHARACTERISTIC
/begin CHARACTERISTIC CtApImageProcess_FreeRunning.PpImageProcess_Obstacle_60ms.DeObstacle.gstObjects[16].fPoint3Y "" VALUE 0x3c077c __FLOAT32_IEEE_S 0 NO_COMPU_METHOD 0 3.402823e+38 ECU_ADDRESS_EXTENSION 0x80 /end CHARACTERISTIC
/begin CHARACTERISTIC CtApImageProcess_FreeRunning.PpImageProcess_Obstacle_60ms.DeObstacle.gstObjects[16].fPoint4X "" VALUE 0x3c0780 __FLOAT32_IEEE_S 0 NO_COMPU_METHOD 0 3.402823e+38 ECU_ADDRESS_EXTENSION 0x80 /end CHARACTERISTIC
/begin CHARACTERISTIC CtApImageProcess_FreeRunning.PpImageProcess_Obstacle_60ms.DeObstacle.gstObjects[16].fPoint4Y "" VALUE 0x3c0784 __FLOAT32_IEEE_S 0 NO_COMPU_METHOD 0 3.402823e+38 ECU_ADDRESS_EXTENSION 0x80 /end CHARACTERISTIC
/begin CHARACTERISTIC CtApImageProcess_FreeRunning.PpImageProcess_Obstacle_60ms.DeObstacle.gstObjects[17].nObjectID "" VALUE 0x3c0788 __UWORD_S 0 NO_COMPU_METHOD 0 65535 ECU_ADDRESS_EXTENSION 0x80 /end CHARACTERISTIC
/begin CHARACTERISTIC CtApImageProcess_FreeRunning.PpImageProcess_Obstacle_60ms.DeObstacle.gstObjects[17].nType "" VALUE 0x3c078a __UBYTE_S 0 NO_COMPU_METHOD 0 255 ECU_ADDRESS_EXTENSION 0x80 /end CHARACTERISTIC
/begin CHARACTERISTIC CtApImageProcess_FreeRunning.PpImageProcess_Obstacle_60ms.DeObstacle.gstObjects[17].nAge "" VALUE 0x3c078b __UBYTE_S 0 NO_COMPU_METHOD 0 255 ECU_ADDRESS_EXTENSION 0x80 /end CHARACTERISTIC
/begin CHARACTERISTIC CtApImageProcess_FreeRunning.PpImageProcess_Obstacle_60ms.DeObstacle.gstObjects[17].nQuality "" VALUE 0x3c078c __UBYTE_S 0 NO_COMPU_METHOD 0 255 ECU_ADDRESS_EXTENSION 0x80 /end CHARACTERISTIC
/begin CHARACTERISTIC CtApImageProcess_FreeRunning.PpImageProcess_Obstacle_60ms.DeObstacle.gstObjects[17].fHeight "" VALUE 0x3c0790 __FLOAT32_IEEE_S 0 NO_COMPU_METHOD 0 3.402823e+38 ECU_ADDRESS_EXTENSION 0x80 /end CHARACTERISTIC
/begin CHARACTERISTIC CtApImageProcess_FreeRunning.PpImageProcess_Obstacle_60ms.DeObstacle.gstObjects[17].fPiont1X "" VALUE 0x3c0794 __FLOAT32_IEEE_S 0 NO_COMPU_METHOD 0 3.402823e+38 ECU_ADDRESS_EXTENSION 0x80 /end CHARACTERISTIC
/begin CHARACTERISTIC CtApImageProcess_FreeRunning.PpImageProcess_Obstacle_60ms.DeObstacle.gstObjects[17].fPiont1Y "" VALUE 0x3c0798 __FLOAT32_IEEE_S 0 NO_COMPU_METHOD 0 3.402823e+38 ECU_ADDRESS_EXTENSION 0x80 /end CHARACTERISTIC
/begin CHARACTERISTIC CtApImageProcess_FreeRunning.PpImageProcess_Obstacle_60ms.DeObstacle.gstObjects[17].fPiont2X "" VALUE 0x3c079c __FLOAT32_IEEE_S 0 NO_COMPU_METHOD 0 3.402823e+38 ECU_ADDRESS_EXTENSION 0x80 /end CHARACTERISTIC
/begin CHARACTERISTIC CtApImageProcess_FreeRunning.PpImageProcess_Obstacle_60ms.DeObstacle.gstObjects[17].fPiont2Y "" VALUE 0x3c07a0 __FLOAT32_IEEE_S 0 NO_COMPU_METHOD 0 3.402823e+38 ECU_ADDRESS_EXTENSION 0x80 /end CHARACTERISTIC
/begin CHARACTERISTIC CtApImageProcess_FreeRunning.PpImageProcess_Obstacle_60ms.DeObstacle.gstObjects[17].fRelVelocityX "" VALUE 0x3c07a4 __FLOAT32_IEEE_S 0 NO_COMPU_METHOD 0 3.402823e+38 ECU_ADDRESS_EXTENSION 0x80 /end CHARACTERISTIC
/begin CHARACTERISTIC CtApImageProcess_FreeRunning.PpImageProcess_Obstacle_60ms.DeObstacle.gstObjects[17].fRelVelocityY "" VALUE 0x3c07a8 __FLOAT32_IEEE_S 0 NO_COMPU_METHOD 0 3.402823e+38 ECU_ADDRESS_EXTENSION 0x80 /end CHARACTERISTIC
/begin CHARACTERISTIC CtApImageProcess_FreeRunning.PpImageProcess_Obstacle_60ms.DeObstacle.gstObjects[17].fAblVelocityX "" VALUE 0x3c07ac __FLOAT32_IEEE_S 0 NO_COMPU_METHOD 0 3.402823e+38 ECU_ADDRESS_EXTENSION 0x80 /end CHARACTERISTIC
/begin CHARACTERISTIC CtApImageProcess_FreeRunning.PpImageProcess_Obstacle_60ms.DeObstacle.gstObjects[17].fAblVelocityY "" VALUE 0x3c07b0 __FLOAT32_IEEE_S 0 NO_COMPU_METHOD 0 3.402823e+38 ECU_ADDRESS_EXTENSION 0x80 /end CHARACTERISTIC
/begin CHARACTERISTIC CtApImageProcess_FreeRunning.PpImageProcess_Obstacle_60ms.DeObstacle.gstObjects[17].fAbsValY "" VALUE 0x3c07b4 __FLOAT32_IEEE_S 0 NO_COMPU_METHOD 0 3.402823e+38 ECU_ADDRESS_EXTENSION 0x80 /end CHARACTERISTIC
/begin CHARACTERISTIC CtApImageProcess_FreeRunning.PpImageProcess_Obstacle_60ms.DeObstacle.gstObjects[17].nPoint1OnCar "" VALUE 0x3c07b8 __UBYTE_S 0 NO_COMPU_METHOD 0 255 ECU_ADDRESS_EXTENSION 0x80 /end CHARACTERISTIC
/begin CHARACTERISTIC CtApImageProcess_FreeRunning.PpImageProcess_Obstacle_60ms.DeObstacle.gstObjects[17].nPoint2OnCar "" VALUE 0x3c07b9 __UBYTE_S 0 NO_COMPU_METHOD 0 255 ECU_ADDRESS_EXTENSION 0x80 /end CHARACTERISTIC
/begin CHARACTERISTIC CtApImageProcess_FreeRunning.PpImageProcess_Obstacle_60ms.DeObstacle.gstObjects[17].fReserved "10 uint32 array" VAL_BLK 0x3c07bc __ULONG_S 0 NO_COMPU_METHOD 0 4294967295 ECU_ADDRESS_EXTENSION 0x80 MATRIX_DIM 10 1 1 /end CHARACTERISTIC
/begin CHARACTERISTIC CtApImageProcess_FreeRunning.PpImageProcess_Obstacle_60ms.DeObstacle.gstObjects[17].n3D "" VALUE 0x3c07e4 __UBYTE_S 0 NO_COMPU_METHOD 0 255 ECU_ADDRESS_EXTENSION 0x80 /end CHARACTERISTIC
/begin CHARACTERISTIC CtApImageProcess_FreeRunning.PpImageProcess_Obstacle_60ms.DeObstacle.gstObjects[17].fPoint3X "" VALUE 0x3c07e8 __FLOAT32_IEEE_S 0 NO_COMPU_METHOD 0 3.402823e+38 ECU_ADDRESS_EXTENSION 0x80 /end CHARACTERISTIC
/begin CHARACTERISTIC CtApImageProcess_FreeRunning.PpImageProcess_Obstacle_60ms.DeObstacle.gstObjects[17].fPoint3Y "" VALUE 0x3c07ec __FLOAT32_IEEE_S 0 NO_COMPU_METHOD 0 3.402823e+38 ECU_ADDRESS_EXTENSION 0x80 /end CHARACTERISTIC
/begin CHARACTERISTIC CtApImageProcess_FreeRunning.PpImageProcess_Obstacle_60ms.DeObstacle.gstObjects[17].fPoint4X "" VALUE 0x3c07f0 __FLOAT32_IEEE_S 0 NO_COMPU_METHOD 0 3.402823e+38 ECU_ADDRESS_EXTENSION 0x80 /end CHARACTERISTIC
/begin CHARACTERISTIC CtApImageProcess_FreeRunning.PpImageProcess_Obstacle_60ms.DeObstacle.gstObjects[17].fPoint4Y "" VALUE 0x3c07f4 __FLOAT32_IEEE_S 0 NO_COMPU_METHOD 0 3.402823e+38 ECU_ADDRESS_EXTENSION 0x80 /end CHARACTERISTIC
/begin CHARACTERISTIC CtApImageProcess_FreeRunning.PpImageProcess_Obstacle_60ms.DeObstacle.gstObjects[18].nObjectID "" VALUE 0x3c07f8 __UWORD_S 0 NO_COMPU_METHOD 0 65535 ECU_ADDRESS_EXTENSION 0x80 /end CHARACTERISTIC
/begin CHARACTERISTIC CtApImageProcess_FreeRunning.PpImageProcess_Obstacle_60ms.DeObstacle.gstObjects[18].nType "" VALUE 0x3c07fa __UBYTE_S 0 NO_COMPU_METHOD 0 255 ECU_ADDRESS_EXTENSION 0x80 /end CHARACTERISTIC
/begin CHARACTERISTIC CtApImageProcess_FreeRunning.PpImageProcess_Obstacle_60ms.DeObstacle.gstObjects[18].nAge "" VALUE 0x3c07fb __UBYTE_S 0 NO_COMPU_METHOD 0 255 ECU_ADDRESS_EXTENSION 0x80 /end CHARACTERISTIC
/begin CHARACTERISTIC CtApImageProcess_FreeRunning.PpImageProcess_Obstacle_60ms.DeObstacle.gstObjects[18].nQuality "" VALUE 0x3c07fc __UBYTE_S 0 NO_COMPU_METHOD 0 255 ECU_ADDRESS_EXTENSION 0x80 /end CHARACTERISTIC
/begin CHARACTERISTIC CtApImageProcess_FreeRunning.PpImageProcess_Obstacle_60ms.DeObstacle.gstObjects[18].fHeight "" VALUE 0x3c0800 __FLOAT32_IEEE_S 0 NO_COMPU_METHOD 0 3.402823e+38 ECU_ADDRESS_EXTENSION 0x80 /end CHARACTERISTIC
/begin CHARACTERISTIC CtApImageProcess_FreeRunning.PpImageProcess_Obstacle_60ms.DeObstacle.gstObjects[18].fPiont1X "" VALUE 0x3c0804 __FLOAT32_IEEE_S 0 NO_COMPU_METHOD 0 3.402823e+38 ECU_ADDRESS_EXTENSION 0x80 /end CHARACTERISTIC
/begin CHARACTERISTIC CtApImageProcess_FreeRunning.PpImageProcess_Obstacle_60ms.DeObstacle.gstObjects[18].fPiont1Y "" VALUE 0x3c0808 __FLOAT32_IEEE_S 0 NO_COMPU_METHOD 0 3.402823e+38 ECU_ADDRESS_EXTENSION 0x80 /end CHARACTERISTIC
/begin CHARACTERISTIC CtApImageProcess_FreeRunning.PpImageProcess_Obstacle_60ms.DeObstacle.gstObjects[18].fPiont2X "" VALUE 0x3c080c __FLOAT32_IEEE_S 0 NO_COMPU_METHOD 0 3.402823e+38 ECU_ADDRESS_EXTENSION 0x80 /end CHARACTERISTIC
/begin CHARACTERISTIC CtApImageProcess_FreeRunning.PpImageProcess_Obstacle_60ms.DeObstacle.gstObjects[18].fPiont2Y "" VALUE 0x3c0810 __FLOAT32_IEEE_S 0 NO_COMPU_METHOD 0 3.402823e+38 ECU_ADDRESS_EXTENSION 0x80 /end CHARACTERISTIC
/begin CHARACTERISTIC CtApImageProcess_FreeRunning.PpImageProcess_Obstacle_60ms.DeObstacle.gstObjects[18].fRelVelocityX "" VALUE 0x3c0814 __FLOAT32_IEEE_S 0 NO_COMPU_METHOD 0 3.402823e+38 ECU_ADDRESS_EXTENSION 0x80 /end CHARACTERISTIC
/begin CHARACTERISTIC CtApImageProcess_FreeRunning.PpImageProcess_Obstacle_60ms.DeObstacle.gstObjects[18].fRelVelocityY "" VALUE 0x3c0818 __FLOAT32_IEEE_S 0 NO_COMPU_METHOD 0 3.402823e+38 ECU_ADDRESS_EXTENSION 0x80 /end CHARACTERISTIC
/begin CHARACTERISTIC CtApImageProcess_FreeRunning.PpImageProcess_Obstacle_60ms.DeObstacle.gstObjects[18].fAblVelocityX "" VALUE 0x3c081c __FLOAT32_IEEE_S 0 NO_COMPU_METHOD 0 3.402823e+38 ECU_ADDRESS_EXTENSION 0x80 /end CHARACTERISTIC
/begin CHARACTERISTIC CtApImageProcess_FreeRunning.PpImageProcess_Obstacle_60ms.DeObstacle.gstObjects[18].fAblVelocityY "" VALUE 0x3c0820 __FLOAT32_IEEE_S 0 NO_COMPU_METHOD 0 3.402823e+38 ECU_ADDRESS_EXTENSION 0x80 /end CHARACTERISTIC
/begin CHARACTERISTIC CtApImageProcess_FreeRunning.PpImageProcess_Obstacle_60ms.DeObstacle.gstObjects[18].fAbsValY "" VALUE 0x3c0824 __FLOAT32_IEEE_S 0 NO_COMPU_METHOD 0 3.402823e+38 ECU_ADDRESS_EXTENSION 0x80 /end CHARACTERISTIC
/begin CHARACTERISTIC CtApImageProcess_FreeRunning.PpImageProcess_Obstacle_60ms.DeObstacle.gstObjects[18].nPoint1OnCar "" VALUE 0x3c0828 __UBYTE_S 0 NO_COMPU_METHOD 0 255 ECU_ADDRESS_EXTENSION 0x80 /end CHARACTERISTIC
/begin CHARACTERISTIC CtApImageProcess_FreeRunning.PpImageProcess_Obstacle_60ms.DeObstacle.gstObjects[18].nPoint2OnCar "" VALUE 0x3c0829 __UBYTE_S 0 NO_COMPU_METHOD 0 255 ECU_ADDRESS_EXTENSION 0x80 /end CHARACTERISTIC
/begin CHARACTERISTIC CtApImageProcess_FreeRunning.PpImageProcess_Obstacle_60ms.DeObstacle.gstObjects[18].fReserved "10 uint32 array" VAL_BLK 0x3c082c __ULONG_S 0 NO_COMPU_METHOD 0 4294967295 ECU_ADDRESS_EXTENSION 0x80 MATRIX_DIM 10 1 1 /end CHARACTERISTIC
/begin CHARACTERISTIC CtApImageProcess_FreeRunning.PpImageProcess_Obstacle_60ms.DeObstacle.gstObjects[18].n3D "" VALUE 0x3c0854 __UBYTE_S 0 NO_COMPU_METHOD 0 255 ECU_ADDRESS_EXTENSION 0x80 /end CHARACTERISTIC
/begin CHARACTERISTIC CtApImageProcess_FreeRunning.PpImageProcess_Obstacle_60ms.DeObstacle.gstObjects[18].fPoint3X "" VALUE 0x3c0858 __FLOAT32_IEEE_S 0 NO_COMPU_METHOD 0 3.402823e+38 ECU_ADDRESS_EXTENSION 0x80 /end CHARACTERISTIC
/begin CHARACTERISTIC CtApImageProcess_FreeRunning.PpImageProcess_Obstacle_60ms.DeObstacle.gstObjects[18].fPoint3Y "" VALUE 0x3c085c __FLOAT32_IEEE_S 0 NO_COMPU_METHOD 0 3.402823e+38 ECU_ADDRESS_EXTENSION 0x80 /end CHARACTERISTIC
/begin CHARACTERISTIC CtApImageProcess_FreeRunning.PpImageProcess_Obstacle_60ms.DeObstacle.gstObjects[18].fPoint4X "" VALUE 0x3c0860 __FLOAT32_IEEE_S 0 NO_COMPU_METHOD 0 3.402823e+38 ECU_ADDRESS_EXTENSION 0x80 /end CHARACTERISTIC
/begin CHARACTERISTIC CtApImageProcess_FreeRunning.PpImageProcess_Obstacle_60ms.DeObstacle.gstObjects[18].fPoint4Y "" VALUE 0x3c0864 __FLOAT32_IEEE_S 0 NO_COMPU_METHOD 0 3.402823e+38 ECU_ADDRESS_EXTENSION 0x80 /end CHARACTERISTIC
/begin CHARACTERISTIC CtApImageProcess_FreeRunning.PpImageProcess_Obstacle_60ms.DeObstacle.gstObjects[19].nObjectID "" VALUE 0x3c0868 __UWORD_S 0 NO_COMPU_METHOD 0 65535 ECU_ADDRESS_EXTENSION 0x80 /end CHARACTERISTIC
/begin CHARACTERISTIC CtApImageProcess_FreeRunning.PpImageProcess_Obstacle_60ms.DeObstacle.gstObjects[19].nType "" VALUE 0x3c086a __UBYTE_S 0 NO_COMPU_METHOD 0 255 ECU_ADDRESS_EXTENSION 0x80 /end CHARACTERISTIC
/begin CHARACTERISTIC CtApImageProcess_FreeRunning.PpImageProcess_Obstacle_60ms.DeObstacle.gstObjects[19].nAge "" VALUE 0x3c086b __UBYTE_S 0 NO_COMPU_METHOD 0 255 ECU_ADDRESS_EXTENSION 0x80 /end CHARACTERISTIC
/begin CHARACTERISTIC CtApImageProcess_FreeRunning.PpImageProcess_Obstacle_60ms.DeObstacle.gstObjects[19].nQuality "" VALUE 0x3c086c __UBYTE_S 0 NO_COMPU_METHOD 0 255 ECU_ADDRESS_EXTENSION 0x80 /end CHARACTERISTIC
/begin CHARACTERISTIC CtApImageProcess_FreeRunning.PpImageProcess_Obstacle_60ms.DeObstacle.gstObjects[19].fHeight "" VALUE 0x3c0870 __FLOAT32_IEEE_S 0 NO_COMPU_METHOD 0 3.402823e+38 ECU_ADDRESS_EXTENSION 0x80 /end CHARACTERISTIC
/begin CHARACTERISTIC CtApImageProcess_FreeRunning.PpImageProcess_Obstacle_60ms.DeObstacle.gstObjects[19].fPiont1X "" VALUE 0x3c0874 __FLOAT32_IEEE_S 0 NO_COMPU_METHOD 0 3.402823e+38 ECU_ADDRESS_EXTENSION 0x80 /end CHARACTERISTIC
/begin CHARACTERISTIC CtApImageProcess_FreeRunning.PpImageProcess_Obstacle_60ms.DeObstacle.gstObjects[19].fPiont1Y "" VALUE 0x3c0878 __FLOAT32_IEEE_S 0 NO_COMPU_METHOD 0 3.402823e+38 ECU_ADDRESS_EXTENSION 0x80 /end CHARACTERISTIC
/begin CHARACTERISTIC CtApImageProcess_FreeRunning.PpImageProcess_Obstacle_60ms.DeObstacle.gstObjects[19].fPiont2X "" VALUE 0x3c087c __FLOAT32_IEEE_S 0 NO_COMPU_METHOD 0 3.402823e+38 ECU_ADDRESS_EXTENSION 0x80 /end CHARACTERISTIC
/begin CHARACTERISTIC CtApImageProcess_FreeRunning.PpImageProcess_Obstacle_60ms.DeObstacle.gstObjects[19].fPiont2Y "" VALUE 0x3c0880 __FLOAT32_IEEE_S 0 NO_COMPU_METHOD 0 3.402823e+38 ECU_ADDRESS_EXTENSION 0x80 /end CHARACTERISTIC
/begin CHARACTERISTIC CtApImageProcess_FreeRunning.PpImageProcess_Obstacle_60ms.DeObstacle.gstObjects[19].fRelVelocityX "" VALUE 0x3c0884 __FLOAT32_IEEE_S 0 NO_COMPU_METHOD 0 3.402823e+38 ECU_ADDRESS_EXTENSION 0x80 /end CHARACTERISTIC
/begin CHARACTERISTIC CtApImageProcess_FreeRunning.PpImageProcess_Obstacle_60ms.DeObstacle.gstObjects[19].fRelVelocityY "" VALUE 0x3c0888 __FLOAT32_IEEE_S 0 NO_COMPU_METHOD 0 3.402823e+38 ECU_ADDRESS_EXTENSION 0x80 /end CHARACTERISTIC
/begin CHARACTERISTIC CtApImageProcess_FreeRunning.PpImageProcess_Obstacle_60ms.DeObstacle.gstObjects[19].fAblVelocityX "" VALUE 0x3c088c __FLOAT32_IEEE_S 0 NO_COMPU_METHOD 0 3.402823e+38 ECU_ADDRESS_EXTENSION 0x80 /end CHARACTERISTIC
/begin CHARACTERISTIC CtApImageProcess_FreeRunning.PpImageProcess_Obstacle_60ms.DeObstacle.gstObjects[19].fAblVelocityY "" VALUE 0x3c0890 __FLOAT32_IEEE_S 0 NO_COMPU_METHOD 0 3.402823e+38 ECU_ADDRESS_EXTENSION 0x80 /end CHARACTERISTIC
/begin CHARACTERISTIC CtApImageProcess_FreeRunning.PpImageProcess_Obstacle_60ms.DeObstacle.gstObjects[19].fAbsValY "" VALUE 0x3c0894 __FLOAT32_IEEE_S 0 NO_COMPU_METHOD 0 3.402823e+38 ECU_ADDRESS_EXTENSION 0x80 /end CHARACTERISTIC
/begin CHARACTERISTIC CtApImageProcess_FreeRunning.PpImageProcess_Obstacle_60ms.DeObstacle.gstObjects[19].nPoint1OnCar "" VALUE 0x3c0898 __UBYTE_S 0 NO_COMPU_METHOD 0 255 ECU_ADDRESS_EXTENSION 0x80 /end CHARACTERISTIC
/begin CHARACTERISTIC CtApImageProcess_FreeRunning.PpImageProcess_Obstacle_60ms.DeObstacle.gstObjects[19].nPoint2OnCar "" VALUE 0x3c0899 __UBYTE_S 0 NO_COMPU_METHOD 0 255 ECU_ADDRESS_EXTENSION 0x80 /end CHARACTERISTIC
/begin CHARACTERISTIC CtApImageProcess_FreeRunning.PpImageProcess_Obstacle_60ms.DeObstacle.gstObjects[19].fReserved "10 uint32 array" VAL_BLK 0x3c089c __ULONG_S 0 NO_COMPU_METHOD 0 4294967295 ECU_ADDRESS_EXTENSION 0x80 MATRIX_DIM 10 1 1 /end CHARACTERISTIC
/begin CHARACTERISTIC CtApImageProcess_FreeRunning.PpImageProcess_Obstacle_60ms.DeObstacle.gstObjects[19].n3D "" VALUE 0x3c08c4 __UBYTE_S 0 NO_COMPU_METHOD 0 255 ECU_ADDRESS_EXTENSION 0x80 /end CHARACTERISTIC
/begin CHARACTERISTIC CtApImageProcess_FreeRunning.PpImageProcess_Obstacle_60ms.DeObstacle.gstObjects[19].fPoint3X "" VALUE 0x3c08c8 __FLOAT32_IEEE_S 0 NO_COMPU_METHOD 0 3.402823e+38 ECU_ADDRESS_EXTENSION 0x80 /end CHARACTERISTIC
/begin CHARACTERISTIC CtApImageProcess_FreeRunning.PpImageProcess_Obstacle_60ms.DeObstacle.gstObjects[19].fPoint3Y "" VALUE 0x3c08cc __FLOAT32_IEEE_S 0 NO_COMPU_METHOD 0 3.402823e+38 ECU_ADDRESS_EXTENSION 0x80 /end CHARACTERISTIC
/begin CHARACTERISTIC CtApImageProcess_FreeRunning.PpImageProcess_Obstacle_60ms.DeObstacle.gstObjects[19].fPoint4X "" VALUE 0x3c08d0 __FLOAT32_IEEE_S 0 NO_COMPU_METHOD 0 3.402823e+38 ECU_ADDRESS_EXTENSION 0x80 /end CHARACTERISTIC
/begin CHARACTERISTIC CtApImageProcess_FreeRunning.PpImageProcess_Obstacle_60ms.DeObstacle.gstObjects[19].fPoint4Y "" VALUE 0x3c08d4 __FLOAT32_IEEE_S 0 NO_COMPU_METHOD 0 3.402823e+38 ECU_ADDRESS_EXTENSION 0x80 /end CHARACTERISTIC
/begin CHARACTERISTIC CtApImageProcess_FreeRunning.PpImageProcess_Obstacle_60ms.DeObstacle.reseved "16 uint8 array" VAL_BLK 0x3c08d8 __UBYTE_S 0 NO_COMPU_METHOD 0 255 ECU_ADDRESS_EXTENSION 0x80 MATRIX_DIM 16 1 1 /end CHARACTERISTIC
/begin CHARACTERISTIC CtApImageProcess_FreeRunning.PpImageProcess_Obstacle_60ms.DeObstacle.t2 "2 uint32 array" VAL_BLK 0x3c08e8 __ULONG_S 0 NO_COMPU_METHOD 0 4294967295 ECU_ADDRESS_EXTENSION 0x80 MATRIX_DIM 2 1 1 /end CHARACTERISTIC
/begin CHARACTERISTIC CtApImageProcess_FreeRunning.PpImageProcess_ParkingLot_20ms.DeSVParkingSlot.stHeader.Counter "" VALUE 0x3d0000 __UWORD_S 0 NO_COMPU_METHOD 0 65535 ECU_ADDRESS_EXTENSION 0x80 /end CHARACTERISTIC
/begin CHARACTERISTIC CtApImageProcess_FreeRunning.PpImageProcess_ParkingLot_20ms.DeSVParkingSlot.stHeader.FrameID "" VALUE 0x3d0002 __UBYTE_S 0 NO_COMPU_METHOD 0 255 ECU_ADDRESS_EXTENSION 0x80 /end CHARACTERISTIC
/begin CHARACTERISTIC CtApImageProcess_FreeRunning.PpImageProcess_ParkingLot_20ms.DeSVParkingSlot.stHeader.TimeStamp "2 uint32 array" VAL_BLK 0x3d0004 __ULONG_S 0 NO_COMPU_METHOD 0 4294967295 ECU_ADDRESS_EXTENSION 0x80 MATRIX_DIM 2 1 1 /end CHARACTERISTIC
/begin CHARACTERISTIC CtApImageProcess_FreeRunning.PpImageProcess_ParkingLot_20ms.DeSVParkingSlot.nImageTimeStamp "2 uint32 array" VAL_BLK 0x3d000c __ULONG_S 0 NO_COMPU_METHOD 0 4294967295 ECU_ADDRESS_EXTENSION 0x80 MATRIX_DIM 2 1 1 /end CHARACTERISTIC
/begin CHARACTERISTIC CtApImageProcess_FreeRunning.PpImageProcess_ParkingLot_20ms.DeSVParkingSlot.gstSpaceFront[0].nValid "" VALUE 0x3d0014 __UBYTE_S 0 NO_COMPU_METHOD 0 255 ECU_ADDRESS_EXTENSION 0x80 /end CHARACTERISTIC
/begin CHARACTERISTIC CtApImageProcess_FreeRunning.PpImageProcess_ParkingLot_20ms.DeSVParkingSlot.gstSpaceFront[0].gfPos[0] "2 float32 array" VAL_BLK 0x3d0018 __FLOAT32_IEEE_S 0 NO_COMPU_METHOD 0 3.402823e+38 ECU_ADDRESS_EXTENSION 0x80 MATRIX_DIM 2 1 1 /end CHARACTERISTIC
/begin CHARACTERISTIC CtApImageProcess_FreeRunning.PpImageProcess_ParkingLot_20ms.DeSVParkingSlot.gstSpaceFront[0].gfPos[1] "2 float32 array" VAL_BLK 0x3d0020 __FLOAT32_IEEE_S 0 NO_COMPU_METHOD 0 3.402823e+38 ECU_ADDRESS_EXTENSION 0x80 MATRIX_DIM 2 1 1 /end CHARACTERISTIC
/begin CHARACTERISTIC CtApImageProcess_FreeRunning.PpImageProcess_ParkingLot_20ms.DeSVParkingSlot.gstSpaceFront[0].gfPos[2] "2 float32 array" VAL_BLK 0x3d0028 __FLOAT32_IEEE_S 0 NO_COMPU_METHOD 0 3.402823e+38 ECU_ADDRESS_EXTENSION 0x80 MATRIX_DIM 2 1 1 /end CHARACTERISTIC
/begin CHARACTERISTIC CtApImageProcess_FreeRunning.PpImageProcess_ParkingLot_20ms.DeSVParkingSlot.gstSpaceFront[0].gfPos[3] "2 float32 array" VAL_BLK 0x3d0030 __FLOAT32_IEEE_S 0 NO_COMPU_METHOD 0 3.402823e+38 ECU_ADDRESS_EXTENSION 0x80 MATRIX_DIM 2 1 1 /end CHARACTERISTIC
/begin CHARACTERISTIC CtApImageProcess_FreeRunning.PpImageProcess_ParkingLot_20ms.DeSVParkingSlot.gstSpaceFront[0].nQuality "" VALUE 0x3d0038 __UBYTE_S 0 NO_COMPU_METHOD 0 255 ECU_ADDRESS_EXTENSION 0x80 /end CHARACTERISTIC
/begin CHARACTERISTIC CtApImageProcess_FreeRunning.PpImageProcess_ParkingLot_20ms.DeSVParkingSlot.gstSpaceFront[0].nType "" VALUE 0x3d0039 __UBYTE_S 0 NO_COMPU_METHOD 0 255 ECU_ADDRESS_EXTENSION 0x80 /end CHARACTERISTIC
/begin CHARACTERISTIC CtApImageProcess_FreeRunning.PpImageProcess_ParkingLot_20ms.DeSVParkingSlot.gstSpaceFront[0].nParkingGarageID "" VALUE 0x3d003a __UBYTE_S 0 NO_COMPU_METHOD 0 255 ECU_ADDRESS_EXTENSION 0x80 /end CHARACTERISTIC
/begin CHARACTERISTIC CtApImageProcess_FreeRunning.PpImageProcess_ParkingLot_20ms.DeSVParkingSlot.gstSpaceFront[0].fLineWith "" VALUE 0x3d003c __FLOAT32_IEEE_S 0 NO_COMPU_METHOD 0 3.402823e+38 ECU_ADDRESS_EXTENSION 0x80 /end CHARACTERISTIC
/begin CHARACTERISTIC CtApImageProcess_FreeRunning.PpImageProcess_ParkingLot_20ms.DeSVParkingSlot.gstSpaceFront[0].fSita "" VALUE 0x3d0040 __FLOAT32_IEEE_S 0 NO_COMPU_METHOD 0 3.402823e+38 ECU_ADDRESS_EXTENSION 0x80 /end CHARACTERISTIC
/begin CHARACTERISTIC CtApImageProcess_FreeRunning.PpImageProcess_ParkingLot_20ms.DeSVParkingSlot.gstSpaceFront[0].fIdentifierNum "2 uint32 array" VAL_BLK 0x3d0044 __ULONG_S 0 NO_COMPU_METHOD 0 4294967295 ECU_ADDRESS_EXTENSION 0x80 MATRIX_DIM 2 1 1 /end CHARACTERISTIC
/begin CHARACTERISTIC CtApImageProcess_FreeRunning.PpImageProcess_ParkingLot_20ms.DeSVParkingSlot.gstSpaceFront[0].fReserved "12 uint8 array" VAL_BLK 0x3d004c __UBYTE_S 0 NO_COMPU_METHOD 0 255 ECU_ADDRESS_EXTENSION 0x80 MATRIX_DIM 12 1 1 /end CHARACTERISTIC
/begin CHARACTERISTIC CtApImageProcess_FreeRunning.PpImageProcess_ParkingLot_20ms.DeSVParkingSlot.gstSpaceFront[1].nValid "" VALUE 0x3d0058 __UBYTE_S 0 NO_COMPU_METHOD 0 255 ECU_ADDRESS_EXTENSION 0x80 /end CHARACTERISTIC
/begin CHARACTERISTIC CtApImageProcess_FreeRunning.PpImageProcess_ParkingLot_20ms.DeSVParkingSlot.gstSpaceFront[1].gfPos[0] "2 float32 array" VAL_BLK 0x3d005c __FLOAT32_IEEE_S 0 NO_COMPU_METHOD 0 3.402823e+38 ECU_ADDRESS_EXTENSION 0x80 MATRIX_DIM 2 1 1 /end CHARACTERISTIC
/begin CHARACTERISTIC CtApImageProcess_FreeRunning.PpImageProcess_ParkingLot_20ms.DeSVParkingSlot.gstSpaceFront[1].gfPos[1] "2 float32 array" VAL_BLK 0x3d0064 __FLOAT32_IEEE_S 0 NO_COMPU_METHOD 0 3.402823e+38 ECU_ADDRESS_EXTENSION 0x80 MATRIX_DIM 2 1 1 /end CHARACTERISTIC
/begin CHARACTERISTIC CtApImageProcess_FreeRunning.PpImageProcess_ParkingLot_20ms.DeSVParkingSlot.gstSpaceFront[1].gfPos[2] "2 float32 array" VAL_BLK 0x3d006c __FLOAT32_IEEE_S 0 NO_COMPU_METHOD 0 3.402823e+38 ECU_ADDRESS_EXTENSION 0x80 MATRIX_DIM 2 1 1 /end CHARACTERISTIC
/begin CHARACTERISTIC CtApImageProcess_FreeRunning.PpImageProcess_ParkingLot_20ms.DeSVParkingSlot.gstSpaceFront[1].gfPos[3] "2 float32 array" VAL_BLK 0x3d0074 __FLOAT32_IEEE_S 0 NO_COMPU_METHOD 0 3.402823e+38 ECU_ADDRESS_EXTENSION 0x80 MATRIX_DIM 2 1 1 /end CHARACTERISTIC
/begin CHARACTERISTIC CtApImageProcess_FreeRunning.PpImageProcess_ParkingLot_20ms.DeSVParkingSlot.gstSpaceFront[1].nQuality "" VALUE 0x3d007c __UBYTE_S 0 NO_COMPU_METHOD 0 255 ECU_ADDRESS_EXTENSION 0x80 /end CHARACTERISTIC
/begin CHARACTERISTIC CtApImageProcess_FreeRunning.PpImageProcess_ParkingLot_20ms.DeSVParkingSlot.gstSpaceFront[1].nType "" VALUE 0x3d007d __UBYTE_S 0 NO_COMPU_METHOD 0 255 ECU_ADDRESS_EXTENSION 0x80 /end CHARACTERISTIC
/begin CHARACTERISTIC CtApImageProcess_FreeRunning.PpImageProcess_ParkingLot_20ms.DeSVParkingSlot.gstSpaceFront[1].nParkingGarageID "" VALUE 0x3d007e __UBYTE_S 0 NO_COMPU_METHOD 0 255 ECU_ADDRESS_EXTENSION 0x80 /end CHARACTERISTIC
/begin CHARACTERISTIC CtApImageProcess_FreeRunning.PpImageProcess_ParkingLot_20ms.DeSVParkingSlot.gstSpaceFront[1].fLineWith "" VALUE 0x3d0080 __FLOAT32_IEEE_S 0 NO_COMPU_METHOD 0 3.402823e+38 ECU_ADDRESS_EXTENSION 0x80 /end CHARACTERISTIC
/begin CHARACTERISTIC CtApImageProcess_FreeRunning.PpImageProcess_ParkingLot_20ms.DeSVParkingSlot.gstSpaceFront[1].fSita "" VALUE 0x3d0084 __FLOAT32_IEEE_S 0 NO_COMPU_METHOD 0 3.402823e+38 ECU_ADDRESS_EXTENSION 0x80 /end CHARACTERISTIC
/begin CHARACTERISTIC CtApImageProcess_FreeRunning.PpImageProcess_ParkingLot_20ms.DeSVParkingSlot.gstSpaceFront[1].fIdentifierNum "2 uint32 array" VAL_BLK 0x3d0088 __ULONG_S 0 NO_COMPU_METHOD 0 4294967295 ECU_ADDRESS_EXTENSION 0x80 MATRIX_DIM 2 1 1 /end CHARACTERISTIC
/begin CHARACTERISTIC CtApImageProcess_FreeRunning.PpImageProcess_ParkingLot_20ms.DeSVParkingSlot.gstSpaceFront[1].fReserved "12 uint8 array" VAL_BLK 0x3d0090 __UBYTE_S 0 NO_COMPU_METHOD 0 255 ECU_ADDRESS_EXTENSION 0x80 MATRIX_DIM 12 1 1 /end CHARACTERISTIC
/begin CHARACTERISTIC CtApImageProcess_FreeRunning.PpImageProcess_ParkingLot_20ms.DeSVParkingSlot.gstSpaceFront[2].nValid "" VALUE 0x3d009c __UBYTE_S 0 NO_COMPU_METHOD 0 255 ECU_ADDRESS_EXTENSION 0x80 /end CHARACTERISTIC
/begin CHARACTERISTIC CtApImageProcess_FreeRunning.PpImageProcess_ParkingLot_20ms.DeSVParkingSlot.gstSpaceFront[2].gfPos[0] "2 float32 array" VAL_BLK 0x3d00a0 __FLOAT32_IEEE_S 0 NO_COMPU_METHOD 0 3.402823e+38 ECU_ADDRESS_EXTENSION 0x80 MATRIX_DIM 2 1 1 /end CHARACTERISTIC
/begin CHARACTERISTIC CtApImageProcess_FreeRunning.PpImageProcess_ParkingLot_20ms.DeSVParkingSlot.gstSpaceFront[2].gfPos[1] "2 float32 array" VAL_BLK 0x3d00a8 __FLOAT32_IEEE_S 0 NO_COMPU_METHOD 0 3.402823e+38 ECU_ADDRESS_EXTENSION 0x80 MATRIX_DIM 2 1 1 /end CHARACTERISTIC
/begin CHARACTERISTIC CtApImageProcess_FreeRunning.PpImageProcess_ParkingLot_20ms.DeSVParkingSlot.gstSpaceFront[2].gfPos[2] "2 float32 array" VAL_BLK 0x3d00b0 __FLOAT32_IEEE_S 0 NO_COMPU_METHOD 0 3.402823e+38 ECU_ADDRESS_EXTENSION 0x80 MATRIX_DIM 2 1 1 /end CHARACTERISTIC
/begin CHARACTERISTIC CtApImageProcess_FreeRunning.PpImageProcess_ParkingLot_20ms.DeSVParkingSlot.gstSpaceFront[2].gfPos[3] "2 float32 array" VAL_BLK 0x3d00b8 __FLOAT32_IEEE_S 0 NO_COMPU_METHOD 0 3.402823e+38 ECU_ADDRESS_EXTENSION 0x80 MATRIX_DIM 2 1 1 /end CHARACTERISTIC
/begin CHARACTERISTIC CtApImageProcess_FreeRunning.PpImageProcess_ParkingLot_20ms.DeSVParkingSlot.gstSpaceFront[2].nQuality "" VALUE 0x3d00c0 __UBYTE_S 0 NO_COMPU_METHOD 0 255 ECU_ADDRESS_EXTENSION 0x80 /end CHARACTERISTIC
/begin CHARACTERISTIC CtApImageProcess_FreeRunning.PpImageProcess_ParkingLot_20ms.DeSVParkingSlot.gstSpaceFront[2].nType "" VALUE 0x3d00c1 __UBYTE_S 0 NO_COMPU_METHOD 0 255 ECU_ADDRESS_EXTENSION 0x80 /end CHARACTERISTIC
/begin CHARACTERISTIC CtApImageProcess_FreeRunning.PpImageProcess_ParkingLot_20ms.DeSVParkingSlot.gstSpaceFront[2].nParkingGarageID "" VALUE 0x3d00c2 __UBYTE_S 0 NO_COMPU_METHOD 0 255 ECU_ADDRESS_EXTENSION 0x80 /end CHARACTERISTIC
/begin CHARACTERISTIC CtApImageProcess_FreeRunning.PpImageProcess_ParkingLot_20ms.DeSVParkingSlot.gstSpaceFront[2].fLineWith "" VALUE 0x3d00c4 __FLOAT32_IEEE_S 0 NO_COMPU_METHOD 0 3.402823e+38 ECU_ADDRESS_EXTENSION 0x80 /end CHARACTERISTIC
/begin CHARACTERISTIC CtApImageProcess_FreeRunning.PpImageProcess_ParkingLot_20ms.DeSVParkingSlot.gstSpaceFront[2].fSita "" VALUE 0x3d00c8 __FLOAT32_IEEE_S 0 NO_COMPU_METHOD 0 3.402823e+38 ECU_ADDRESS_EXTENSION 0x80 /end CHARACTERISTIC
/begin CHARACTERISTIC CtApImageProcess_FreeRunning.PpImageProcess_ParkingLot_20ms.DeSVParkingSlot.gstSpaceFront[2].fIdentifierNum "2 uint32 array" VAL_BLK 0x3d00cc __ULONG_S 0 NO_COMPU_METHOD 0 4294967295 ECU_ADDRESS_EXTENSION 0x80 MATRIX_DIM 2 1 1 /end CHARACTERISTIC
/begin CHARACTERISTIC CtApImageProcess_FreeRunning.PpImageProcess_ParkingLot_20ms.DeSVParkingSlot.gstSpaceFront[2].fReserved "12 uint8 array" VAL_BLK 0x3d00d4 __UBYTE_S 0 NO_COMPU_METHOD 0 255 ECU_ADDRESS_EXTENSION 0x80 MATRIX_DIM 12 1 1 /end CHARACTERISTIC
/begin CHARACTERISTIC CtApImageProcess_FreeRunning.PpImageProcess_ParkingLot_20ms.DeSVParkingSlot.gstSpaceFront[3].nValid "" VALUE 0x3d00e0 __UBYTE_S 0 NO_COMPU_METHOD 0 255 ECU_ADDRESS_EXTENSION 0x80 /end CHARACTERISTIC
/begin CHARACTERISTIC CtApImageProcess_FreeRunning.PpImageProcess_ParkingLot_20ms.DeSVParkingSlot.gstSpaceFront[3].gfPos[0] "2 float32 array" VAL_BLK 0x3d00e4 __FLOAT32_IEEE_S 0 NO_COMPU_METHOD 0 3.402823e+38 ECU_ADDRESS_EXTENSION 0x80 MATRIX_DIM 2 1 1 /end CHARACTERISTIC
/begin CHARACTERISTIC CtApImageProcess_FreeRunning.PpImageProcess_ParkingLot_20ms.DeSVParkingSlot.gstSpaceFront[3].gfPos[1] "2 float32 array" VAL_BLK 0x3d00ec __FLOAT32_IEEE_S 0 NO_COMPU_METHOD 0 3.402823e+38 ECU_ADDRESS_EXTENSION 0x80 MATRIX_DIM 2 1 1 /end CHARACTERISTIC
/begin CHARACTERISTIC CtApImageProcess_FreeRunning.PpImageProcess_ParkingLot_20ms.DeSVParkingSlot.gstSpaceFront[3].gfPos[2] "2 float32 array" VAL_BLK 0x3d00f4 __FLOAT32_IEEE_S 0 NO_COMPU_METHOD 0 3.402823e+38 ECU_ADDRESS_EXTENSION 0x80 MATRIX_DIM 2 1 1 /end CHARACTERISTIC
/begin CHARACTERISTIC CtApImageProcess_FreeRunning.PpImageProcess_ParkingLot_20ms.DeSVParkingSlot.gstSpaceFront[3].gfPos[3] "2 float32 array" VAL_BLK 0x3d00fc __FLOAT32_IEEE_S 0 NO_COMPU_METHOD 0 3.402823e+38 ECU_ADDRESS_EXTENSION 0x80 MATRIX_DIM 2 1 1 /end CHARACTERISTIC
/begin CHARACTERISTIC CtApImageProcess_FreeRunning.PpImageProcess_ParkingLot_20ms.DeSVParkingSlot.gstSpaceFront[3].nQuality "" VALUE 0x3d0104 __UBYTE_S 0 NO_COMPU_METHOD 0 255 ECU_ADDRESS_EXTENSION 0x80 /end CHARACTERISTIC
/begin CHARACTERISTIC CtApImageProcess_FreeRunning.PpImageProcess_ParkingLot_20ms.DeSVParkingSlot.gstSpaceFront[3].nType "" VALUE 0x3d0105 __UBYTE_S 0 NO_COMPU_METHOD 0 255 ECU_ADDRESS_EXTENSION 0x80 /end CHARACTERISTIC
/begin CHARACTERISTIC CtApImageProcess_FreeRunning.PpImageProcess_ParkingLot_20ms.DeSVParkingSlot.gstSpaceFront[3].nParkingGarageID "" VALUE 0x3d0106 __UBYTE_S 0 NO_COMPU_METHOD 0 255 ECU_ADDRESS_EXTENSION 0x80 /end CHARACTERISTIC
/begin CHARACTERISTIC CtApImageProcess_FreeRunning.PpImageProcess_ParkingLot_20ms.DeSVParkingSlot.gstSpaceFront[3].fLineWith "" VALUE 0x3d0108 __FLOAT32_IEEE_S 0 NO_COMPU_METHOD 0 3.402823e+38 ECU_ADDRESS_EXTENSION 0x80 /end CHARACTERISTIC
/begin CHARACTERISTIC CtApImageProcess_FreeRunning.PpImageProcess_ParkingLot_20ms.DeSVParkingSlot.gstSpaceFront[3].fSita "" VALUE 0x3d010c __FLOAT32_IEEE_S 0 NO_COMPU_METHOD 0 3.402823e+38 ECU_ADDRESS_EXTENSION 0x80 /end CHARACTERISTIC
/begin CHARACTERISTIC CtApImageProcess_FreeRunning.PpImageProcess_ParkingLot_20ms.DeSVParkingSlot.gstSpaceFront[3].fIdentifierNum "2 uint32 array" VAL_BLK 0x3d0110 __ULONG_S 0 NO_COMPU_METHOD 0 4294967295 ECU_ADDRESS_EXTENSION 0x80 MATRIX_DIM 2 1 1 /end CHARACTERISTIC
/begin CHARACTERISTIC CtApImageProcess_FreeRunning.PpImageProcess_ParkingLot_20ms.DeSVParkingSlot.gstSpaceFront[3].fReserved "12 uint8 array" VAL_BLK 0x3d0118 __UBYTE_S 0 NO_COMPU_METHOD 0 255 ECU_ADDRESS_EXTENSION 0x80 MATRIX_DIM 12 1 1 /end CHARACTERISTIC
/begin CHARACTERISTIC CtApImageProcess_FreeRunning.PpImageProcess_ParkingLot_20ms.DeSVParkingSlot.gstSpaceFront[4].nValid "" VALUE 0x3d0124 __UBYTE_S 0 NO_COMPU_METHOD 0 255 ECU_ADDRESS_EXTENSION 0x80 /end CHARACTERISTIC
/begin CHARACTERISTIC CtApImageProcess_FreeRunning.PpImageProcess_ParkingLot_20ms.DeSVParkingSlot.gstSpaceFront[4].gfPos[0] "2 float32 array" VAL_BLK 0x3d0128 __FLOAT32_IEEE_S 0 NO_COMPU_METHOD 0 3.402823e+38 ECU_ADDRESS_EXTENSION 0x80 MATRIX_DIM 2 1 1 /end CHARACTERISTIC
/begin CHARACTERISTIC CtApImageProcess_FreeRunning.PpImageProcess_ParkingLot_20ms.DeSVParkingSlot.gstSpaceFront[4].gfPos[1] "2 float32 array" VAL_BLK 0x3d0130 __FLOAT32_IEEE_S 0 NO_COMPU_METHOD 0 3.402823e+38 ECU_ADDRESS_EXTENSION 0x80 MATRIX_DIM 2 1 1 /end CHARACTERISTIC
/begin CHARACTERISTIC CtApImageProcess_FreeRunning.PpImageProcess_ParkingLot_20ms.DeSVParkingSlot.gstSpaceFront[4].gfPos[2] "2 float32 array" VAL_BLK 0x3d0138 __FLOAT32_IEEE_S 0 NO_COMPU_METHOD 0 3.402823e+38 ECU_ADDRESS_EXTENSION 0x80 MATRIX_DIM 2 1 1 /end CHARACTERISTIC
/begin CHARACTERISTIC CtApImageProcess_FreeRunning.PpImageProcess_ParkingLot_20ms.DeSVParkingSlot.gstSpaceFront[4].gfPos[3] "2 float32 array" VAL_BLK 0x3d0140 __FLOAT32_IEEE_S 0 NO_COMPU_METHOD 0 3.402823e+38 ECU_ADDRESS_EXTENSION 0x80 MATRIX_DIM 2 1 1 /end CHARACTERISTIC
/begin CHARACTERISTIC CtApImageProcess_FreeRunning.PpImageProcess_ParkingLot_20ms.DeSVParkingSlot.gstSpaceFront[4].nQuality "" VALUE 0x3d0148 __UBYTE_S 0 NO_COMPU_METHOD 0 255 ECU_ADDRESS_EXTENSION 0x80 /end CHARACTERISTIC
/begin CHARACTERISTIC CtApImageProcess_FreeRunning.PpImageProcess_ParkingLot_20ms.DeSVParkingSlot.gstSpaceFront[4].nType "" VALUE 0x3d0149 __UBYTE_S 0 NO_COMPU_METHOD 0 255 ECU_ADDRESS_EXTENSION 0x80 /end CHARACTERISTIC
/begin CHARACTERISTIC CtApImageProcess_FreeRunning.PpImageProcess_ParkingLot_20ms.DeSVParkingSlot.gstSpaceFront[4].nParkingGarageID "" VALUE 0x3d014a __UBYTE_S 0 NO_COMPU_METHOD 0 255 ECU_ADDRESS_EXTENSION 0x80 /end CHARACTERISTIC
/begin CHARACTERISTIC CtApImageProcess_FreeRunning.PpImageProcess_ParkingLot_20ms.DeSVParkingSlot.gstSpaceFront[4].fLineWith "" VALUE 0x3d014c __FLOAT32_IEEE_S 0 NO_COMPU_METHOD 0 3.402823e+38 ECU_ADDRESS_EXTENSION 0x80 /end CHARACTERISTIC
/begin CHARACTERISTIC CtApImageProcess_FreeRunning.PpImageProcess_ParkingLot_20ms.DeSVParkingSlot.gstSpaceFront[4].fSita "" VALUE 0x3d0150 __FLOAT32_IEEE_S 0 NO_COMPU_METHOD 0 3.402823e+38 ECU_ADDRESS_EXTENSION 0x80 /end CHARACTERISTIC
/begin CHARACTERISTIC CtApImageProcess_FreeRunning.PpImageProcess_ParkingLot_20ms.DeSVParkingSlot.gstSpaceFront[4].fIdentifierNum "2 uint32 array" VAL_BLK 0x3d0154 __ULONG_S 0 NO_COMPU_METHOD 0 4294967295 ECU_ADDRESS_EXTENSION 0x80 MATRIX_DIM 2 1 1 /end CHARACTERISTIC
/begin CHARACTERISTIC CtApImageProcess_FreeRunning.PpImageProcess_ParkingLot_20ms.DeSVParkingSlot.gstSpaceFront[4].fReserved "12 uint8 array" VAL_BLK 0x3d015c __UBYTE_S 0 NO_COMPU_METHOD 0 255 ECU_ADDRESS_EXTENSION 0x80 MATRIX_DIM 12 1 1 /end CHARACTERISTIC
/begin CHARACTERISTIC CtApImageProcess_FreeRunning.PpImageProcess_ParkingLot_20ms.DeSVParkingSlot.gstSpaceFront[5].nValid "" VALUE 0x3d0168 __UBYTE_S 0 NO_COMPU_METHOD 0 255 ECU_ADDRESS_EXTENSION 0x80 /end CHARACTERISTIC
/begin CHARACTERISTIC CtApImageProcess_FreeRunning.PpImageProcess_ParkingLot_20ms.DeSVParkingSlot.gstSpaceFront[5].gfPos[0] "2 float32 array" VAL_BLK 0x3d016c __FLOAT32_IEEE_S 0 NO_COMPU_METHOD 0 3.402823e+38 ECU_ADDRESS_EXTENSION 0x80 MATRIX_DIM 2 1 1 /end CHARACTERISTIC
/begin CHARACTERISTIC CtApImageProcess_FreeRunning.PpImageProcess_ParkingLot_20ms.DeSVParkingSlot.gstSpaceFront[5].gfPos[1] "2 float32 array" VAL_BLK 0x3d0174 __FLOAT32_IEEE_S 0 NO_COMPU_METHOD 0 3.402823e+38 ECU_ADDRESS_EXTENSION 0x80 MATRIX_DIM 2 1 1 /end CHARACTERISTIC
/begin CHARACTERISTIC CtApImageProcess_FreeRunning.PpImageProcess_ParkingLot_20ms.DeSVParkingSlot.gstSpaceFront[5].gfPos[2] "2 float32 array" VAL_BLK 0x3d017c __FLOAT32_IEEE_S 0 NO_COMPU_METHOD 0 3.402823e+38 ECU_ADDRESS_EXTENSION 0x80 MATRIX_DIM 2 1 1 /end CHARACTERISTIC
/begin CHARACTERISTIC CtApImageProcess_FreeRunning.PpImageProcess_ParkingLot_20ms.DeSVParkingSlot.gstSpaceFront[5].gfPos[3] "2 float32 array" VAL_BLK 0x3d0184 __FLOAT32_IEEE_S 0 NO_COMPU_METHOD 0 3.402823e+38 ECU_ADDRESS_EXTENSION 0x80 MATRIX_DIM 2 1 1 /end CHARACTERISTIC
/begin CHARACTERISTIC CtApImageProcess_FreeRunning.PpImageProcess_ParkingLot_20ms.DeSVParkingSlot.gstSpaceFront[5].nQuality "" VALUE 0x3d018c __UBYTE_S 0 NO_COMPU_METHOD 0 255 ECU_ADDRESS_EXTENSION 0x80 /end CHARACTERISTIC
/begin CHARACTERISTIC CtApImageProcess_FreeRunning.PpImageProcess_ParkingLot_20ms.DeSVParkingSlot.gstSpaceFront[5].nType "" VALUE 0x3d018d __UBYTE_S 0 NO_COMPU_METHOD 0 255 ECU_ADDRESS_EXTENSION 0x80 /end CHARACTERISTIC
/begin CHARACTERISTIC CtApImageProcess_FreeRunning.PpImageProcess_ParkingLot_20ms.DeSVParkingSlot.gstSpaceFront[5].nParkingGarageID "" VALUE 0x3d018e __UBYTE_S 0 NO_COMPU_METHOD 0 255 ECU_ADDRESS_EXTENSION 0x80 /end CHARACTERISTIC
/begin CHARACTERISTIC CtApImageProcess_FreeRunning.PpImageProcess_ParkingLot_20ms.DeSVParkingSlot.gstSpaceFront[5].fLineWith "" VALUE 0x3d0190 __FLOAT32_IEEE_S 0 NO_COMPU_METHOD 0 3.402823e+38 ECU_ADDRESS_EXTENSION 0x80 /end CHARACTERISTIC
/begin CHARACTERISTIC CtApImageProcess_FreeRunning.PpImageProcess_ParkingLot_20ms.DeSVParkingSlot.gstSpaceFront[5].fSita "" VALUE 0x3d0194 __FLOAT32_IEEE_S 0 NO_COMPU_METHOD 0 3.402823e+38 ECU_ADDRESS_EXTENSION 0x80 /end CHARACTERISTIC
/begin CHARACTERISTIC CtApImageProcess_FreeRunning.PpImageProcess_ParkingLot_20ms.DeSVParkingSlot.gstSpaceFront[5].fIdentifierNum "2 uint32 array" VAL_BLK 0x3d0198 __ULONG_S 0 NO_COMPU_METHOD 0 4294967295 ECU_ADDRESS_EXTENSION 0x80 MATRIX_DIM 2 1 1 /end CHARACTERISTIC
/begin CHARACTERISTIC CtApImageProcess_FreeRunning.PpImageProcess_ParkingLot_20ms.DeSVParkingSlot.gstSpaceFront[5].fReserved "12 uint8 array" VAL_BLK 0x3d01a0 __UBYTE_S 0 NO_COMPU_METHOD 0 255 ECU_ADDRESS_EXTENSION 0x80 MATRIX_DIM 12 1 1 /end CHARACTERISTIC
/begin CHARACTERISTIC CtApImageProcess_FreeRunning.PpImageProcess_ParkingLot_20ms.DeSVParkingSlot.gstSpaceFront[6].nValid "" VALUE 0x3d01ac __UBYTE_S 0 NO_COMPU_METHOD 0 255 ECU_ADDRESS_EXTENSION 0x80 /end CHARACTERISTIC
/begin CHARACTERISTIC CtApImageProcess_FreeRunning.PpImageProcess_ParkingLot_20ms.DeSVParkingSlot.gstSpaceFront[6].gfPos[0] "2 float32 array" VAL_BLK 0x3d01b0 __FLOAT32_IEEE_S 0 NO_COMPU_METHOD 0 3.402823e+38 ECU_ADDRESS_EXTENSION 0x80 MATRIX_DIM 2 1 1 /end CHARACTERISTIC
/begin CHARACTERISTIC CtApImageProcess_FreeRunning.PpImageProcess_ParkingLot_20ms.DeSVParkingSlot.gstSpaceFront[6].gfPos[1] "2 float32 array" VAL_BLK 0x3d01b8 __FLOAT32_IEEE_S 0 NO_COMPU_METHOD 0 3.402823e+38 ECU_ADDRESS_EXTENSION 0x80 MATRIX_DIM 2 1 1 /end CHARACTERISTIC
/begin CHARACTERISTIC CtApImageProcess_FreeRunning.PpImageProcess_ParkingLot_20ms.DeSVParkingSlot.gstSpaceFront[6].gfPos[2] "2 float32 array" VAL_BLK 0x3d01c0 __FLOAT32_IEEE_S 0 NO_COMPU_METHOD 0 3.402823e+38 ECU_ADDRESS_EXTENSION 0x80 MATRIX_DIM 2 1 1 /end CHARACTERISTIC
/begin CHARACTERISTIC CtApImageProcess_FreeRunning.PpImageProcess_ParkingLot_20ms.DeSVParkingSlot.gstSpaceFront[6].gfPos[3] "2 float32 array" VAL_BLK 0x3d01c8 __FLOAT32_IEEE_S 0 NO_COMPU_METHOD 0 3.402823e+38 ECU_ADDRESS_EXTENSION 0x80 MATRIX_DIM 2 1 1 /end CHARACTERISTIC
/begin CHARACTERISTIC CtApImageProcess_FreeRunning.PpImageProcess_ParkingLot_20ms.DeSVParkingSlot.gstSpaceFront[6].nQuality "" VALUE 0x3d01d0 __UBYTE_S 0 NO_COMPU_METHOD 0 255 ECU_ADDRESS_EXTENSION 0x80 /end CHARACTERISTIC
/begin CHARACTERISTIC CtApImageProcess_FreeRunning.PpImageProcess_ParkingLot_20ms.DeSVParkingSlot.gstSpaceFront[6].nType "" VALUE 0x3d01d1 __UBYTE_S 0 NO_COMPU_METHOD 0 255 ECU_ADDRESS_EXTENSION 0x80 /end CHARACTERISTIC
/begin CHARACTERISTIC CtApImageProcess_FreeRunning.PpImageProcess_ParkingLot_20ms.DeSVParkingSlot.gstSpaceFront[6].nParkingGarageID "" VALUE 0x3d01d2 __UBYTE_S 0 NO_COMPU_METHOD 0 255 ECU_ADDRESS_EXTENSION 0x80 /end CHARACTERISTIC
/begin CHARACTERISTIC CtApImageProcess_FreeRunning.PpImageProcess_ParkingLot_20ms.DeSVParkingSlot.gstSpaceFront[6].fLineWith "" VALUE 0x3d01d4 __FLOAT32_IEEE_S 0 NO_COMPU_METHOD 0 3.402823e+38 ECU_ADDRESS_EXTENSION 0x80 /end CHARACTERISTIC
/begin CHARACTERISTIC CtApImageProcess_FreeRunning.PpImageProcess_ParkingLot_20ms.DeSVParkingSlot.gstSpaceFront[6].fSita "" VALUE 0x3d01d8 __FLOAT32_IEEE_S 0 NO_COMPU_METHOD 0 3.402823e+38 ECU_ADDRESS_EXTENSION 0x80 /end CHARACTERISTIC
/begin CHARACTERISTIC CtApImageProcess_FreeRunning.PpImageProcess_ParkingLot_20ms.DeSVParkingSlot.gstSpaceFront[6].fIdentifierNum "2 uint32 array" VAL_BLK 0x3d01dc __ULONG_S 0 NO_COMPU_METHOD 0 4294967295 ECU_ADDRESS_EXTENSION 0x80 MATRIX_DIM 2 1 1 /end CHARACTERISTIC
/begin CHARACTERISTIC CtApImageProcess_FreeRunning.PpImageProcess_ParkingLot_20ms.DeSVParkingSlot.gstSpaceFront[6].fReserved "12 uint8 array" VAL_BLK 0x3d01e4 __UBYTE_S 0 NO_COMPU_METHOD 0 255 ECU_ADDRESS_EXTENSION 0x80 MATRIX_DIM 12 1 1 /end CHARACTERISTIC
/begin CHARACTERISTIC CtApImageProcess_FreeRunning.PpImageProcess_ParkingLot_20ms.DeSVParkingSlot.gstSpaceFront[7].nValid "" VALUE 0x3d01f0 __UBYTE_S 0 NO_COMPU_METHOD 0 255 ECU_ADDRESS_EXTENSION 0x80 /end CHARACTERISTIC
/begin CHARACTERISTIC CtApImageProcess_FreeRunning.PpImageProcess_ParkingLot_20ms.DeSVParkingSlot.gstSpaceFront[7].gfPos[0] "2 float32 array" VAL_BLK 0x3d01f4 __FLOAT32_IEEE_S 0 NO_COMPU_METHOD 0 3.402823e+38 ECU_ADDRESS_EXTENSION 0x80 MATRIX_DIM 2 1 1 /end CHARACTERISTIC
/begin CHARACTERISTIC CtApImageProcess_FreeRunning.PpImageProcess_ParkingLot_20ms.DeSVParkingSlot.gstSpaceFront[7].gfPos[1] "2 float32 array" VAL_BLK 0x3d01fc __FLOAT32_IEEE_S 0 NO_COMPU_METHOD 0 3.402823e+38 ECU_ADDRESS_EXTENSION 0x80 MATRIX_DIM 2 1 1 /end CHARACTERISTIC
/begin CHARACTERISTIC CtApImageProcess_FreeRunning.PpImageProcess_ParkingLot_20ms.DeSVParkingSlot.gstSpaceFront[7].gfPos[2] "2 float32 array" VAL_BLK 0x3d0204 __FLOAT32_IEEE_S 0 NO_COMPU_METHOD 0 3.402823e+38 ECU_ADDRESS_EXTENSION 0x80 MATRIX_DIM 2 1 1 /end CHARACTERISTIC
/begin CHARACTERISTIC CtApImageProcess_FreeRunning.PpImageProcess_ParkingLot_20ms.DeSVParkingSlot.gstSpaceFront[7].gfPos[3] "2 float32 array" VAL_BLK 0x3d020c __FLOAT32_IEEE_S 0 NO_COMPU_METHOD 0 3.402823e+38 ECU_ADDRESS_EXTENSION 0x80 MATRIX_DIM 2 1 1 /end CHARACTERISTIC
/begin CHARACTERISTIC CtApImageProcess_FreeRunning.PpImageProcess_ParkingLot_20ms.DeSVParkingSlot.gstSpaceFront[7].nQuality "" VALUE 0x3d0214 __UBYTE_S 0 NO_COMPU_METHOD 0 255 ECU_ADDRESS_EXTENSION 0x80 /end CHARACTERISTIC
/begin CHARACTERISTIC CtApImageProcess_FreeRunning.PpImageProcess_ParkingLot_20ms.DeSVParkingSlot.gstSpaceFront[7].nType "" VALUE 0x3d0215 __UBYTE_S 0 NO_COMPU_METHOD 0 255 ECU_ADDRESS_EXTENSION 0x80 /end CHARACTERISTIC
/begin CHARACTERISTIC CtApImageProcess_FreeRunning.PpImageProcess_ParkingLot_20ms.DeSVParkingSlot.gstSpaceFront[7].nParkingGarageID "" VALUE 0x3d0216 __UBYTE_S 0 NO_COMPU_METHOD 0 255 ECU_ADDRESS_EXTENSION 0x80 /end CHARACTERISTIC
/begin CHARACTERISTIC CtApImageProcess_FreeRunning.PpImageProcess_ParkingLot_20ms.DeSVParkingSlot.gstSpaceFront[7].fLineWith "" VALUE 0x3d0218 __FLOAT32_IEEE_S 0 NO_COMPU_METHOD 0 3.402823e+38 ECU_ADDRESS_EXTENSION 0x80 /end CHARACTERISTIC
/begin CHARACTERISTIC CtApImageProcess_FreeRunning.PpImageProcess_ParkingLot_20ms.DeSVParkingSlot.gstSpaceFront[7].fSita "" VALUE 0x3d021c __FLOAT32_IEEE_S 0 NO_COMPU_METHOD 0 3.402823e+38 ECU_ADDRESS_EXTENSION 0x80 /end CHARACTERISTIC
/begin CHARACTERISTIC CtApImageProcess_FreeRunning.PpImageProcess_ParkingLot_20ms.DeSVParkingSlot.gstSpaceFront[7].fIdentifierNum "2 uint32 array" VAL_BLK 0x3d0220 __ULONG_S 0 NO_COMPU_METHOD 0 4294967295 ECU_ADDRESS_EXTENSION 0x80 MATRIX_DIM 2 1 1 /end CHARACTERISTIC
/begin CHARACTERISTIC CtApImageProcess_FreeRunning.PpImageProcess_ParkingLot_20ms.DeSVParkingSlot.gstSpaceFront[7].fReserved "12 uint8 array" VAL_BLK 0x3d0228 __UBYTE_S 0 NO_COMPU_METHOD 0 255 ECU_ADDRESS_EXTENSION 0x80 MATRIX_DIM 12 1 1 /end CHARACTERISTIC
/begin CHARACTERISTIC CtApImageProcess_FreeRunning.PpImageProcess_ParkingLot_20ms.DeSVParkingSlot.gstSpaceRight[0].nValid "" VALUE 0x3d0234 __UBYTE_S 0 NO_COMPU_METHOD 0 255 ECU_ADDRESS_EXTENSION 0x80 /end CHARACTERISTIC
/begin CHARACTERISTIC CtApImageProcess_FreeRunning.PpImageProcess_ParkingLot_20ms.DeSVParkingSlot.gstSpaceRight[0].gfPos[0] "2 float32 array" VAL_BLK 0x3d0238 __FLOAT32_IEEE_S 0 NO_COMPU_METHOD 0 3.402823e+38 ECU_ADDRESS_EXTENSION 0x80 MATRIX_DIM 2 1 1 /end CHARACTERISTIC
/begin CHARACTERISTIC CtApImageProcess_FreeRunning.PpImageProcess_ParkingLot_20ms.DeSVParkingSlot.gstSpaceRight[0].gfPos[1] "2 float32 array" VAL_BLK 0x3d0240 __FLOAT32_IEEE_S 0 NO_COMPU_METHOD 0 3.402823e+38 ECU_ADDRESS_EXTENSION 0x80 MATRIX_DIM 2 1 1 /end CHARACTERISTIC
/begin CHARACTERISTIC CtApImageProcess_FreeRunning.PpImageProcess_ParkingLot_20ms.DeSVParkingSlot.gstSpaceRight[0].gfPos[2] "2 float32 array" VAL_BLK 0x3d0248 __FLOAT32_IEEE_S 0 NO_COMPU_METHOD 0 3.402823e+38 ECU_ADDRESS_EXTENSION 0x80 MATRIX_DIM 2 1 1 /end CHARACTERISTIC
/begin CHARACTERISTIC CtApImageProcess_FreeRunning.PpImageProcess_ParkingLot_20ms.DeSVParkingSlot.gstSpaceRight[0].gfPos[3] "2 float32 array" VAL_BLK 0x3d0250 __FLOAT32_IEEE_S 0 NO_COMPU_METHOD 0 3.402823e+38 ECU_ADDRESS_EXTENSION 0x80 MATRIX_DIM 2 1 1 /end CHARACTERISTIC
/begin CHARACTERISTIC CtApImageProcess_FreeRunning.PpImageProcess_ParkingLot_20ms.DeSVParkingSlot.gstSpaceRight[0].nQuality "" VALUE 0x3d0258 __UBYTE_S 0 NO_COMPU_METHOD 0 255 ECU_ADDRESS_EXTENSION 0x80 /end CHARACTERISTIC
/begin CHARACTERISTIC CtApImageProcess_FreeRunning.PpImageProcess_ParkingLot_20ms.DeSVParkingSlot.gstSpaceRight[0].nType "" VALUE 0x3d0259 __UBYTE_S 0 NO_COMPU_METHOD 0 255 ECU_ADDRESS_EXTENSION 0x80 /end CHARACTERISTIC
/begin CHARACTERISTIC CtApImageProcess_FreeRunning.PpImageProcess_ParkingLot_20ms.DeSVParkingSlot.gstSpaceRight[0].nParkingGarageID "" VALUE 0x3d025a __UBYTE_S 0 NO_COMPU_METHOD 0 255 ECU_ADDRESS_EXTENSION 0x80 /end CHARACTERISTIC
/begin CHARACTERISTIC CtApImageProcess_FreeRunning.PpImageProcess_ParkingLot_20ms.DeSVParkingSlot.gstSpaceRight[0].fLineWith "" VALUE 0x3d025c __FLOAT32_IEEE_S 0 NO_COMPU_METHOD 0 3.402823e+38 ECU_ADDRESS_EXTENSION 0x80 /end CHARACTERISTIC
/begin CHARACTERISTIC CtApImageProcess_FreeRunning.PpImageProcess_ParkingLot_20ms.DeSVParkingSlot.gstSpaceRight[0].fSita "" VALUE 0x3d0260 __FLOAT32_IEEE_S 0 NO_COMPU_METHOD 0 3.402823e+38 ECU_ADDRESS_EXTENSION 0x80 /end CHARACTERISTIC
/begin CHARACTERISTIC CtApImageProcess_FreeRunning.PpImageProcess_ParkingLot_20ms.DeSVParkingSlot.gstSpaceRight[0].fIdentifierNum "2 uint32 array" VAL_BLK 0x3d0264 __ULONG_S 0 NO_COMPU_METHOD 0 4294967295 ECU_ADDRESS_EXTENSION 0x80 MATRIX_DIM 2 1 1 /end CHARACTERISTIC
/begin CHARACTERISTIC CtApImageProcess_FreeRunning.PpImageProcess_ParkingLot_20ms.DeSVParkingSlot.gstSpaceRight[0].fReserved "12 uint8 array" VAL_BLK 0x3d026c __UBYTE_S 0 NO_COMPU_METHOD 0 255 ECU_ADDRESS_EXTENSION 0x80 MATRIX_DIM 12 1 1 /end CHARACTERISTIC
/begin CHARACTERISTIC CtApImageProcess_FreeRunning.PpImageProcess_ParkingLot_20ms.DeSVParkingSlot.gstSpaceRight[1].nValid "" VALUE 0x3d0278 __UBYTE_S 0 NO_COMPU_METHOD 0 255 ECU_ADDRESS_EXTENSION 0x80 /end CHARACTERISTIC
/begin CHARACTERISTIC CtApImageProcess_FreeRunning.PpImageProcess_ParkingLot_20ms.DeSVParkingSlot.gstSpaceRight[1].gfPos[0] "2 float32 array" VAL_BLK 0x3d027c __FLOAT32_IEEE_S 0 NO_COMPU_METHOD 0 3.402823e+38 ECU_ADDRESS_EXTENSION 0x80 MATRIX_DIM 2 1 1 /end CHARACTERISTIC
/begin CHARACTERISTIC CtApImageProcess_FreeRunning.PpImageProcess_ParkingLot_20ms.DeSVParkingSlot.gstSpaceRight[1].gfPos[1] "2 float32 array" VAL_BLK 0x3d0284 __FLOAT32_IEEE_S 0 NO_COMPU_METHOD 0 3.402823e+38 ECU_ADDRESS_EXTENSION 0x80 MATRIX_DIM 2 1 1 /end CHARACTERISTIC
/begin CHARACTERISTIC CtApImageProcess_FreeRunning.PpImageProcess_ParkingLot_20ms.DeSVParkingSlot.gstSpaceRight[1].gfPos[2] "2 float32 array" VAL_BLK 0x3d028c __FLOAT32_IEEE_S 0 NO_COMPU_METHOD 0 3.402823e+38 ECU_ADDRESS_EXTENSION 0x80 MATRIX_DIM 2 1 1 /end CHARACTERISTIC
/begin CHARACTERISTIC CtApImageProcess_FreeRunning.PpImageProcess_ParkingLot_20ms.DeSVParkingSlot.gstSpaceRight[1].gfPos[3] "2 float32 array" VAL_BLK 0x3d0294 __FLOAT32_IEEE_S 0 NO_COMPU_METHOD 0 3.402823e+38 ECU_ADDRESS_EXTENSION 0x80 MATRIX_DIM 2 1 1 /end CHARACTERISTIC
/begin CHARACTERISTIC CtApImageProcess_FreeRunning.PpImageProcess_ParkingLot_20ms.DeSVParkingSlot.gstSpaceRight[1].nQuality "" VALUE 0x3d029c __UBYTE_S 0 NO_COMPU_METHOD 0 255 ECU_ADDRESS_EXTENSION 0x80 /end CHARACTERISTIC
/begin CHARACTERISTIC CtApImageProcess_FreeRunning.PpImageProcess_ParkingLot_20ms.DeSVParkingSlot.gstSpaceRight[1].nType "" VALUE 0x3d029d __UBYTE_S 0 NO_COMPU_METHOD 0 255 ECU_ADDRESS_EXTENSION 0x80 /end CHARACTERISTIC
/begin CHARACTERISTIC CtApImageProcess_FreeRunning.PpImageProcess_ParkingLot_20ms.DeSVParkingSlot.gstSpaceRight[1].nParkingGarageID "" VALUE 0x3d029e __UBYTE_S 0 NO_COMPU_METHOD 0 255 ECU_ADDRESS_EXTENSION 0x80 /end CHARACTERISTIC
/begin CHARACTERISTIC CtApImageProcess_FreeRunning.PpImageProcess_ParkingLot_20ms.DeSVParkingSlot.gstSpaceRight[1].fLineWith "" VALUE 0x3d02a0 __FLOAT32_IEEE_S 0 NO_COMPU_METHOD 0 3.402823e+38 ECU_ADDRESS_EXTENSION 0x80 /end CHARACTERISTIC
/begin CHARACTERISTIC CtApImageProcess_FreeRunning.PpImageProcess_ParkingLot_20ms.DeSVParkingSlot.gstSpaceRight[1].fSita "" VALUE 0x3d02a4 __FLOAT32_IEEE_S 0 NO_COMPU_METHOD 0 3.402823e+38 ECU_ADDRESS_EXTENSION 0x80 /end CHARACTERISTIC
/begin CHARACTERISTIC CtApImageProcess_FreeRunning.PpImageProcess_ParkingLot_20ms.DeSVParkingSlot.gstSpaceRight[1].fIdentifierNum "2 uint32 array" VAL_BLK 0x3d02a8 __ULONG_S 0 NO_COMPU_METHOD 0 4294967295 ECU_ADDRESS_EXTENSION 0x80 MATRIX_DIM 2 1 1 /end CHARACTERISTIC
/begin CHARACTERISTIC CtApImageProcess_FreeRunning.PpImageProcess_ParkingLot_20ms.DeSVParkingSlot.gstSpaceRight[1].fReserved "12 uint8 array" VAL_BLK 0x3d02b0 __UBYTE_S 0 NO_COMPU_METHOD 0 255 ECU_ADDRESS_EXTENSION 0x80 MATRIX_DIM 12 1 1 /end CHARACTERISTIC
/begin CHARACTERISTIC CtApImageProcess_FreeRunning.PpImageProcess_ParkingLot_20ms.DeSVParkingSlot.gstSpaceRight[2].nValid "" VALUE 0x3d02bc __UBYTE_S 0 NO_COMPU_METHOD 0 255 ECU_ADDRESS_EXTENSION 0x80 /end CHARACTERISTIC
/begin CHARACTERISTIC CtApImageProcess_FreeRunning.PpImageProcess_ParkingLot_20ms.DeSVParkingSlot.gstSpaceRight[2].gfPos[0] "2 float32 array" VAL_BLK 0x3d02c0 __FLOAT32_IEEE_S 0 NO_COMPU_METHOD 0 3.402823e+38 ECU_ADDRESS_EXTENSION 0x80 MATRIX_DIM 2 1 1 /end CHARACTERISTIC
/begin CHARACTERISTIC CtApImageProcess_FreeRunning.PpImageProcess_ParkingLot_20ms.DeSVParkingSlot.gstSpaceRight[2].gfPos[1] "2 float32 array" VAL_BLK 0x3d02c8 __FLOAT32_IEEE_S 0 NO_COMPU_METHOD 0 3.402823e+38 ECU_ADDRESS_EXTENSION 0x80 MATRIX_DIM 2 1 1 /end CHARACTERISTIC
/begin CHARACTERISTIC CtApImageProcess_FreeRunning.PpImageProcess_ParkingLot_20ms.DeSVParkingSlot.gstSpaceRight[2].gfPos[2] "2 float32 array" VAL_BLK 0x3d02d0 __FLOAT32_IEEE_S 0 NO_COMPU_METHOD 0 3.402823e+38 ECU_ADDRESS_EXTENSION 0x80 MATRIX_DIM 2 1 1 /end CHARACTERISTIC
/begin CHARACTERISTIC CtApImageProcess_FreeRunning.PpImageProcess_ParkingLot_20ms.DeSVParkingSlot.gstSpaceRight[2].gfPos[3] "2 float32 array" VAL_BLK 0x3d02d8 __FLOAT32_IEEE_S 0 NO_COMPU_METHOD 0 3.402823e+38 ECU_ADDRESS_EXTENSION 0x80 MATRIX_DIM 2 1 1 /end CHARACTERISTIC
/begin CHARACTERISTIC CtApImageProcess_FreeRunning.PpImageProcess_ParkingLot_20ms.DeSVParkingSlot.gstSpaceRight[2].nQuality "" VALUE 0x3d02e0 __UBYTE_S 0 NO_COMPU_METHOD 0 255 ECU_ADDRESS_EXTENSION 0x80 /end CHARACTERISTIC
/begin CHARACTERISTIC CtApImageProcess_FreeRunning.PpImageProcess_ParkingLot_20ms.DeSVParkingSlot.gstSpaceRight[2].nType "" VALUE 0x3d02e1 __UBYTE_S 0 NO_COMPU_METHOD 0 255 ECU_ADDRESS_EXTENSION 0x80 /end CHARACTERISTIC
/begin CHARACTERISTIC CtApImageProcess_FreeRunning.PpImageProcess_ParkingLot_20ms.DeSVParkingSlot.gstSpaceRight[2].nParkingGarageID "" VALUE 0x3d02e2 __UBYTE_S 0 NO_COMPU_METHOD 0 255 ECU_ADDRESS_EXTENSION 0x80 /end CHARACTERISTIC
/begin CHARACTERISTIC CtApImageProcess_FreeRunning.PpImageProcess_ParkingLot_20ms.DeSVParkingSlot.gstSpaceRight[2].fLineWith "" VALUE 0x3d02e4 __FLOAT32_IEEE_S 0 NO_COMPU_METHOD 0 3.402823e+38 ECU_ADDRESS_EXTENSION 0x80 /end CHARACTERISTIC
/begin CHARACTERISTIC CtApImageProcess_FreeRunning.PpImageProcess_ParkingLot_20ms.DeSVParkingSlot.gstSpaceRight[2].fSita "" VALUE 0x3d02e8 __FLOAT32_IEEE_S 0 NO_COMPU_METHOD 0 3.402823e+38 ECU_ADDRESS_EXTENSION 0x80 /end CHARACTERISTIC
/begin CHARACTERISTIC CtApImageProcess_FreeRunning.PpImageProcess_ParkingLot_20ms.DeSVParkingSlot.gstSpaceRight[2].fIdentifierNum "2 uint32 array" VAL_BLK 0x3d02ec __ULONG_S 0 NO_COMPU_METHOD 0 4294967295 ECU_ADDRESS_EXTENSION 0x80 MATRIX_DIM 2 1 1 /end CHARACTERISTIC
/begin CHARACTERISTIC CtApImageProcess_FreeRunning.PpImageProcess_ParkingLot_20ms.DeSVParkingSlot.gstSpaceRight[2].fReserved "12 uint8 array" VAL_BLK 0x3d02f4 __UBYTE_S 0 NO_COMPU_METHOD 0 255 ECU_ADDRESS_EXTENSION 0x80 MATRIX_DIM 12 1 1 /end CHARACTERISTIC
/begin CHARACTERISTIC CtApImageProcess_FreeRunning.PpImageProcess_ParkingLot_20ms.DeSVParkingSlot.gstSpaceRight[3].nValid "" VALUE 0x3d0300 __UBYTE_S 0 NO_COMPU_METHOD 0 255 ECU_ADDRESS_EXTENSION 0x80 /end CHARACTERISTIC
/begin CHARACTERISTIC CtApImageProcess_FreeRunning.PpImageProcess_ParkingLot_20ms.DeSVParkingSlot.gstSpaceRight[3].gfPos[0] "2 float32 array" VAL_BLK 0x3d0304 __FLOAT32_IEEE_S 0 NO_COMPU_METHOD 0 3.402823e+38 ECU_ADDRESS_EXTENSION 0x80 MATRIX_DIM 2 1 1 /end CHARACTERISTIC
/begin CHARACTERISTIC CtApImageProcess_FreeRunning.PpImageProcess_ParkingLot_20ms.DeSVParkingSlot.gstSpaceRight[3].gfPos[1] "2 float32 array" VAL_BLK 0x3d030c __FLOAT32_IEEE_S 0 NO_COMPU_METHOD 0 3.402823e+38 ECU_ADDRESS_EXTENSION 0x80 MATRIX_DIM 2 1 1 /end CHARACTERISTIC
/begin CHARACTERISTIC CtApImageProcess_FreeRunning.PpImageProcess_ParkingLot_20ms.DeSVParkingSlot.gstSpaceRight[3].gfPos[2] "2 float32 array" VAL_BLK 0x3d0314 __FLOAT32_IEEE_S 0 NO_COMPU_METHOD 0 3.402823e+38 ECU_ADDRESS_EXTENSION 0x80 MATRIX_DIM 2 1 1 /end CHARACTERISTIC
/begin CHARACTERISTIC CtApImageProcess_FreeRunning.PpImageProcess_ParkingLot_20ms.DeSVParkingSlot.gstSpaceRight[3].gfPos[3] "2 float32 array" VAL_BLK 0x3d031c __FLOAT32_IEEE_S 0 NO_COMPU_METHOD 0 3.402823e+38 ECU_ADDRESS_EXTENSION 0x80 MATRIX_DIM 2 1 1 /end CHARACTERISTIC
/begin CHARACTERISTIC CtApImageProcess_FreeRunning.PpImageProcess_ParkingLot_20ms.DeSVParkingSlot.gstSpaceRight[3].nQuality "" VALUE 0x3d0324 __UBYTE_S 0 NO_COMPU_METHOD 0 255 ECU_ADDRESS_EXTENSION 0x80 /end CHARACTERISTIC
/begin CHARACTERISTIC CtApImageProcess_FreeRunning.PpImageProcess_ParkingLot_20ms.DeSVParkingSlot.gstSpaceRight[3].nType "" VALUE 0x3d0325 __UBYTE_S 0 NO_COMPU_METHOD 0 255 ECU_ADDRESS_EXTENSION 0x80 /end CHARACTERISTIC
/begin CHARACTERISTIC CtApImageProcess_FreeRunning.PpImageProcess_ParkingLot_20ms.DeSVParkingSlot.gstSpaceRight[3].nParkingGarageID "" VALUE 0x3d0326 __UBYTE_S 0 NO_COMPU_METHOD 0 255 ECU_ADDRESS_EXTENSION 0x80 /end CHARACTERISTIC
/begin CHARACTERISTIC CtApImageProcess_FreeRunning.PpImageProcess_ParkingLot_20ms.DeSVParkingSlot.gstSpaceRight[3].fLineWith "" VALUE 0x3d0328 __FLOAT32_IEEE_S 0 NO_COMPU_METHOD 0 3.402823e+38 ECU_ADDRESS_EXTENSION 0x80 /end CHARACTERISTIC
/begin CHARACTERISTIC CtApImageProcess_FreeRunning.PpImageProcess_ParkingLot_20ms.DeSVParkingSlot.gstSpaceRight[3].fSita "" VALUE 0x3d032c __FLOAT32_IEEE_S 0 NO_COMPU_METHOD 0 3.402823e+38 ECU_ADDRESS_EXTENSION 0x80 /end CHARACTERISTIC
/begin CHARACTERISTIC CtApImageProcess_FreeRunning.PpImageProcess_ParkingLot_20ms.DeSVParkingSlot.gstSpaceRight[3].fIdentifierNum "2 uint32 array" VAL_BLK 0x3d0330 __ULONG_S 0 NO_COMPU_METHOD 0 4294967295 ECU_ADDRESS_EXTENSION 0x80 MATRIX_DIM 2 1 1 /end CHARACTERISTIC
/begin CHARACTERISTIC CtApImageProcess_FreeRunning.PpImageProcess_ParkingLot_20ms.DeSVParkingSlot.gstSpaceRight[3].fReserved "12 uint8 array" VAL_BLK 0x3d0338 __UBYTE_S 0 NO_COMPU_METHOD 0 255 ECU_ADDRESS_EXTENSION 0x80 MATRIX_DIM 12 1 1 /end CHARACTERISTIC
/begin CHARACTERISTIC CtApImageProcess_FreeRunning.PpImageProcess_ParkingLot_20ms.DeSVParkingSlot.gstSpaceRight[4].nValid "" VALUE 0x3d0344 __UBYTE_S 0 NO_COMPU_METHOD 0 255 ECU_ADDRESS_EXTENSION 0x80 /end CHARACTERISTIC
/begin CHARACTERISTIC CtApImageProcess_FreeRunning.PpImageProcess_ParkingLot_20ms.DeSVParkingSlot.gstSpaceRight[4].gfPos[0] "2 float32 array" VAL_BLK 0x3d0348 __FLOAT32_IEEE_S 0 NO_COMPU_METHOD 0 3.402823e+38 ECU_ADDRESS_EXTENSION 0x80 MATRIX_DIM 2 1 1 /end CHARACTERISTIC
/begin CHARACTERISTIC CtApImageProcess_FreeRunning.PpImageProcess_ParkingLot_20ms.DeSVParkingSlot.gstSpaceRight[4].gfPos[1] "2 float32 array" VAL_BLK 0x3d0350 __FLOAT32_IEEE_S 0 NO_COMPU_METHOD 0 3.402823e+38 ECU_ADDRESS_EXTENSION 0x80 MATRIX_DIM 2 1 1 /end CHARACTERISTIC
/begin CHARACTERISTIC CtApImageProcess_FreeRunning.PpImageProcess_ParkingLot_20ms.DeSVParkingSlot.gstSpaceRight[4].gfPos[2] "2 float32 array" VAL_BLK 0x3d0358 __FLOAT32_IEEE_S 0 NO_COMPU_METHOD 0 3.402823e+38 ECU_ADDRESS_EXTENSION 0x80 MATRIX_DIM 2 1 1 /end CHARACTERISTIC
/begin CHARACTERISTIC CtApImageProcess_FreeRunning.PpImageProcess_ParkingLot_20ms.DeSVParkingSlot.gstSpaceRight[4].gfPos[3] "2 float32 array" VAL_BLK 0x3d0360 __FLOAT32_IEEE_S 0 NO_COMPU_METHOD 0 3.402823e+38 ECU_ADDRESS_EXTENSION 0x80 MATRIX_DIM 2 1 1 /end CHARACTERISTIC
/begin CHARACTERISTIC CtApImageProcess_FreeRunning.PpImageProcess_ParkingLot_20ms.DeSVParkingSlot.gstSpaceRight[4].nQuality "" VALUE 0x3d0368 __UBYTE_S 0 NO_COMPU_METHOD 0 255 ECU_ADDRESS_EXTENSION 0x80 /end CHARACTERISTIC
/begin CHARACTERISTIC CtApImageProcess_FreeRunning.PpImageProcess_ParkingLot_20ms.DeSVParkingSlot.gstSpaceRight[4].nType "" VALUE 0x3d0369 __UBYTE_S 0 NO_COMPU_METHOD 0 255 ECU_ADDRESS_EXTENSION 0x80 /end CHARACTERISTIC
/begin CHARACTERISTIC CtApImageProcess_FreeRunning.PpImageProcess_ParkingLot_20ms.DeSVParkingSlot.gstSpaceRight[4].nParkingGarageID "" VALUE 0x3d036a __UBYTE_S 0 NO_COMPU_METHOD 0 255 ECU_ADDRESS_EXTENSION 0x80 /end CHARACTERISTIC
/begin CHARACTERISTIC CtApImageProcess_FreeRunning.PpImageProcess_ParkingLot_20ms.DeSVParkingSlot.gstSpaceRight[4].fLineWith "" VALUE 0x3d036c __FLOAT32_IEEE_S 0 NO_COMPU_METHOD 0 3.402823e+38 ECU_ADDRESS_EXTENSION 0x80 /end CHARACTERISTIC
/begin CHARACTERISTIC CtApImageProcess_FreeRunning.PpImageProcess_ParkingLot_20ms.DeSVParkingSlot.gstSpaceRight[4].fSita "" VALUE 0x3d0370 __FLOAT32_IEEE_S 0 NO_COMPU_METHOD 0 3.402823e+38 ECU_ADDRESS_EXTENSION 0x80 /end CHARACTERISTIC
/begin CHARACTERISTIC CtApImageProcess_FreeRunning.PpImageProcess_ParkingLot_20ms.DeSVParkingSlot.gstSpaceRight[4].fIdentifierNum "2 uint32 array" VAL_BLK 0x3d0374 __ULONG_S 0 NO_COMPU_METHOD 0 4294967295 ECU_ADDRESS_EXTENSION 0x80 MATRIX_DIM 2 1 1 /end CHARACTERISTIC
/begin CHARACTERISTIC CtApImageProcess_FreeRunning.PpImageProcess_ParkingLot_20ms.DeSVParkingSlot.gstSpaceRight[4].fReserved "12 uint8 array" VAL_BLK 0x3d037c __UBYTE_S 0 NO_COMPU_METHOD 0 255 ECU_ADDRESS_EXTENSION 0x80 MATRIX_DIM 12 1 1 /end CHARACTERISTIC
/begin CHARACTERISTIC CtApImageProcess_FreeRunning.PpImageProcess_ParkingLot_20ms.DeSVParkingSlot.gstSpaceRight[5].nValid "" VALUE 0x3d0388 __UBYTE_S 0 NO_COMPU_METHOD 0 255 ECU_ADDRESS_EXTENSION 0x80 /end CHARACTERISTIC
/begin CHARACTERISTIC CtApImageProcess_FreeRunning.PpImageProcess_ParkingLot_20ms.DeSVParkingSlot.gstSpaceRight[5].gfPos[0] "2 float32 array" VAL_BLK 0x3d038c __FLOAT32_IEEE_S 0 NO_COMPU_METHOD 0 3.402823e+38 ECU_ADDRESS_EXTENSION 0x80 MATRIX_DIM 2 1 1 /end CHARACTERISTIC
/begin CHARACTERISTIC CtApImageProcess_FreeRunning.PpImageProcess_ParkingLot_20ms.DeSVParkingSlot.gstSpaceRight[5].gfPos[1] "2 float32 array" VAL_BLK 0x3d0394 __FLOAT32_IEEE_S 0 NO_COMPU_METHOD 0 3.402823e+38 ECU_ADDRESS_EXTENSION 0x80 MATRIX_DIM 2 1 1 /end CHARACTERISTIC
/begin CHARACTERISTIC CtApImageProcess_FreeRunning.PpImageProcess_ParkingLot_20ms.DeSVParkingSlot.gstSpaceRight[5].gfPos[2] "2 float32 array" VAL_BLK 0x3d039c __FLOAT32_IEEE_S 0 NO_COMPU_METHOD 0 3.402823e+38 ECU_ADDRESS_EXTENSION 0x80 MATRIX_DIM 2 1 1 /end CHARACTERISTIC
/begin CHARACTERISTIC CtApImageProcess_FreeRunning.PpImageProcess_ParkingLot_20ms.DeSVParkingSlot.gstSpaceRight[5].gfPos[3] "2 float32 array" VAL_BLK 0x3d03a4 __FLOAT32_IEEE_S 0 NO_COMPU_METHOD 0 3.402823e+38 ECU_ADDRESS_EXTENSION 0x80 MATRIX_DIM 2 1 1 /end CHARACTERISTIC
/begin CHARACTERISTIC CtApImageProcess_FreeRunning.PpImageProcess_ParkingLot_20ms.DeSVParkingSlot.gstSpaceRight[5].nQuality "" VALUE 0x3d03ac __UBYTE_S 0 NO_COMPU_METHOD 0 255 ECU_ADDRESS_EXTENSION 0x80 /end CHARACTERISTIC
/begin CHARACTERISTIC CtApImageProcess_FreeRunning.PpImageProcess_ParkingLot_20ms.DeSVParkingSlot.gstSpaceRight[5].nType "" VALUE 0x3d03ad __UBYTE_S 0 NO_COMPU_METHOD 0 255 ECU_ADDRESS_EXTENSION 0x80 /end CHARACTERISTIC
/begin CHARACTERISTIC CtApImageProcess_FreeRunning.PpImageProcess_ParkingLot_20ms.DeSVParkingSlot.gstSpaceRight[5].nParkingGarageID "" VALUE 0x3d03ae __UBYTE_S 0 NO_COMPU_METHOD 0 255 ECU_ADDRESS_EXTENSION 0x80 /end CHARACTERISTIC
/begin CHARACTERISTIC CtApImageProcess_FreeRunning.PpImageProcess_ParkingLot_20ms.DeSVParkingSlot.gstSpaceRight[5].fLineWith "" VALUE 0x3d03b0 __FLOAT32_IEEE_S 0 NO_COMPU_METHOD 0 3.402823e+38 ECU_ADDRESS_EXTENSION 0x80 /end CHARACTERISTIC
/begin CHARACTERISTIC CtApImageProcess_FreeRunning.PpImageProcess_ParkingLot_20ms.DeSVParkingSlot.gstSpaceRight[5].fSita "" VALUE 0x3d03b4 __FLOAT32_IEEE_S 0 NO_COMPU_METHOD 0 3.402823e+38 ECU_ADDRESS_EXTENSION 0x80 /end CHARACTERISTIC
/begin CHARACTERISTIC CtApImageProcess_FreeRunning.PpImageProcess_ParkingLot_20ms.DeSVParkingSlot.gstSpaceRight[5].fIdentifierNum "2 uint32 array" VAL_BLK 0x3d03b8 __ULONG_S 0 NO_COMPU_METHOD 0 4294967295 ECU_ADDRESS_EXTENSION 0x80 MATRIX_DIM 2 1 1 /end CHARACTERISTIC
/begin CHARACTERISTIC CtApImageProcess_FreeRunning.PpImageProcess_ParkingLot_20ms.DeSVParkingSlot.gstSpaceRight[5].fReserved "12 uint8 array" VAL_BLK 0x3d03c0 __UBYTE_S 0 NO_COMPU_METHOD 0 255 ECU_ADDRESS_EXTENSION 0x80 MATRIX_DIM 12 1 1 /end CHARACTERISTIC
/begin CHARACTERISTIC CtApImageProcess_FreeRunning.PpImageProcess_ParkingLot_20ms.DeSVParkingSlot.gstSpaceRight[6].nValid "" VALUE 0x3d03cc __UBYTE_S 0 NO_COMPU_METHOD 0 255 ECU_ADDRESS_EXTENSION 0x80 /end CHARACTERISTIC
/begin CHARACTERISTIC CtApImageProcess_FreeRunning.PpImageProcess_ParkingLot_20ms.DeSVParkingSlot.gstSpaceRight[6].gfPos[0] "2 float32 array" VAL_BLK 0x3d03d0 __FLOAT32_IEEE_S 0 NO_COMPU_METHOD 0 3.402823e+38 ECU_ADDRESS_EXTENSION 0x80 MATRIX_DIM 2 1 1 /end CHARACTERISTIC
/begin CHARACTERISTIC CtApImageProcess_FreeRunning.PpImageProcess_ParkingLot_20ms.DeSVParkingSlot.gstSpaceRight[6].gfPos[1] "2 float32 array" VAL_BLK 0x3d03d8 __FLOAT32_IEEE_S 0 NO_COMPU_METHOD 0 3.402823e+38 ECU_ADDRESS_EXTENSION 0x80 MATRIX_DIM 2 1 1 /end CHARACTERISTIC
/begin CHARACTERISTIC CtApImageProcess_FreeRunning.PpImageProcess_ParkingLot_20ms.DeSVParkingSlot.gstSpaceRight[6].gfPos[2] "2 float32 array" VAL_BLK 0x3d03e0 __FLOAT32_IEEE_S 0 NO_COMPU_METHOD 0 3.402823e+38 ECU_ADDRESS_EXTENSION 0x80 MATRIX_DIM 2 1 1 /end CHARACTERISTIC
/begin CHARACTERISTIC CtApImageProcess_FreeRunning.PpImageProcess_ParkingLot_20ms.DeSVParkingSlot.gstSpaceRight[6].gfPos[3] "2 float32 array" VAL_BLK 0x3d03e8 __FLOAT32_IEEE_S 0 NO_COMPU_METHOD 0 3.402823e+38 ECU_ADDRESS_EXTENSION 0x80 MATRIX_DIM 2 1 1 /end CHARACTERISTIC
/begin CHARACTERISTIC CtApImageProcess_FreeRunning.PpImageProcess_ParkingLot_20ms.DeSVParkingSlot.gstSpaceRight[6].nQuality "" VALUE 0x3d03f0 __UBYTE_S 0 NO_COMPU_METHOD 0 255 ECU_ADDRESS_EXTENSION 0x80 /end CHARACTERISTIC
/begin CHARACTERISTIC CtApImageProcess_FreeRunning.PpImageProcess_ParkingLot_20ms.DeSVParkingSlot.gstSpaceRight[6].nType "" VALUE 0x3d03f1 __UBYTE_S 0 NO_COMPU_METHOD 0 255 ECU_ADDRESS_EXTENSION 0x80 /end CHARACTERISTIC
/begin CHARACTERISTIC CtApImageProcess_FreeRunning.PpImageProcess_ParkingLot_20ms.DeSVParkingSlot.gstSpaceRight[6].nParkingGarageID "" VALUE 0x3d03f2 __UBYTE_S 0 NO_COMPU_METHOD 0 255 ECU_ADDRESS_EXTENSION 0x80 /end CHARACTERISTIC
/begin CHARACTERISTIC CtApImageProcess_FreeRunning.PpImageProcess_ParkingLot_20ms.DeSVParkingSlot.gstSpaceRight[6].fLineWith "" VALUE 0x3d03f4 __FLOAT32_IEEE_S 0 NO_COMPU_METHOD 0 3.402823e+38 ECU_ADDRESS_EXTENSION 0x80 /end CHARACTERISTIC
/begin CHARACTERISTIC CtApImageProcess_FreeRunning.PpImageProcess_ParkingLot_20ms.DeSVParkingSlot.gstSpaceRight[6].fSita "" VALUE 0x3d03f8 __FLOAT32_IEEE_S 0 NO_COMPU_METHOD 0 3.402823e+38 ECU_ADDRESS_EXTENSION 0x80 /end CHARACTERISTIC
/begin CHARACTERISTIC CtApImageProcess_FreeRunning.PpImageProcess_ParkingLot_20ms.DeSVParkingSlot.gstSpaceRight[6].fIdentifierNum "2 uint32 array" VAL_BLK 0x3d03fc __ULONG_S 0 NO_COMPU_METHOD 0 4294967295 ECU_ADDRESS_EXTENSION 0x80 MATRIX_DIM 2 1 1 /end CHARACTERISTIC
/begin CHARACTERISTIC CtApImageProcess_FreeRunning.PpImageProcess_ParkingLot_20ms.DeSVParkingSlot.gstSpaceRight[6].fReserved "12 uint8 array" VAL_BLK 0x3d0404 __UBYTE_S 0 NO_COMPU_METHOD 0 255 ECU_ADDRESS_EXTENSION 0x80 MATRIX_DIM 12 1 1 /end CHARACTERISTIC
/begin CHARACTERISTIC CtApImageProcess_FreeRunning.PpImageProcess_ParkingLot_20ms.DeSVParkingSlot.gstSpaceRight[7].nValid "" VALUE 0x3d0410 __UBYTE_S 0 NO_COMPU_METHOD 0 255 ECU_ADDRESS_EXTENSION 0x80 /end CHARACTERISTIC
/begin CHARACTERISTIC CtApImageProcess_FreeRunning.PpImageProcess_ParkingLot_20ms.DeSVParkingSlot.gstSpaceRight[7].gfPos[0] "2 float32 array" VAL_BLK 0x3d0414 __FLOAT32_IEEE_S 0 NO_COMPU_METHOD 0 3.402823e+38 ECU_ADDRESS_EXTENSION 0x80 MATRIX_DIM 2 1 1 /end CHARACTERISTIC
/begin CHARACTERISTIC CtApImageProcess_FreeRunning.PpImageProcess_ParkingLot_20ms.DeSVParkingSlot.gstSpaceRight[7].gfPos[1] "2 float32 array" VAL_BLK 0x3d041c __FLOAT32_IEEE_S 0 NO_COMPU_METHOD 0 3.402823e+38 ECU_ADDRESS_EXTENSION 0x80 MATRIX_DIM 2 1 1 /end CHARACTERISTIC
/begin CHARACTERISTIC CtApImageProcess_FreeRunning.PpImageProcess_ParkingLot_20ms.DeSVParkingSlot.gstSpaceRight[7].gfPos[2] "2 float32 array" VAL_BLK 0x3d0424 __FLOAT32_IEEE_S 0 NO_COMPU_METHOD 0 3.402823e+38 ECU_ADDRESS_EXTENSION 0x80 MATRIX_DIM 2 1 1 /end CHARACTERISTIC
/begin CHARACTERISTIC CtApImageProcess_FreeRunning.PpImageProcess_ParkingLot_20ms.DeSVParkingSlot.gstSpaceRight[7].gfPos[3] "2 float32 array" VAL_BLK 0x3d042c __FLOAT32_IEEE_S 0 NO_COMPU_METHOD 0 3.402823e+38 ECU_ADDRESS_EXTENSION 0x80 MATRIX_DIM 2 1 1 /end CHARACTERISTIC
/begin CHARACTERISTIC CtApImageProcess_FreeRunning.PpImageProcess_ParkingLot_20ms.DeSVParkingSlot.gstSpaceRight[7].nQuality "" VALUE 0x3d0434 __UBYTE_S 0 NO_COMPU_METHOD 0 255 ECU_ADDRESS_EXTENSION 0x80 /end CHARACTERISTIC
/begin CHARACTERISTIC CtApImageProcess_FreeRunning.PpImageProcess_ParkingLot_20ms.DeSVParkingSlot.gstSpaceRight[7].nType "" VALUE 0x3d0435 __UBYTE_S 0 NO_COMPU_METHOD 0 255 ECU_ADDRESS_EXTENSION 0x80 /end CHARACTERISTIC
/begin CHARACTERISTIC CtApImageProcess_FreeRunning.PpImageProcess_ParkingLot_20ms.DeSVParkingSlot.gstSpaceRight[7].nParkingGarageID "" VALUE 0x3d0436 __UBYTE_S 0 NO_COMPU_METHOD 0 255 ECU_ADDRESS_EXTENSION 0x80 /end CHARACTERISTIC
/begin CHARACTERISTIC CtApImageProcess_FreeRunning.PpImageProcess_ParkingLot_20ms.DeSVParkingSlot.gstSpaceRight[7].fLineWith "" VALUE 0x3d0438 __FLOAT32_IEEE_S 0 NO_COMPU_METHOD 0 3.402823e+38 ECU_ADDRESS_EXTENSION 0x80 /end CHARACTERISTIC
/begin CHARACTERISTIC CtApImageProcess_FreeRunning.PpImageProcess_ParkingLot_20ms.DeSVParkingSlot.gstSpaceRight[7].fSita "" VALUE 0x3d043c __FLOAT32_IEEE_S 0 NO_COMPU_METHOD 0 3.402823e+38 ECU_ADDRESS_EXTENSION 0x80 /end CHARACTERISTIC
/begin CHARACTERISTIC CtApImageProcess_FreeRunning.PpImageProcess_ParkingLot_20ms.DeSVParkingSlot.gstSpaceRight[7].fIdentifierNum "2 uint32 array" VAL_BLK 0x3d0440 __ULONG_S 0 NO_COMPU_METHOD 0 4294967295 ECU_ADDRESS_EXTENSION 0x80 MATRIX_DIM 2 1 1 /end CHARACTERISTIC
/begin CHARACTERISTIC CtApImageProcess_FreeRunning.PpImageProcess_ParkingLot_20ms.DeSVParkingSlot.gstSpaceRight[7].fReserved "12 uint8 array" VAL_BLK 0x3d0448 __UBYTE_S 0 NO_COMPU_METHOD 0 255 ECU_ADDRESS_EXTENSION 0x80 MATRIX_DIM 12 1 1 /end CHARACTERISTIC
/begin CHARACTERISTIC CtApImageProcess_FreeRunning.PpImageProcess_ParkingLot_20ms.DeSVParkingSlot.gstSpaceLeft[0].nValid "" VALUE 0x3d0454 __UBYTE_S 0 NO_COMPU_METHOD 0 255 ECU_ADDRESS_EXTENSION 0x80 /end CHARACTERISTIC
/begin CHARACTERISTIC CtApImageProcess_FreeRunning.PpImageProcess_ParkingLot_20ms.DeSVParkingSlot.gstSpaceLeft[0].gfPos[0] "2 float32 array" VAL_BLK 0x3d0458 __FLOAT32_IEEE_S 0 NO_COMPU_METHOD 0 3.402823e+38 ECU_ADDRESS_EXTENSION 0x80 MATRIX_DIM 2 1 1 /end CHARACTERISTIC
/begin CHARACTERISTIC CtApImageProcess_FreeRunning.PpImageProcess_ParkingLot_20ms.DeSVParkingSlot.gstSpaceLeft[0].gfPos[1] "2 float32 array" VAL_BLK 0x3d0460 __FLOAT32_IEEE_S 0 NO_COMPU_METHOD 0 3.402823e+38 ECU_ADDRESS_EXTENSION 0x80 MATRIX_DIM 2 1 1 /end CHARACTERISTIC
/begin CHARACTERISTIC CtApImageProcess_FreeRunning.PpImageProcess_ParkingLot_20ms.DeSVParkingSlot.gstSpaceLeft[0].gfPos[2] "2 float32 array" VAL_BLK 0x3d0468 __FLOAT32_IEEE_S 0 NO_COMPU_METHOD 0 3.402823e+38 ECU_ADDRESS_EXTENSION 0x80 MATRIX_DIM 2 1 1 /end CHARACTERISTIC
/begin CHARACTERISTIC CtApImageProcess_FreeRunning.PpImageProcess_ParkingLot_20ms.DeSVParkingSlot.gstSpaceLeft[0].gfPos[3] "2 float32 array" VAL_BLK 0x3d0470 __FLOAT32_IEEE_S 0 NO_COMPU_METHOD 0 3.402823e+38 ECU_ADDRESS_EXTENSION 0x80 MATRIX_DIM 2 1 1 /end CHARACTERISTIC
/begin CHARACTERISTIC CtApImageProcess_FreeRunning.PpImageProcess_ParkingLot_20ms.DeSVParkingSlot.gstSpaceLeft[0].nQuality "" VALUE 0x3d0478 __UBYTE_S 0 NO_COMPU_METHOD 0 255 ECU_ADDRESS_EXTENSION 0x80 /end CHARACTERISTIC
/begin CHARACTERISTIC CtApImageProcess_FreeRunning.PpImageProcess_ParkingLot_20ms.DeSVParkingSlot.gstSpaceLeft[0].nType "" VALUE 0x3d0479 __UBYTE_S 0 NO_COMPU_METHOD 0 255 ECU_ADDRESS_EXTENSION 0x80 /end CHARACTERISTIC
/begin CHARACTERISTIC CtApImageProcess_FreeRunning.PpImageProcess_ParkingLot_20ms.DeSVParkingSlot.gstSpaceLeft[0].nParkingGarageID "" VALUE 0x3d047a __UBYTE_S 0 NO_COMPU_METHOD 0 255 ECU_ADDRESS_EXTENSION 0x80 /end CHARACTERISTIC
/begin CHARACTERISTIC CtApImageProcess_FreeRunning.PpImageProcess_ParkingLot_20ms.DeSVParkingSlot.gstSpaceLeft[0].fLineWith "" VALUE 0x3d047c __FLOAT32_IEEE_S 0 NO_COMPU_METHOD 0 3.402823e+38 ECU_ADDRESS_EXTENSION 0x80 /end CHARACTERISTIC
/begin CHARACTERISTIC CtApImageProcess_FreeRunning.PpImageProcess_ParkingLot_20ms.DeSVParkingSlot.gstSpaceLeft[0].fSita "" VALUE 0x3d0480 __FLOAT32_IEEE_S 0 NO_COMPU_METHOD 0 3.402823e+38 ECU_ADDRESS_EXTENSION 0x80 /end CHARACTERISTIC
/begin CHARACTERISTIC CtApImageProcess_FreeRunning.PpImageProcess_ParkingLot_20ms.DeSVParkingSlot.gstSpaceLeft[0].fIdentifierNum "2 uint32 array" VAL_BLK 0x3d0484 __ULONG_S 0 NO_COMPU_METHOD 0 4294967295 ECU_ADDRESS_EXTENSION 0x80 MATRIX_DIM 2 1 1 /end CHARACTERISTIC
/begin CHARACTERISTIC CtApImageProcess_FreeRunning.PpImageProcess_ParkingLot_20ms.DeSVParkingSlot.gstSpaceLeft[0].fReserved "12 uint8 array" VAL_BLK 0x3d048c __UBYTE_S 0 NO_COMPU_METHOD 0 255 ECU_ADDRESS_EXTENSION 0x80 MATRIX_DIM 12 1 1 /end CHARACTERISTIC
/begin CHARACTERISTIC CtApImageProcess_FreeRunning.PpImageProcess_ParkingLot_20ms.DeSVParkingSlot.gstSpaceLeft[1].nValid "" VALUE 0x3d0498 __UBYTE_S 0 NO_COMPU_METHOD 0 255 ECU_ADDRESS_EXTENSION 0x80 /end CHARACTERISTIC
/begin CHARACTERISTIC CtApImageProcess_FreeRunning.PpImageProcess_ParkingLot_20ms.DeSVParkingSlot.gstSpaceLeft[1].gfPos[0] "2 float32 array" VAL_BLK 0x3d049c __FLOAT32_IEEE_S 0 NO_COMPU_METHOD 0 3.402823e+38 ECU_ADDRESS_EXTENSION 0x80 MATRIX_DIM 2 1 1 /end CHARACTERISTIC
/begin CHARACTERISTIC CtApImageProcess_FreeRunning.PpImageProcess_ParkingLot_20ms.DeSVParkingSlot.gstSpaceLeft[1].gfPos[1] "2 float32 array" VAL_BLK 0x3d04a4 __FLOAT32_IEEE_S 0 NO_COMPU_METHOD 0 3.402823e+38 ECU_ADDRESS_EXTENSION 0x80 MATRIX_DIM 2 1 1 /end CHARACTERISTIC
/begin CHARACTERISTIC CtApImageProcess_FreeRunning.PpImageProcess_ParkingLot_20ms.DeSVParkingSlot.gstSpaceLeft[1].gfPos[2] "2 float32 array" VAL_BLK 0x3d04ac __FLOAT32_IEEE_S 0 NO_COMPU_METHOD 0 3.402823e+38 ECU_ADDRESS_EXTENSION 0x80 MATRIX_DIM 2 1 1 /end CHARACTERISTIC
/begin CHARACTERISTIC CtApImageProcess_FreeRunning.PpImageProcess_ParkingLot_20ms.DeSVParkingSlot.gstSpaceLeft[1].gfPos[3] "2 float32 array" VAL_BLK 0x3d04b4 __FLOAT32_IEEE_S 0 NO_COMPU_METHOD 0 3.402823e+38 ECU_ADDRESS_EXTENSION 0x80 MATRIX_DIM 2 1 1 /end CHARACTERISTIC
/begin CHARACTERISTIC CtApImageProcess_FreeRunning.PpImageProcess_ParkingLot_20ms.DeSVParkingSlot.gstSpaceLeft[1].nQuality "" VALUE 0x3d04bc __UBYTE_S 0 NO_COMPU_METHOD 0 255 ECU_ADDRESS_EXTENSION 0x80 /end CHARACTERISTIC
/begin CHARACTERISTIC CtApImageProcess_FreeRunning.PpImageProcess_ParkingLot_20ms.DeSVParkingSlot.gstSpaceLeft[1].nType "" VALUE 0x3d04bd __UBYTE_S 0 NO_COMPU_METHOD 0 255 ECU_ADDRESS_EXTENSION 0x80 /end CHARACTERISTIC
/begin CHARACTERISTIC CtApImageProcess_FreeRunning.PpImageProcess_ParkingLot_20ms.DeSVParkingSlot.gstSpaceLeft[1].nParkingGarageID "" VALUE 0x3d04be __UBYTE_S 0 NO_COMPU_METHOD 0 255 ECU_ADDRESS_EXTENSION 0x80 /end CHARACTERISTIC
/begin GROUP CtApImageProcess_FreeRunning_xcp_kvs_group "MotinWise KVS characteristic group" ROOT
 /begin REF_CHARACTERISTIC CtApImageProcess_FreeRunning.PpImageProcess_Obstacle_60ms.DeObstacle.gstObjects[3].fAbsValY CtApImageProcess_FreeRunning.PpImageProcess_Obstacle_60ms.DeObstacle.gstObjects[3].nPoint1OnCar CtApImageProcess_FreeRunning.PpImageProcess_Obstacle_60ms.DeObstacle.gstObjects[3].nPoint2OnCar CtApImageProcess_FreeRunning.PpImageProcess_Obstacle_60ms.DeObstacle.gstObjects[3].fReserved CtApImageProcess_FreeRunning.PpImageProcess_Obstacle_60ms.DeObstacle.gstObjects[3].n3D CtApImageProcess_FreeRunning.PpImageProcess_Obstacle_60ms.DeObstacle.gstObjects[3].fPoint3X CtApImageProcess_FreeRunning.PpImageProcess_Obstacle_60ms.DeObstacle.gstObjects[3].fPoint3Y CtApImageProcess_FreeRunning.PpImageProcess_Obstacle_60ms.DeObstacle.gstObjects[3].fPoint4X CtApImageProcess_FreeRunning.PpImageProcess_Obstacle_60ms.DeObstacle.gstObjects[3].fPoint4Y CtApImageProcess_FreeRunning.PpImageProcess_Obstacle_60ms.DeObstacle.gstObjects[4].nObjectID CtApImageProcess_FreeRunning.PpImageProcess_Obstacle_60ms.DeObstacle.gstObjects[4].nType CtApImageProcess_FreeRunning.PpImageProcess_Obstacle_60ms.DeObstacle.gstObjects[4].nAge CtApImageProcess_FreeRunning.PpImageProcess_Obstacle_60ms.DeObstacle.gstObjects[4].nQuality CtApImageProcess_FreeRunning.PpImageProcess_Obstacle_60ms.DeObstacle.gstObjects[4].fHeight CtApImageProcess_FreeRunning.PpImageProcess_Obstacle_60ms.DeObstacle.gstObjects[4].fPiont1X CtApImageProcess_FreeRunning.PpImageProcess_Obstacle_60ms.DeObstacle.gstObjects[4].fPiont1Y CtApImageProcess_FreeRunning.PpImageProcess_Obstacle_60ms.DeObstacle.gstObjects[4].fPiont2X CtApImageProcess_FreeRunning.PpImageProcess_Obstacle_60ms.DeObstacle.gstObjects[4].fPiont2Y CtApImageProcess_FreeRunning.PpImageProcess_Obstacle_60ms.DeObstacle.gstObjects[4].fRelVelocityX CtApImageProcess_FreeRunning.PpImageProcess_Obstacle_60ms.DeObstacle.gstObjects[4].fRelVelocityY CtApImageProcess_FreeRunning.PpImageProcess_Obstacle_60ms.DeObstacle.gstObjects[4].fAblVelocityX CtApImageProcess_FreeRunning.PpImageProcess_Obstacle_60ms.DeObstacle.gstObjects[4].fAblVelocityY CtApImageProcess_FreeRunning.PpImageProcess_Obstacle_60ms.DeObstacle.gstObjects[4].fAbsValY CtApImageProcess_FreeRunning.PpImageProcess_Obstacle_60ms.DeObstacle.gstObjects[4].nPoint1OnCar CtApImageProcess_FreeRunning.PpImageProcess_Obstacle_60ms.DeObstacle.gstObjects[4].nPoint2OnCar CtApImageProcess_FreeRunning.PpImageProcess_Obstacle_60ms.DeObstacle.gstObjects[4].fReserved CtApImageProcess_FreeRunning.PpImageProcess_Obstacle_60ms.DeObstacle.gstObjects[4].n3D CtApImageProcess_FreeRunning.PpImageProcess_Obstacle_60ms.DeObstacle.gstObjects[4].fPoint3X CtApImageProcess_FreeRunning.PpImageProcess_Obstacle_60ms.DeObstacle.gstObjects[4].fPoint3Y CtApImageProcess_FreeRunning.PpImageProcess_Obstacle_60ms.DeObstacle.gstObjects[4].fPoint4X CtApImageProcess_FreeRunning.PpImageProcess_Obstacle_60ms.DeObstacle.gstObjects[4].fPoint4Y CtApImageProcess_FreeRunning.PpImageProcess_Obstacle_60ms.DeObstacle.gstObjects[5].nObjectID CtApImageProcess_FreeRunning.PpImageProcess_Obstacle_60ms.DeObstacle.gstObjects[5].nType CtApImageProcess_FreeRunning.PpImageProcess_Obstacle_60ms.DeObstacle.gstObjects[5].nAge CtApImageProcess_FreeRunning.PpImageProcess_Obstacle_60ms.DeObstacle.gstObjects[5].nQuality CtApImageProcess_FreeRunning.PpImageProcess_Obstacle_60ms.DeObstacle.gstObjects[5].fHeight CtApImageProcess_FreeRunning.PpImageProcess_Obstacle_60ms.DeObstacle.gstObjects[5].fPiont1X CtApImageProcess_FreeRunning.PpImageProcess_Obstacle_60ms.DeObstacle.gstObjects[5].fPiont1Y CtApImageProcess_FreeRunning.PpImageProcess_Obstacle_60ms.DeObstacle.gstObjects[5].fPiont2X CtApImageProcess_FreeRunning.PpImageProcess_Obstacle_60ms.DeObstacle.gstObjects[5].fPiont2Y CtApImageProcess_FreeRunning.PpImageProcess_Obstacle_60ms.DeObstacle.gstObjects[5].fRelVelocityX CtApImageProcess_FreeRunning.PpImageProcess_Obstacle_60ms.DeObstacle.gstObjects[5].fRelVelocityY CtApImageProcess_FreeRunning.PpImageProcess_Obstacle_60ms.DeObstacle.gstObjects[5].fAblVelocityX CtApImageProcess_FreeRunning.PpImageProcess_Obstacle_60ms.DeObstacle.gstObjects[5].fAblVelocityY CtApImageProcess_FreeRunning.PpImageProcess_Obstacle_60ms.DeObstacle.gstObjects[5].fAbsValY CtApImageProcess_FreeRunning.PpImageProcess_Obstacle_60ms.DeObstacle.gstObjects[5].nPoint1OnCar CtApImageProcess_FreeRunning.PpImageProcess_Obstacle_60ms.DeObstacle.gstObjects[5].nPoint2OnCar CtApImageProcess_FreeRunning.PpImageProcess_Obstacle_60ms.DeObstacle.gstObjects[5].fReserved CtApImageProcess_FreeRunning.PpImageProcess_Obstacle_60ms.DeObstacle.gstObjects[5].n3D CtApImageProcess_FreeRunning.PpImageProcess_Obstacle_60ms.DeObstacle.gstObjects[5].fPoint3X CtApImageProcess_FreeRunning.PpImageProcess_Obstacle_60ms.DeObstacle.gstObjects[5].fPoint3Y CtApImageProcess_FreeRunning.PpImageProcess_Obstacle_60ms.DeObstacle.gstObjects[5].fPoint4X CtApImageProcess_FreeRunning.PpImageProcess_Obstacle_60ms.DeObstacle.gstObjects[5].fPoint4Y CtApImageProcess_FreeRunning.PpImageProcess_Obstacle_60ms.DeObstacle.gstObjects[6].nObjectID CtApImageProcess_FreeRunning.PpImageProcess_Obstacle_60ms.DeObstacle.gstObjects[6].nType CtApImageProcess_FreeRunning.PpImageProcess_Obstacle_60ms.DeObstacle.gstObjects[6].nAge CtApImageProcess_FreeRunning.PpImageProcess_Obstacle_60ms.DeObstacle.gstObjects[6].nQuality CtApImageProcess_FreeRunning.PpImageProcess_Obstacle_60ms.DeObstacle.gstObjects[6].fHeight CtApImageProcess_FreeRunning.PpImageProcess_Obstacle_60ms.DeObstacle.gstObjects[6].fPiont1X CtApImageProcess_FreeRunning.PpImageProcess_Obstacle_60ms.DeObstacle.gstObjects[6].fPiont1Y CtApImageProcess_FreeRunning.PpImageProcess_Obstacle_60ms.DeObstacle.gstObjects[6].fPiont2X CtApImageProcess_FreeRunning.PpImageProcess_Obstacle_60ms.DeObstacle.gstObjects[6].fPiont2Y CtApImageProcess_FreeRunning.PpImageProcess_Obstacle_60ms.DeObstacle.gstObjects[6].fRelVelocityX CtApImageProcess_FreeRunning.PpImageProcess_Obstacle_60ms.DeObstacle.gstObjects[6].fRelVelocityY CtApImageProcess_FreeRunning.PpImageProcess_Obstacle_60ms.DeObstacle.gstObjects[6].fAblVelocityX CtApImageProcess_FreeRunning.PpImageProcess_Obstacle_60ms.DeObstacle.gstObjects[6].fAblVelocityY CtApImageProcess_FreeRunning.PpImageProcess_Obstacle_60ms.DeObstacle.gstObjects[6].fAbsValY CtApImageProcess_FreeRunning.PpImageProcess_Obstacle_60ms.DeObstacle.gstObjects[6].nPoint1OnCar CtApImageProcess_FreeRunning.PpImageProcess_Obstacle_60ms.DeObstacle.gstObjects[6].nPoint2OnCar CtApImageProcess_FreeRunning.PpImageProcess_Obstacle_60ms.DeObstacle.gstObjects[6].fReserved CtApImageProcess_FreeRunning.PpImageProcess_Obstacle_60ms.DeObstacle.gstObjects[6].n3D CtApImageProcess_FreeRunning.PpImageProcess_Obstacle_60ms.DeObstacle.gstObjects[6].fPoint3X CtApImageProcess_FreeRunning.PpImageProcess_Obstacle_60ms.DeObstacle.gstObjects[6].fPoint3Y CtApImageProcess_FreeRunning.PpImageProcess_Obstacle_60ms.DeObstacle.gstObjects[6].fPoint4X CtApImageProcess_FreeRunning.PpImageProcess_Obstacle_60ms.DeObstacle.gstObjects[6].fPoint4Y CtApImageProcess_FreeRunning.PpImageProcess_Obstacle_60ms.DeObstacle.gstObjects[7].nObjectID CtApImageProcess_FreeRunning.PpImageProcess_Obstacle_60ms.DeObstacle.gstObjects[7].nType CtApImageProcess_FreeRunning.PpImageProcess_Obstacle_60ms.DeObstacle.gstObjects[7].nAge CtApImageProcess_FreeRunning.PpImageProcess_Obstacle_60ms.DeObstacle.gstObjects[7].nQuality CtApImageProcess_FreeRunning.PpImageProcess_Obstacle_60ms.DeObstacle.gstObjects[7].fHeight CtApImageProcess_FreeRunning.PpImageProcess_Obstacle_60ms.DeObstacle.gstObjects[7].fPiont1X CtApImageProcess_FreeRunning.PpImageProcess_Obstacle_60ms.DeObstacle.gstObjects[7].fPiont1Y CtApImageProcess_FreeRunning.PpImageProcess_Obstacle_60ms.DeObstacle.gstObjects[7].fPiont2X CtApImageProcess_FreeRunning.PpImageProcess_Obstacle_60ms.DeObstacle.gstObjects[7].fPiont2Y CtApImageProcess_FreeRunning.PpImageProcess_Obstacle_60ms.DeObstacle.gstObjects[7].fRelVelocityX CtApImageProcess_FreeRunning.PpImageProcess_Obstacle_60ms.DeObstacle.gstObjects[7].fRelVelocityY CtApImageProcess_FreeRunning.PpImageProcess_Obstacle_60ms.DeObstacle.gstObjects[7].fAblVelocityX CtApImageProcess_FreeRunning.PpImageProcess_Obstacle_60ms.DeObstacle.gstObjects[7].fAblVelocityY CtApImageProcess_FreeRunning.PpImageProcess_Obstacle_60ms.DeObstacle.gstObjects[7].fAbsValY CtApImageProcess_FreeRunning.PpImageProcess_Obstacle_60ms.DeObstacle.gstObjects[7].nPoint1OnCar CtApImageProcess_FreeRunning.PpImageProcess_Obstacle_60ms.DeObstacle.gstObjects[7].nPoint2OnCar CtApImageProcess_FreeRunning.PpImageProcess_Obstacle_60ms.DeObstacle.gstObjects[7].fReserved CtApImageProcess_FreeRunning.PpImageProcess_Obstacle_60ms.DeObstacle.gstObjects[7].n3D CtApImageProcess_FreeRunning.PpImageProcess_Obstacle_60ms.DeObstacle.gstObjects[7].fPoint3X CtApImageProcess_FreeRunning.PpImageProcess_Obstacle_60ms.DeObstacle.gstObjects[7].fPoint3Y CtApImageProcess_FreeRunning.PpImageProcess_Obstacle_60ms.DeObstacle.gstObjects[7].fPoint4X CtApImageProcess_FreeRunning.PpImageProcess_Obstacle_60ms.DeObstacle.gstObjects[7].fPoint4Y CtApImageProcess_FreeRunning.PpImageProcess_Obstacle_60ms.DeObstacle.gstObjects[8].nObjectID CtApImageProcess_FreeRunning.PpImageProcess_Obstacle_60ms.DeObstacle.gstObjects[8].nType CtApImageProcess_FreeRunning.PpImageProcess_Obstacle_60ms.DeObstacle.gstObjects[8].nAge CtApImageProcess_FreeRunning.PpImageProcess_Obstacle_60ms.DeObstacle.gstObjects[8].nQuality CtApImageProcess_FreeRunning.PpImageProcess_Obstacle_60ms.DeObstacle.gstObjects[8].fHeight CtApImageProcess_FreeRunning.PpImageProcess_Obstacle_60ms.DeObstacle.gstObjects[8].fPiont1X CtApImageProcess_FreeRunning.PpImageProcess_Obstacle_60ms.DeObstacle.gstObjects[8].fPiont1Y CtApImageProcess_FreeRunning.PpImageProcess_Obstacle_60ms.DeObstacle.gstObjects[8].fPiont2X CtApImageProcess_FreeRunning.PpImageProcess_Obstacle_60ms.DeObstacle.gstObjects[8].fPiont2Y CtApImageProcess_FreeRunning.PpImageProcess_Obstacle_60ms.DeObstacle.gstObjects[8].fRelVelocityX CtApImageProcess_FreeRunning.PpImageProcess_Obstacle_60ms.DeObstacle.gstObjects[8].fRelVelocityY CtApImageProcess_FreeRunning.PpImageProcess_Obstacle_60ms.DeObstacle.gstObjects[8].fAblVelocityX CtApImageProcess_FreeRunning.PpImageProcess_Obstacle_60ms.DeObstacle.gstObjects[8].fAblVelocityY CtApImageProcess_FreeRunning.PpImageProcess_Obstacle_60ms.DeObstacle.gstObjects[8].fAbsValY CtApImageProcess_FreeRunning.PpImageProcess_Obstacle_60ms.DeObstacle.gstObjects[8].nPoint1OnCar CtApImageProcess_FreeRunning.PpImageProcess_Obstacle_60ms.DeObstacle.gstObjects[8].nPoint2OnCar CtApImageProcess_FreeRunning.PpImageProcess_Obstacle_60ms.DeObstacle.gstObjects[8].fReserved CtApImageProcess_FreeRunning.PpImageProcess_Obstacle_60ms.DeObstacle.gstObjects[8].n3D CtApImageProcess_FreeRunning.PpImageProcess_Obstacle_60ms.DeObstacle.gstObjects[8].fPoint3X CtApImageProcess_FreeRunning.PpImageProcess_Obstacle_60ms.DeObstacle.gstObjects[8].fPoint3Y CtApImageProcess_FreeRunning.PpImageProcess_Obstacle_60ms.DeObstacle.gstObjects[8].fPoint4X CtApImageProcess_FreeRunning.PpImageProcess_Obstacle_60ms.DeObstacle.gstObjects[8].fPoint4Y CtApImageProcess_FreeRunning.PpImageProcess_Obstacle_60ms.DeObstacle.gstObjects[9].nObjectID CtApImageProcess_FreeRunning.PpImageProcess_Obstacle_60ms.DeObstacle.gstObjects[9].nType CtApImageProcess_FreeRunning.PpImageProcess_Obstacle_60ms.DeObstacle.gstObjects[9].nAge CtApImageProcess_FreeRunning.PpImageProcess_Obstacle_60ms.DeObstacle.gstObjects[9].nQuality CtApImageProcess_FreeRunning.PpImageProcess_Obstacle_60ms.DeObstacle.gstObjects[9].fHeight CtApImageProcess_FreeRunning.PpImageProcess_Obstacle_60ms.DeObstacle.gstObjects[9].fPiont1X CtApImageProcess_FreeRunning.PpImageProcess_Obstacle_60ms.DeObstacle.gstObjects[9].fPiont1Y CtApImageProcess_FreeRunning.PpImageProcess_Obstacle_60ms.DeObstacle.gstObjects[9].fPiont2X CtApImageProcess_FreeRunning.PpImageProcess_Obstacle_60ms.DeObstacle.gstObjects[9].fPiont2Y CtApImageProcess_FreeRunning.PpImageProcess_Obstacle_60ms.DeObstacle.gstObjects[9].fRelVelocityX CtApImageProcess_FreeRunning.PpImageProcess_Obstacle_60ms.DeObstacle.gstObjects[9].fRelVelocityY CtApImageProcess_FreeRunning.PpImageProcess_Obstacle_60ms.DeObstacle.gstObjects[9].fAblVelocityX CtApImageProcess_FreeRunning.PpImageProcess_Obstacle_60ms.DeObstacle.gstObjects[9].fAblVelocityY CtApImageProcess_FreeRunning.PpImageProcess_Obstacle_60ms.DeObstacle.gstObjects[9].fAbsValY CtApImageProcess_FreeRunning.PpImageProcess_Obstacle_60ms.DeObstacle.gstObjects[9].nPoint1OnCar CtApImageProcess_FreeRunning.PpImageProcess_Obstacle_60ms.DeObstacle.gstObjects[9].nPoint2OnCar CtApImageProcess_FreeRunning.PpImageProcess_Obstacle_60ms.DeObstacle.gstObjects[9].fReserved CtApImageProcess_FreeRunning.PpImageProcess_Obstacle_60ms.DeObstacle.gstObjects[9].n3D CtApImageProcess_FreeRunning.PpImageProcess_Obstacle_60ms.DeObstacle.gstObjects[9].fPoint3X CtApImageProcess_FreeRunning.PpImageProcess_Obstacle_60ms.DeObstacle.gstObjects[9].fPoint3Y CtApImageProcess_FreeRunning.PpImageProcess_Obstacle_60ms.DeObstacle.gstObjects[9].fPoint4X CtApImageProcess_FreeRunning.PpImageProcess_Obstacle_60ms.DeObstacle.gstObjects[9].fPoint4Y CtApImageProcess_FreeRunning.PpImageProcess_Obstacle_60ms.DeObstacle.gstObjects[10].nObjectID CtApImageProcess_FreeRunning.PpImageProcess_Obstacle_60ms.DeObstacle.gstObjects[10].nType CtApImageProcess_FreeRunning.PpImageProcess_Obstacle_60ms.DeObstacle.gstObjects[10].nAge CtApImageProcess_FreeRunning.PpImageProcess_Obstacle_60ms.DeObstacle.gstObjects[10].nQuality CtApImageProcess_FreeRunning.PpImageProcess_Obstacle_60ms.DeObstacle.gstObjects[10].fHeight CtApImageProcess_FreeRunning.PpImageProcess_Obstacle_60ms.DeObstacle.gstObjects[10].fPiont1X CtApImageProcess_FreeRunning.PpImageProcess_Obstacle_60ms.DeObstacle.gstObjects[10].fPiont1Y CtApImageProcess_FreeRunning.PpImageProcess_Obstacle_60ms.DeObstacle.gstObjects[10].fPiont2X CtApImageProcess_FreeRunning.PpImageProcess_Obstacle_60ms.DeObstacle.gstObjects[10].fPiont2Y CtApImageProcess_FreeRunning.PpImageProcess_Obstacle_60ms.DeObstacle.gstObjects[10].fRelVelocityX CtApImageProcess_FreeRunning.PpImageProcess_Obstacle_60ms.DeObstacle.gstObjects[10].fRelVelocityY CtApImageProcess_FreeRunning.PpImageProcess_Obstacle_60ms.DeObstacle.gstObjects[10].fAblVelocityX CtApImageProcess_FreeRunning.PpImageProcess_Obstacle_60ms.DeObstacle.gstObjects[10].fAblVelocityY CtApImageProcess_FreeRunning.PpImageProcess_Obstacle_60ms.DeObstacle.gstObjects[10].fAbsValY CtApImageProcess_FreeRunning.PpImageProcess_Obstacle_60ms.DeObstacle.gstObjects[10].nPoint1OnCar CtApImageProcess_FreeRunning.PpImageProcess_Obstacle_60ms.DeObstacle.gstObjects[10].nPoint2OnCar CtApImageProcess_FreeRunning.PpImageProcess_Obstacle_60ms.DeObstacle.gstObjects[10].fReserved CtApImageProcess_FreeRunning.PpImageProcess_Obstacle_60ms.DeObstacle.gstObjects[10].n3D CtApImageProcess_FreeRunning.PpImageProcess_Obstacle_60ms.DeObstacle.gstObjects[10].fPoint3X CtApImageProcess_FreeRunning.PpImageProcess_Obstacle_60ms.DeObstacle.gstObjects[10].fPoint3Y CtApImageProcess_FreeRunning.PpImageProcess_Obstacle_60ms.DeObstacle.gstObjects[10].fPoint4X CtApImageProcess_FreeRunning.PpImageProcess_Obstacle_60ms.DeObstacle.gstObjects[10].fPoint4Y CtApImageProcess_FreeRunning.PpImageProcess_Obstacle_60ms.DeObstacle.gstObjects[11].nObjectID CtApImageProcess_FreeRunning.PpImageProcess_Obstacle_60ms.DeObstacle.gstObjects[11].nType CtApImageProcess_FreeRunning.PpImageProcess_Obstacle_60ms.DeObstacle.gstObjects[11].nAge CtApImageProcess_FreeRunning.PpImageProcess_Obstacle_60ms.DeObstacle.gstObjects[11].nQuality CtApImageProcess_FreeRunning.PpImageProcess_Obstacle_60ms.DeObstacle.gstObjects[11].fHeight CtApImageProcess_FreeRunning.PpImageProcess_Obstacle_60ms.DeObstacle.gstObjects[11].fPiont1X CtApImageProcess_FreeRunning.PpImageProcess_Obstacle_60ms.DeObstacle.gstObjects[11].fPiont1Y CtApImageProcess_FreeRunning.PpImageProcess_Obstacle_60ms.DeObstacle.gstObjects[11].fPiont2X CtApImageProcess_FreeRunning.PpImageProcess_Obstacle_60ms.DeObstacle.gstObjects[11].fPiont2Y CtApImageProcess_FreeRunning.PpImageProcess_Obstacle_60ms.DeObstacle.gstObjects[11].fRelVelocityX CtApImageProcess_FreeRunning.PpImageProcess_Obstacle_60ms.DeObstacle.gstObjects[11].fRelVelocityY CtApImageProcess_FreeRunning.PpImageProcess_Obstacle_60ms.DeObstacle.gstObjects[11].fAblVelocityX CtApImageProcess_FreeRunning.PpImageProcess_Obstacle_60ms.DeObstacle.gstObjects[11].fAblVelocityY CtApImageProcess_FreeRunning.PpImageProcess_Obstacle_60ms.DeObstacle.gstObjects[11].fAbsValY CtApImageProcess_FreeRunning.PpImageProcess_Obstacle_60ms.DeObstacle.gstObjects[11].nPoint1OnCar CtApImageProcess_FreeRunning.PpImageProcess_Obstacle_60ms.DeObstacle.gstObjects[11].nPoint2OnCar CtApImageProcess_FreeRunning.PpImageProcess_Obstacle_60ms.DeObstacle.gstObjects[11].fReserved CtApImageProcess_FreeRunning.PpImageProcess_Obstacle_60ms.DeObstacle.gstObjects[11].n3D CtApImageProcess_FreeRunning.PpImageProcess_Obstacle_60ms.DeObstacle.gstObjects[11].fPoint3X CtApImageProcess_FreeRunning.PpImageProcess_Obstacle_60ms.DeObstacle.gstObjects[11].fPoint3Y CtApImageProcess_FreeRunning.PpImageProcess_Obstacle_60ms.DeObstacle.gstObjects[11].fPoint4X CtApImageProcess_FreeRunning.PpImageProcess_Obstacle_60ms.DeObstacle.gstObjects[11].fPoint4Y CtApImageProcess_FreeRunning.PpImageProcess_Obstacle_60ms.DeObstacle.gstObjects[12].nObjectID CtApImageProcess_FreeRunning.PpImageProcess_Obstacle_60ms.DeObstacle.gstObjects[12].nType CtApImageProcess_FreeRunning.PpImageProcess_Obstacle_60ms.DeObstacle.gstObjects[12].nAge CtApImageProcess_FreeRunning.PpImageProcess_Obstacle_60ms.DeObstacle.gstObjects[12].nQuality CtApImageProcess_FreeRunning.PpImageProcess_Obstacle_60ms.DeObstacle.gstObjects[12].fHeight CtApImageProcess_FreeRunning.PpImageProcess_Obstacle_60ms.DeObstacle.gstObjects[12].fPiont1X CtApImageProcess_FreeRunning.PpImageProcess_Obstacle_60ms.DeObstacle.gstObjects[12].fPiont1Y CtApImageProcess_FreeRunning.PpImageProcess_Obstacle_60ms.DeObstacle.gstObjects[12].fPiont2X CtApImageProcess_FreeRunning.PpImageProcess_Obstacle_60ms.DeObstacle.gstObjects[12].fPiont2Y CtApImageProcess_FreeRunning.PpImageProcess_Obstacle_60ms.DeObstacle.gstObjects[12].fRelVelocityX CtApImageProcess_FreeRunning.PpImageProcess_Obstacle_60ms.DeObstacle.gstObjects[12].fRelVelocityY CtApImageProcess_FreeRunning.PpImageProcess_Obstacle_60ms.DeObstacle.gstObjects[12].fAblVelocityX CtApImageProcess_FreeRunning.PpImageProcess_Obstacle_60ms.DeObstacle.gstObjects[12].fAblVelocityY CtApImageProcess_FreeRunning.PpImageProcess_Obstacle_60ms.DeObstacle.gstObjects[12].fAbsValY CtApImageProcess_FreeRunning.PpImageProcess_Obstacle_60ms.DeObstacle.gstObjects[12].nPoint1OnCar CtApImageProcess_FreeRunning.PpImageProcess_Obstacle_60ms.DeObstacle.gstObjects[12].nPoint2OnCar CtApImageProcess_FreeRunning.PpImageProcess_Obstacle_60ms.DeObstacle.gstObjects[12].fReserved CtApImageProcess_FreeRunning.PpImageProcess_Obstacle_60ms.DeObstacle.gstObjects[12].n3D CtApImageProcess_FreeRunning.PpImageProcess_Obstacle_60ms.DeObstacle.gstObjects[12].fPoint3X CtApImageProcess_FreeRunning.PpImageProcess_Obstacle_60ms.DeObstacle.gstObjects[12].fPoint3Y CtApImageProcess_FreeRunning.PpImageProcess_Obstacle_60ms.DeObstacle.gstObjects[12].fPoint4X CtApImageProcess_FreeRunning.PpImageProcess_Obstacle_60ms.DeObstacle.gstObjects[12].fPoint4Y CtApImageProcess_FreeRunning.PpImageProcess_Obstacle_60ms.DeObstacle.gstObjects[13].nObjectID CtApImageProcess_FreeRunning.PpImageProcess_Obstacle_60ms.DeObstacle.gstObjects[13].nType CtApImageProcess_FreeRunning.PpImageProcess_Obstacle_60ms.DeObstacle.gstObjects[13].nAge CtApImageProcess_FreeRunning.PpImageProcess_Obstacle_60ms.DeObstacle.gstObjects[13].nQuality CtApImageProcess_FreeRunning.PpImageProcess_Obstacle_60ms.DeObstacle.gstObjects[13].fHeight CtApImageProcess_FreeRunning.PpImageProcess_Obstacle_60ms.DeObstacle.gstObjects[13].fPiont1X CtApImageProcess_FreeRunning.PpImageProcess_Obstacle_60ms.DeObstacle.gstObjects[13].fPiont1Y CtApImageProcess_FreeRunning.PpImageProcess_Obstacle_60ms.DeObstacle.gstObjects[13].fPiont2X CtApImageProcess_FreeRunning.PpImageProcess_Obstacle_60ms.DeObstacle.gstObjects[13].fPiont2Y CtApImageProcess_FreeRunning.PpImageProcess_Obstacle_60ms.DeObstacle.gstObjects[13].fRelVelocityX CtApImageProcess_FreeRunning.PpImageProcess_Obstacle_60ms.DeObstacle.gstObjects[13].fRelVelocityY CtApImageProcess_FreeRunning.PpImageProcess_Obstacle_60ms.DeObstacle.gstObjects[13].fAblVelocityX CtApImageProcess_FreeRunning.PpImageProcess_Obstacle_60ms.DeObstacle.gstObjects[13].fAblVelocityY CtApImageProcess_FreeRunning.PpImageProcess_Obstacle_60ms.DeObstacle.gstObjects[13].fAbsValY CtApImageProcess_FreeRunning.PpImageProcess_Obstacle_60ms.DeObstacle.gstObjects[13].nPoint1OnCar CtApImageProcess_FreeRunning.PpImageProcess_Obstacle_60ms.DeObstacle.gstObjects[13].nPoint2OnCar CtApImageProcess_FreeRunning.PpImageProcess_Obstacle_60ms.DeObstacle.gstObjects[13].fReserved CtApImageProcess_FreeRunning.PpImageProcess_Obstacle_60ms.DeObstacle.gstObjects[13].n3D CtApImageProcess_FreeRunning.PpImageProcess_Obstacle_60ms.DeObstacle.gstObjects[13].fPoint3X CtApImageProcess_FreeRunning.PpImageProcess_Obstacle_60ms.DeObstacle.gstObjects[13].fPoint3Y CtApImageProcess_FreeRunning.PpImageProcess_Obstacle_60ms.DeObstacle.gstObjects[13].fPoint4X CtApImageProcess_FreeRunning.PpImageProcess_Obstacle_60ms.DeObstacle.gstObjects[13].fPoint4Y CtApImageProcess_FreeRunning.PpImageProcess_Obstacle_60ms.DeObstacle.gstObjects[14].nObjectID CtApImageProcess_FreeRunning.PpImageProcess_Obstacle_60ms.DeObstacle.gstObjects[14].nType CtApImageProcess_FreeRunning.PpImageProcess_Obstacle_60ms.DeObstacle.gstObjects[14].nAge CtApImageProcess_FreeRunning.PpImageProcess_Obstacle_60ms.DeObstacle.gstObjects[14].nQuality CtApImageProcess_FreeRunning.PpImageProcess_Obstacle_60ms.DeObstacle.gstObjects[14].fHeight CtApImageProcess_FreeRunning.PpImageProcess_Obstacle_60ms.DeObstacle.gstObjects[14].fPiont1X CtApImageProcess_FreeRunning.PpImageProcess_Obstacle_60ms.DeObstacle.gstObjects[14].fPiont1Y CtApImageProcess_FreeRunning.PpImageProcess_Obstacle_60ms.DeObstacle.gstObjects[14].fPiont2X CtApImageProcess_FreeRunning.PpImageProcess_Obstacle_60ms.DeObstacle.gstObjects[14].fPiont2Y CtApImageProcess_FreeRunning.PpImageProcess_Obstacle_60ms.DeObstacle.gstObjects[14].fRelVelocityX CtApImageProcess_FreeRunning.PpImageProcess_Obstacle_60ms.DeObstacle.gstObjects[14].fRelVelocityY CtApImageProcess_FreeRunning.PpImageProcess_Obstacle_60ms.DeObstacle.gstObjects[14].fAblVelocityX CtApImageProcess_FreeRunning.PpImageProcess_Obstacle_60ms.DeObstacle.gstObjects[14].fAblVelocityY CtApImageProcess_FreeRunning.PpImageProcess_Obstacle_60ms.DeObstacle.gstObjects[14].fAbsValY CtApImageProcess_FreeRunning.PpImageProcess_Obstacle_60ms.DeObstacle.gstObjects[14].nPoint1OnCar CtApImageProcess_FreeRunning.PpImageProcess_Obstacle_60ms.DeObstacle.gstObjects[14].nPoint2OnCar CtApImageProcess_FreeRunning.PpImageProcess_Obstacle_60ms.DeObstacle.gstObjects[14].fReserved CtApImageProcess_FreeRunning.PpImageProcess_Obstacle_60ms.DeObstacle.gstObjects[14].n3D CtApImageProcess_FreeRunning.PpImageProcess_Obstacle_60ms.DeObstacle.gstObjects[14].fPoint3X CtApImageProcess_FreeRunning.PpImageProcess_Obstacle_60ms.DeObstacle.gstObjects[14].fPoint3Y CtApImageProcess_FreeRunning.PpImageProcess_Obstacle_60ms.DeObstacle.gstObjects[14].fPoint4X CtApImageProcess_FreeRunning.PpImageProcess_Obstacle_60ms.DeObstacle.gstObjects[14].fPoint4Y CtApImageProcess_FreeRunning.PpImageProcess_Obstacle_60ms.DeObstacle.gstObjects[15].nObjectID CtApImageProcess_FreeRunning.PpImageProcess_Obstacle_60ms.DeObstacle.gstObjects[15].nType CtApImageProcess_FreeRunning.PpImageProcess_Obstacle_60ms.DeObstacle.gstObjects[15].nAge CtApImageProcess_FreeRunning.PpImageProcess_Obstacle_60ms.DeObstacle.gstObjects[15].nQuality CtApImageProcess_FreeRunning.PpImageProcess_Obstacle_60ms.DeObstacle.gstObjects[15].fHeight CtApImageProcess_FreeRunning.PpImageProcess_Obstacle_60ms.DeObstacle.gstObjects[15].fPiont1X CtApImageProcess_FreeRunning.PpImageProcess_Obstacle_60ms.DeObstacle.gstObjects[15].fPiont1Y CtApImageProcess_FreeRunning.PpImageProcess_Obstacle_60ms.DeObstacle.gstObjects[15].fPiont2X CtApImageProcess_FreeRunning.PpImageProcess_Obstacle_60ms.DeObstacle.gstObjects[15].fPiont2Y CtApImageProcess_FreeRunning.PpImageProcess_Obstacle_60ms.DeObstacle.gstObjects[15].fRelVelocityX CtApImageProcess_FreeRunning.PpImageProcess_Obstacle_60ms.DeObstacle.gstObjects[15].fRelVelocityY CtApImageProcess_FreeRunning.PpImageProcess_Obstacle_60ms.DeObstacle.gstObjects[15].fAblVelocityX CtApImageProcess_FreeRunning.PpImageProcess_Obstacle_60ms.DeObstacle.gstObjects[15].fAblVelocityY CtApImageProcess_FreeRunning.PpImageProcess_Obstacle_60ms.DeObstacle.gstObjects[15].fAbsValY CtApImageProcess_FreeRunning.PpImageProcess_Obstacle_60ms.DeObstacle.gstObjects[15].nPoint1OnCar CtApImageProcess_FreeRunning.PpImageProcess_Obstacle_60ms.DeObstacle.gstObjects[15].nPoint2OnCar CtApImageProcess_FreeRunning.PpImageProcess_Obstacle_60ms.DeObstacle.gstObjects[15].fReserved CtApImageProcess_FreeRunning.PpImageProcess_Obstacle_60ms.DeObstacle.gstObjects[15].n3D CtApImageProcess_FreeRunning.PpImageProcess_Obstacle_60ms.DeObstacle.gstObjects[15].fPoint3X CtApImageProcess_FreeRunning.PpImageProcess_Obstacle_60ms.DeObstacle.gstObjects[15].fPoint3Y CtApImageProcess_FreeRunning.PpImageProcess_Obstacle_60ms.DeObstacle.gstObjects[15].fPoint4X CtApImageProcess_FreeRunning.PpImageProcess_Obstacle_60ms.DeObstacle.gstObjects[15].fPoint4Y CtApImageProcess_FreeRunning.PpImageProcess_Obstacle_60ms.DeObstacle.gstObjects[16].nObjectID CtApImageProcess_FreeRunning.PpImageProcess_Obstacle_60ms.DeObstacle.gstObjects[16].nType CtApImageProcess_FreeRunning.PpImageProcess_Obstacle_60ms.DeObstacle.gstObjects[16].nAge CtApImageProcess_FreeRunning.PpImageProcess_Obstacle_60ms.DeObstacle.gstObjects[16].nQuality CtApImageProcess_FreeRunning.PpImageProcess_Obstacle_60ms.DeObstacle.gstObjects[16].fHeight CtApImageProcess_FreeRunning.PpImageProcess_Obstacle_60ms.DeObstacle.gstObjects[16].fPiont1X CtApImageProcess_FreeRunning.PpImageProcess_Obstacle_60ms.DeObstacle.gstObjects[16].fPiont1Y CtApImageProcess_FreeRunning.PpImageProcess_Obstacle_60ms.DeObstacle.gstObjects[16].fPiont2X CtApImageProcess_FreeRunning.PpImageProcess_Obstacle_60ms.DeObstacle.gstObjects[16].fPiont2Y CtApImageProcess_FreeRunning.PpImageProcess_Obstacle_60ms.DeObstacle.gstObjects[16].fRelVelocityX CtApImageProcess_FreeRunning.PpImageProcess_Obstacle_60ms.DeObstacle.gstObjects[16].fRelVelocityY CtApImageProcess_FreeRunning.PpImageProcess_Obstacle_60ms.DeObstacle.gstObjects[16].fAblVelocityX CtApImageProcess_FreeRunning.PpImageProcess_Obstacle_60ms.DeObstacle.gstObjects[16].fAblVelocityY CtApImageProcess_FreeRunning.PpImageProcess_Obstacle_60ms.DeObstacle.gstObjects[16].fAbsValY CtApImageProcess_FreeRunning.PpImageProcess_Obstacle_60ms.DeObstacle.gstObjects[16].nPoint1OnCar CtApImageProcess_FreeRunning.PpImageProcess_Obstacle_60ms.DeObstacle.gstObjects[16].nPoint2OnCar CtApImageProcess_FreeRunning.PpImageProcess_Obstacle_60ms.DeObstacle.gstObjects[16].fReserved CtApImageProcess_FreeRunning.PpImageProcess_Obstacle_60ms.DeObstacle.gstObjects[16].n3D CtApImageProcess_FreeRunning.PpImageProcess_Obstacle_60ms.DeObstacle.gstObjects[16].fPoint3X CtApImageProcess_FreeRunning.PpImageProcess_Obstacle_60ms.DeObstacle.gstObjects[16].fPoint3Y CtApImageProcess_FreeRunning.PpImageProcess_Obstacle_60ms.DeObstacle.gstObjects[16].fPoint4X CtApImageProcess_FreeRunning.PpImageProcess_Obstacle_60ms.DeObstacle.gstObjects[16].fPoint4Y CtApImageProcess_FreeRunning.PpImageProcess_Obstacle_60ms.DeObstacle.gstObjects[17].nObjectID CtApImageProcess_FreeRunning.PpImageProcess_Obstacle_60ms.DeObstacle.gstObjects[17].nType CtApImageProcess_FreeRunning.PpImageProcess_Obstacle_60ms.DeObstacle.gstObjects[17].nAge CtApImageProcess_FreeRunning.PpImageProcess_Obstacle_60ms.DeObstacle.gstObjects[17].nQuality CtApImageProcess_FreeRunning.PpImageProcess_Obstacle_60ms.DeObstacle.gstObjects[17].fHeight CtApImageProcess_FreeRunning.PpImageProcess_Obstacle_60ms.DeObstacle.gstObjects[17].fPiont1X CtApImageProcess_FreeRunning.PpImageProcess_Obstacle_60ms.DeObstacle.gstObjects[17].fPiont1Y CtApImageProcess_FreeRunning.PpImageProcess_Obstacle_60ms.DeObstacle.gstObjects[17].fPiont2X CtApImageProcess_FreeRunning.PpImageProcess_Obstacle_60ms.DeObstacle.gstObjects[17].fPiont2Y CtApImageProcess_FreeRunning.PpImageProcess_Obstacle_60ms.DeObstacle.gstObjects[17].fRelVelocityX CtApImageProcess_FreeRunning.PpImageProcess_Obstacle_60ms.DeObstacle.gstObjects[17].fRelVelocityY CtApImageProcess_FreeRunning.PpImageProcess_Obstacle_60ms.DeObstacle.gstObjects[17].fAblVelocityX CtApImageProcess_FreeRunning.PpImageProcess_Obstacle_60ms.DeObstacle.gstObjects[17].fAblVelocityY CtApImageProcess_FreeRunning.PpImageProcess_Obstacle_60ms.DeObstacle.gstObjects[17].fAbsValY CtApImageProcess_FreeRunning.PpImageProcess_Obstacle_60ms.DeObstacle.gstObjects[17].nPoint1OnCar CtApImageProcess_FreeRunning.PpImageProcess_Obstacle_60ms.DeObstacle.gstObjects[17].nPoint2OnCar CtApImageProcess_FreeRunning.PpImageProcess_Obstacle_60ms.DeObstacle.gstObjects[17].fReserved CtApImageProcess_FreeRunning.PpImageProcess_Obstacle_60ms.DeObstacle.gstObjects[17].n3D CtApImageProcess_FreeRunning.PpImageProcess_Obstacle_60ms.DeObstacle.gstObjects[17].fPoint3X CtApImageProcess_FreeRunning.PpImageProcess_Obstacle_60ms.DeObstacle.gstObjects[17].fPoint3Y CtApImageProcess_FreeRunning.PpImageProcess_Obstacle_60ms.DeObstacle.gstObjects[17].fPoint4X CtApImageProcess_FreeRunning.PpImageProcess_Obstacle_60ms.DeObstacle.gstObjects[17].fPoint4Y CtApImageProcess_FreeRunning.PpImageProcess_Obstacle_60ms.DeObstacle.gstObjects[18].nObjectID CtApImageProcess_FreeRunning.PpImageProcess_Obstacle_60ms.DeObstacle.gstObjects[18].nType CtApImageProcess_FreeRunning.PpImageProcess_Obstacle_60ms.DeObstacle.gstObjects[18].nAge CtApImageProcess_FreeRunning.PpImageProcess_Obstacle_60ms.DeObstacle.gstObjects[18].nQuality CtApImageProcess_FreeRunning.PpImageProcess_Obstacle_60ms.DeObstacle.gstObjects[18].fHeight CtApImageProcess_FreeRunning.PpImageProcess_Obstacle_60ms.DeObstacle.gstObjects[18].fPiont1X CtApImageProcess_FreeRunning.PpImageProcess_Obstacle_60ms.DeObstacle.gstObjects[18].fPiont1Y CtApImageProcess_FreeRunning.PpImageProcess_Obstacle_60ms.DeObstacle.gstObjects[18].fPiont2X CtApImageProcess_FreeRunning.PpImageProcess_Obstacle_60ms.DeObstacle.gstObjects[18].fPiont2Y CtApImageProcess_FreeRunning.PpImageProcess_Obstacle_60ms.DeObstacle.gstObjects[18].fRelVelocityX CtApImageProcess_FreeRunning.PpImageProcess_Obstacle_60ms.DeObstacle.gstObjects[18].fRelVelocityY CtApImageProcess_FreeRunning.PpImageProcess_Obstacle_60ms.DeObstacle.gstObjects[18].fAblVelocityX CtApImageProcess_FreeRunning.PpImageProcess_Obstacle_60ms.DeObstacle.gstObjects[18].fAblVelocityY CtApImageProcess_FreeRunning.PpImageProcess_Obstacle_60ms.DeObstacle.gstObjects[18].fAbsValY CtApImageProcess_FreeRunning.PpImageProcess_Obstacle_60ms.DeObstacle.gstObjects[18].nPoint1OnCar CtApImageProcess_FreeRunning.PpImageProcess_Obstacle_60ms.DeObstacle.gstObjects[18].nPoint2OnCar CtApImageProcess_FreeRunning.PpImageProcess_Obstacle_60ms.DeObstacle.gstObjects[18].fReserved CtApImageProcess_FreeRunning.PpImageProcess_Obstacle_60ms.DeObstacle.gstObjects[18].n3D CtApImageProcess_FreeRunning.PpImageProcess_Obstacle_60ms.DeObstacle.gstObjects[18].fPoint3X CtApImageProcess_FreeRunning.PpImageProcess_Obstacle_60ms.DeObstacle.gstObjects[18].fPoint3Y CtApImageProcess_FreeRunning.PpImageProcess_Obstacle_60ms.DeObstacle.gstObjects[18].fPoint4X CtApImageProcess_FreeRunning.PpImageProcess_Obstacle_60ms.DeObstacle.gstObjects[18].fPoint4Y CtApImageProcess_FreeRunning.PpImageProcess_Obstacle_60ms.DeObstacle.gstObjects[19].nObjectID CtApImageProcess_FreeRunning.PpImageProcess_Obstacle_60ms.DeObstacle.gstObjects[19].nType CtApImageProcess_FreeRunning.PpImageProcess_Obstacle_60ms.DeObstacle.gstObjects[19].nAge CtApImageProcess_FreeRunning.PpImageProcess_Obstacle_60ms.DeObstacle.gstObjects[19].nQuality CtApImageProcess_FreeRunning.PpImageProcess_Obstacle_60ms.DeObstacle.gstObjects[19].fHeight CtApImageProcess_FreeRunning.PpImageProcess_Obstacle_60ms.DeObstacle.gstObjects[19].fPiont1X CtApImageProcess_FreeRunning.PpImageProcess_Obstacle_60ms.DeObstacle.gstObjects[19].fPiont1Y CtApImageProcess_FreeRunning.PpImageProcess_Obstacle_60ms.DeObstacle.gstObjects[19].fPiont2X CtApImageProcess_FreeRunning.PpImageProcess_Obstacle_60ms.DeObstacle.gstObjects[19].fPiont2Y CtApImageProcess_FreeRunning.PpImageProcess_Obstacle_60ms.DeObstacle.gstObjects[19].fRelVelocityX CtApImageProcess_FreeRunning.PpImageProcess_Obstacle_60ms.DeObstacle.gstObjects[19].fRelVelocityY CtApImageProcess_FreeRunning.PpImageProcess_Obstacle_60ms.DeObstacle.gstObjects[19].fAblVelocityX CtApImageProcess_FreeRunning.PpImageProcess_Obstacle_60ms.DeObstacle.gstObjects[19].fAblVelocityY CtApImageProcess_FreeRunning.PpImageProcess_Obstacle_60ms.DeObstacle.gstObjects[19].fAbsValY CtApImageProcess_FreeRunning.PpImageProcess_Obstacle_60ms.DeObstacle.gstObjects[19].nPoint1OnCar CtApImageProcess_FreeRunning.PpImageProcess_Obstacle_60ms.DeObstacle.gstObjects[19].nPoint2OnCar CtApImageProcess_FreeRunning.PpImageProcess_Obstacle_60ms.DeObstacle.gstObjects[19].fReserved CtApImageProcess_FreeRunning.PpImageProcess_Obstacle_60ms.DeObstacle.gstObjects[19].n3D CtApImageProcess_FreeRunning.PpImageProcess_Obstacle_60ms.DeObstacle.gstObjects[19].fPoint3X CtApImageProcess_FreeRunning.PpImageProcess_Obstacle_60ms.DeObstacle.gstObjects[19].fPoint3Y CtApImageProcess_FreeRunning.PpImageProcess_Obstacle_60ms.DeObstacle.gstObjects[19].fPoint4X CtApImageProcess_FreeRunning.PpImageProcess_Obstacle_60ms.DeObstacle.gstObjects[19].fPoint4Y CtApImageProcess_FreeRunning.PpImageProcess_Obstacle_60ms.DeObstacle.reseved CtApImageProcess_FreeRunning.PpImageProcess_Obstacle_60ms.DeObstacle.t2 CtApImageProcess_FreeRunning.PpImageProcess_ParkingLot_20ms.DeSVParkingSlot.stHeader.Counter CtApImageProcess_FreeRunning.PpImageProcess_ParkingLot_20ms.DeSVParkingSlot.stHeader.FrameID CtApImageProcess_FreeRunning.PpImageProcess_ParkingLot_20ms.DeSVParkingSlot.stHeader.TimeStamp CtApImageProcess_FreeRunning.PpImageProcess_ParkingLot_20ms.DeSVParkingSlot.nImageTimeStamp CtApImageProcess_FreeRunning.PpImageProcess_ParkingLot_20ms.DeSVParkingSlot.gstSpaceFront[0].nValid CtApImageProcess_FreeRunning.PpImageProcess_ParkingLot_20ms.DeSVParkingSlot.gstSpaceFront[0].gfPos[0] CtApImageProcess_FreeRunning.PpImageProcess_ParkingLot_20ms.DeSVParkingSlot.gstSpaceFront[0].gfPos[1] CtApImageProcess_FreeRunning.PpImageProcess_ParkingLot_20ms.DeSVParkingSlot.gstSpaceFront[0].gfPos[2] CtApImageProcess_FreeRunning.PpImageProcess_ParkingLot_20ms.DeSVParkingSlot.gstSpaceFront[0].gfPos[3] CtApImageProcess_FreeRunning.PpImageProcess_ParkingLot_20ms.DeSVParkingSlot.gstSpaceFront[0].nQuality CtApImageProcess_FreeRunning.PpImageProcess_ParkingLot_20ms.DeSVParkingSlot.gstSpaceFront[0].nType CtApImageProcess_FreeRunning.PpImageProcess_ParkingLot_20ms.DeSVParkingSlot.gstSpaceFront[0].nParkingGarageID CtApImageProcess_FreeRunning.PpImageProcess_ParkingLot_20ms.DeSVParkingSlot.gstSpaceFront[0].fLineWith CtApImageProcess_FreeRunning.PpImageProcess_ParkingLot_20ms.DeSVParkingSlot.gstSpaceFront[0].fSita CtApImageProcess_FreeRunning.PpImageProcess_ParkingLot_20ms.DeSVParkingSlot.gstSpaceFront[0].fIdentifierNum CtApImageProcess_FreeRunning.PpImageProcess_ParkingLot_20ms.DeSVParkingSlot.gstSpaceFront[0].fReserved CtApImageProcess_FreeRunning.PpImageProcess_ParkingLot_20ms.DeSVParkingSlot.gstSpaceFront[1].nValid CtApImageProcess_FreeRunning.PpImageProcess_ParkingLot_20ms.DeSVParkingSlot.gstSpaceFront[1].gfPos[0] CtApImageProcess_FreeRunning.PpImageProcess_ParkingLot_20ms.DeSVParkingSlot.gstSpaceFront[1].gfPos[1] CtApImageProcess_FreeRunning.PpImageProcess_ParkingLot_20ms.DeSVParkingSlot.gstSpaceFront[1].gfPos[2] CtApImageProcess_FreeRunning.PpImageProcess_ParkingLot_20ms.DeSVParkingSlot.gstSpaceFront[1].gfPos[3] CtApImageProcess_FreeRunning.PpImageProcess_ParkingLot_20ms.DeSVParkingSlot.gstSpaceFront[1].nQuality CtApImageProcess_FreeRunning.PpImageProcess_ParkingLot_20ms.DeSVParkingSlot.gstSpaceFront[1].nType CtApImageProcess_FreeRunning.PpImageProcess_ParkingLot_20ms.DeSVParkingSlot.gstSpaceFront[1].nParkingGarageID CtApImageProcess_FreeRunning.PpImageProcess_ParkingLot_20ms.DeSVParkingSlot.gstSpaceFront[1].fLineWith CtApImageProcess_FreeRunning.PpImageProcess_ParkingLot_20ms.DeSVParkingSlot.gstSpaceFront[1].fSita CtApImageProcess_FreeRunning.PpImageProcess_ParkingLot_20ms.DeSVParkingSlot.gstSpaceFront[1].fIdentifierNum CtApImageProcess_FreeRunning.PpImageProcess_ParkingLot_20ms.DeSVParkingSlot.gstSpaceFront[1].fReserved CtApImageProcess_FreeRunning.PpImageProcess_ParkingLot_20ms.DeSVParkingSlot.gstSpaceFront[2].nValid CtApImageProcess_FreeRunning.PpImageProcess_ParkingLot_20ms.DeSVParkingSlot.gstSpaceFront[2].gfPos[0] CtApImageProcess_FreeRunning.PpImageProcess_ParkingLot_20ms.DeSVParkingSlot.gstSpaceFront[2].gfPos[1] CtApImageProcess_FreeRunning.PpImageProcess_ParkingLot_20ms.DeSVParkingSlot.gstSpaceFront[2].gfPos[2] CtApImageProcess_FreeRunning.PpImageProcess_ParkingLot_20ms.DeSVParkingSlot.gstSpaceFront[2].gfPos[3] CtApImageProcess_FreeRunning.PpImageProcess_ParkingLot_20ms.DeSVParkingSlot.gstSpaceFront[2].nQuality CtApImageProcess_FreeRunning.PpImageProcess_ParkingLot_20ms.DeSVParkingSlot.gstSpaceFront[2].nType CtApImageProcess_FreeRunning.PpImageProcess_ParkingLot_20ms.DeSVParkingSlot.gstSpaceFront[2].nParkingGarageID CtApImageProcess_FreeRunning.PpImageProcess_ParkingLot_20ms.DeSVParkingSlot.gstSpaceFront[2].fLineWith CtApImageProcess_FreeRunning.PpImageProcess_ParkingLot_20ms.DeSVParkingSlot.gstSpaceFront[2].fSita CtApImageProcess_FreeRunning.PpImageProcess_ParkingLot_20ms.DeSVParkingSlot.gstSpaceFront[2].fIdentifierNum CtApImageProcess_FreeRunning.PpImageProcess_ParkingLot_20ms.DeSVParkingSlot.gstSpaceFront[2].fReserved CtApImageProcess_FreeRunning.PpImageProcess_ParkingLot_20ms.DeSVParkingSlot.gstSpaceFront[3].nValid CtApImageProcess_FreeRunning.PpImageProcess_ParkingLot_20ms.DeSVParkingSlot.gstSpaceFront[3].gfPos[0] CtApImageProcess_FreeRunning.PpImageProcess_ParkingLot_20ms.DeSVParkingSlot.gstSpaceFront[3].gfPos[1] CtApImageProcess_FreeRunning.PpImageProcess_ParkingLot_20ms.DeSVParkingSlot.gstSpaceFront[3].gfPos[2] CtApImageProcess_FreeRunning.PpImageProcess_ParkingLot_20ms.DeSVParkingSlot.gstSpaceFront[3].gfPos[3] CtApImageProcess_FreeRunning.PpImageProcess_ParkingLot_20ms.DeSVParkingSlot.gstSpaceFront[3].nQuality CtApImageProcess_FreeRunning.PpImageProcess_ParkingLot_20ms.DeSVParkingSlot.gstSpaceFront[3].nType CtApImageProcess_FreeRunning.PpImageProcess_ParkingLot_20ms.DeSVParkingSlot.gstSpaceFront[3].nParkingGarageID CtApImageProcess_FreeRunning.PpImageProcess_ParkingLot_20ms.DeSVParkingSlot.gstSpaceFront[3].fLineWith CtApImageProcess_FreeRunning.PpImageProcess_ParkingLot_20ms.DeSVParkingSlot.gstSpaceFront[3].fSita CtApImageProcess_FreeRunning.PpImageProcess_ParkingLot_20ms.DeSVParkingSlot.gstSpaceFront[3].fIdentifierNum CtApImageProcess_FreeRunning.PpImageProcess_ParkingLot_20ms.DeSVParkingSlot.gstSpaceFront[3].fReserved CtApImageProcess_FreeRunning.PpImageProcess_ParkingLot_20ms.DeSVParkingSlot.gstSpaceFront[4].nValid CtApImageProcess_FreeRunning.PpImageProcess_ParkingLot_20ms.DeSVParkingSlot.gstSpaceFront[4].gfPos[0] CtApImageProcess_FreeRunning.PpImageProcess_ParkingLot_20ms.DeSVParkingSlot.gstSpaceFront[4].gfPos[1] CtApImageProcess_FreeRunning.PpImageProcess_ParkingLot_20ms.DeSVParkingSlot.gstSpaceFront[4].gfPos[2] CtApImageProcess_FreeRunning.PpImageProcess_ParkingLot_20ms.DeSVParkingSlot.gstSpaceFront[4].gfPos[3] CtApImageProcess_FreeRunning.PpImageProcess_ParkingLot_20ms.DeSVParkingSlot.gstSpaceFront[4].nQuality CtApImageProcess_FreeRunning.PpImageProcess_ParkingLot_20ms.DeSVParkingSlot.gstSpaceFront[4].nType CtApImageProcess_FreeRunning.PpImageProcess_ParkingLot_20ms.DeSVParkingSlot.gstSpaceFront[4].nParkingGarageID CtApImageProcess_FreeRunning.PpImageProcess_ParkingLot_20ms.DeSVParkingSlot.gstSpaceFront[4].fLineWith CtApImageProcess_FreeRunning.PpImageProcess_ParkingLot_20ms.DeSVParkingSlot.gstSpaceFront[4].fSita CtApImageProcess_FreeRunning.PpImageProcess_ParkingLot_20ms.DeSVParkingSlot.gstSpaceFront[4].fIdentifierNum CtApImageProcess_FreeRunning.PpImageProcess_ParkingLot_20ms.DeSVParkingSlot.gstSpaceFront[4].fReserved CtApImageProcess_FreeRunning.PpImageProcess_ParkingLot_20ms.DeSVParkingSlot.gstSpaceFront[5].nValid CtApImageProcess_FreeRunning.PpImageProcess_ParkingLot_20ms.DeSVParkingSlot.gstSpaceFront[5].gfPos[0] CtApImageProcess_FreeRunning.PpImageProcess_ParkingLot_20ms.DeSVParkingSlot.gstSpaceFront[5].gfPos[1] CtApImageProcess_FreeRunning.PpImageProcess_ParkingLot_20ms.DeSVParkingSlot.gstSpaceFront[5].gfPos[2] CtApImageProcess_FreeRunning.PpImageProcess_ParkingLot_20ms.DeSVParkingSlot.gstSpaceFront[5].gfPos[3] CtApImageProcess_FreeRunning.PpImageProcess_ParkingLot_20ms.DeSVParkingSlot.gstSpaceFront[5].nQuality CtApImageProcess_FreeRunning.PpImageProcess_ParkingLot_20ms.DeSVParkingSlot.gstSpaceFront[5].nType CtApImageProcess_FreeRunning.PpImageProcess_ParkingLot_20ms.DeSVParkingSlot.gstSpaceFront[5].nParkingGarageID CtApImageProcess_FreeRunning.PpImageProcess_ParkingLot_20ms.DeSVParkingSlot.gstSpaceFront[5].fLineWith CtApImageProcess_FreeRunning.PpImageProcess_ParkingLot_20ms.DeSVParkingSlot.gstSpaceFront[5].fSita CtApImageProcess_FreeRunning.PpImageProcess_ParkingLot_20ms.DeSVParkingSlot.gstSpaceFront[5].fIdentifierNum CtApImageProcess_FreeRunning.PpImageProcess_ParkingLot_20ms.DeSVParkingSlot.gstSpaceFront[5].fReserved CtApImageProcess_FreeRunning.PpImageProcess_ParkingLot_20ms.DeSVParkingSlot.gstSpaceFront[6].nValid CtApImageProcess_FreeRunning.PpImageProcess_ParkingLot_20ms.DeSVParkingSlot.gstSpaceFront[6].gfPos[0] CtApImageProcess_FreeRunning.PpImageProcess_ParkingLot_20ms.DeSVParkingSlot.gstSpaceFront[6].gfPos[1] CtApImageProcess_FreeRunning.PpImageProcess_ParkingLot_20ms.DeSVParkingSlot.gstSpaceFront[6].gfPos[2] CtApImageProcess_FreeRunning.PpImageProcess_ParkingLot_20ms.DeSVParkingSlot.gstSpaceFront[6].gfPos[3] CtApImageProcess_FreeRunning.PpImageProcess_ParkingLot_20ms.DeSVParkingSlot.gstSpaceFront[6].nQuality CtApImageProcess_FreeRunning.PpImageProcess_ParkingLot_20ms.DeSVParkingSlot.gstSpaceFront[6].nType CtApImageProcess_FreeRunning.PpImageProcess_ParkingLot_20ms.DeSVParkingSlot.gstSpaceFront[6].nParkingGarageID CtApImageProcess_FreeRunning.PpImageProcess_ParkingLot_20ms.DeSVParkingSlot.gstSpaceFront[6].fLineWith CtApImageProcess_FreeRunning.PpImageProcess_ParkingLot_20ms.DeSVParkingSlot.gstSpaceFront[6].fSita CtApImageProcess_FreeRunning.PpImageProcess_ParkingLot_20ms.DeSVParkingSlot.gstSpaceFront[6].fIdentifierNum CtApImageProcess_FreeRunning.PpImageProcess_ParkingLot_20ms.DeSVParkingSlot.gstSpaceFront[6].fReserved CtApImageProcess_FreeRunning.PpImageProcess_ParkingLot_20ms.DeSVParkingSlot.gstSpaceFront[7].nValid CtApImageProcess_FreeRunning.PpImageProcess_ParkingLot_20ms.DeSVParkingSlot.gstSpaceFront[7].gfPos[0] CtApImageProcess_FreeRunning.PpImageProcess_ParkingLot_20ms.DeSVParkingSlot.gstSpaceFront[7].gfPos[1] CtApImageProcess_FreeRunning.PpImageProcess_ParkingLot_20ms.DeSVParkingSlot.gstSpaceFront[7].gfPos[2] CtApImageProcess_FreeRunning.PpImageProcess_ParkingLot_20ms.DeSVParkingSlot.gstSpaceFront[7].gfPos[3] CtApImageProcess_FreeRunning.PpImageProcess_ParkingLot_20ms.DeSVParkingSlot.gstSpaceFront[7].nQuality CtApImageProcess_FreeRunning.PpImageProcess_ParkingLot_20ms.DeSVParkingSlot.gstSpaceFront[7].nType CtApImageProcess_FreeRunning.PpImageProcess_ParkingLot_20ms.DeSVParkingSlot.gstSpaceFront[7].nParkingGarageID CtApImageProcess_FreeRunning.PpImageProcess_ParkingLot_20ms.DeSVParkingSlot.gstSpaceFront[7].fLineWith CtApImageProcess_FreeRunning.PpImageProcess_ParkingLot_20ms.DeSVParkingSlot.gstSpaceFront[7].fSita CtApImageProcess_FreeRunning.PpImageProcess_ParkingLot_20ms.DeSVParkingSlot.gstSpaceFront[7].fIdentifierNum CtApImageProcess_FreeRunning.PpImageProcess_ParkingLot_20ms.DeSVParkingSlot.gstSpaceFront[7].fReserved CtApImageProcess_FreeRunning.PpImageProcess_ParkingLot_20ms.DeSVParkingSlot.gstSpaceRight[0].nValid CtApImageProcess_FreeRunning.PpImageProcess_ParkingLot_20ms.DeSVParkingSlot.gstSpaceRight[0].gfPos[0] CtApImageProcess_FreeRunning.PpImageProcess_ParkingLot_20ms.DeSVParkingSlot.gstSpaceRight[0].gfPos[1] CtApImageProcess_FreeRunning.PpImageProcess_ParkingLot_20ms.DeSVParkingSlot.gstSpaceRight[0].gfPos[2] CtApImageProcess_FreeRunning.PpImageProcess_ParkingLot_20ms.DeSVParkingSlot.gstSpaceRight[0].gfPos[3] CtApImageProcess_FreeRunning.PpImageProcess_ParkingLot_20ms.DeSVParkingSlot.gstSpaceRight[0].nQuality CtApImageProcess_FreeRunning.PpImageProcess_ParkingLot_20ms.DeSVParkingSlot.gstSpaceRight[0].nType CtApImageProcess_FreeRunning.PpImageProcess_ParkingLot_20ms.DeSVParkingSlot.gstSpaceRight[0].nParkingGarageID CtApImageProcess_FreeRunning.PpImageProcess_ParkingLot_20ms.DeSVParkingSlot.gstSpaceRight[0].fLineWith CtApImageProcess_FreeRunning.PpImageProcess_ParkingLot_20ms.DeSVParkingSlot.gstSpaceRight[0].fSita CtApImageProcess_FreeRunning.PpImageProcess_ParkingLot_20ms.DeSVParkingSlot.gstSpaceRight[0].fIdentifierNum CtApImageProcess_FreeRunning.PpImageProcess_ParkingLot_20ms.DeSVParkingSlot.gstSpaceRight[0].fReserved CtApImageProcess_FreeRunning.PpImageProcess_ParkingLot_20ms.DeSVParkingSlot.gstSpaceRight[1].nValid CtApImageProcess_FreeRunning.PpImageProcess_ParkingLot_20ms.DeSVParkingSlot.gstSpaceRight[1].gfPos[0] CtApImageProcess_FreeRunning.PpImageProcess_ParkingLot_20ms.DeSVParkingSlot.gstSpaceRight[1].gfPos[1] CtApImageProcess_FreeRunning.PpImageProcess_ParkingLot_20ms.DeSVParkingSlot.gstSpaceRight[1].gfPos[2] CtApImageProcess_FreeRunning.PpImageProcess_ParkingLot_20ms.DeSVParkingSlot.gstSpaceRight[1].gfPos[3] CtApImageProcess_FreeRunning.PpImageProcess_ParkingLot_20ms.DeSVParkingSlot.gstSpaceRight[1].nQuality CtApImageProcess_FreeRunning.PpImageProcess_ParkingLot_20ms.DeSVParkingSlot.gstSpaceRight[1].nType CtApImageProcess_FreeRunning.PpImageProcess_ParkingLot_20ms.DeSVParkingSlot.gstSpaceRight[1].nParkingGarageID CtApImageProcess_FreeRunning.PpImageProcess_ParkingLot_20ms.DeSVParkingSlot.gstSpaceRight[1].fLineWith CtApImageProcess_FreeRunning.PpImageProcess_ParkingLot_20ms.DeSVParkingSlot.gstSpaceRight[1].fSita CtApImageProcess_FreeRunning.PpImageProcess_ParkingLot_20ms.DeSVParkingSlot.gstSpaceRight[1].fIdentifierNum CtApImageProcess_FreeRunning.PpImageProcess_ParkingLot_20ms.DeSVParkingSlot.gstSpaceRight[1].fReserved CtApImageProcess_FreeRunning.PpImageProcess_ParkingLot_20ms.DeSVParkingSlot.gstSpaceRight[2].nValid CtApImageProcess_FreeRunning.PpImageProcess_ParkingLot_20ms.DeSVParkingSlot.gstSpaceRight[2].gfPos[0] CtApImageProcess_FreeRunning.PpImageProcess_ParkingLot_20ms.DeSVParkingSlot.gstSpaceRight[2].gfPos[1] CtApImageProcess_FreeRunning.PpImageProcess_ParkingLot_20ms.DeSVParkingSlot.gstSpaceRight[2].gfPos[2] CtApImageProcess_FreeRunning.PpImageProcess_ParkingLot_20ms.DeSVParkingSlot.gstSpaceRight[2].gfPos[3] CtApImageProcess_FreeRunning.PpImageProcess_ParkingLot_20ms.DeSVParkingSlot.gstSpaceRight[2].nQuality CtApImageProcess_FreeRunning.PpImageProcess_ParkingLot_20ms.DeSVParkingSlot.gstSpaceRight[2].nType CtApImageProcess_FreeRunning.PpImageProcess_ParkingLot_20ms.DeSVParkingSlot.gstSpaceRight[2].nParkingGarageID CtApImageProcess_FreeRunning.PpImageProcess_ParkingLot_20ms.DeSVParkingSlot.gstSpaceRight[2].fLineWith CtApImageProcess_FreeRunning.PpImageProcess_ParkingLot_20ms.DeSVParkingSlot.gstSpaceRight[2].fSita CtApImageProcess_FreeRunning.PpImageProcess_ParkingLot_20ms.DeSVParkingSlot.gstSpaceRight[2].fIdentifierNum CtApImageProcess_FreeRunning.PpImageProcess_ParkingLot_20ms.DeSVParkingSlot.gstSpaceRight[2].fReserved CtApImageProcess_FreeRunning.PpImageProcess_ParkingLot_20ms.DeSVParkingSlot.gstSpaceRight[3].nValid CtApImageProcess_FreeRunning.PpImageProcess_ParkingLot_20ms.DeSVParkingSlot.gstSpaceRight[3].gfPos[0] CtApImageProcess_FreeRunning.PpImageProcess_ParkingLot_20ms.DeSVParkingSlot.gstSpaceRight[3].gfPos[1] CtApImageProcess_FreeRunning.PpImageProcess_ParkingLot_20ms.DeSVParkingSlot.gstSpaceRight[3].gfPos[2] CtApImageProcess_FreeRunning.PpImageProcess_ParkingLot_20ms.DeSVParkingSlot.gstSpaceRight[3].gfPos[3] CtApImageProcess_FreeRunning.PpImageProcess_ParkingLot_20ms.DeSVParkingSlot.gstSpaceRight[3].nQuality CtApImageProcess_FreeRunning.PpImageProcess_ParkingLot_20ms.DeSVParkingSlot.gstSpaceRight[3].nType CtApImageProcess_FreeRunning.PpImageProcess_ParkingLot_20ms.DeSVParkingSlot.gstSpaceRight[3].nParkingGarageID CtApImageProcess_FreeRunning.PpImageProcess_ParkingLot_20ms.DeSVParkingSlot.gstSpaceRight[3].fLineWith CtApImageProcess_FreeRunning.PpImageProcess_ParkingLot_20ms.DeSVParkingSlot.gstSpaceRight[3].fSita CtApImageProcess_FreeRunning.PpImageProcess_ParkingLot_20ms.DeSVParkingSlot.gstSpaceRight[3].fIdentifierNum CtApImageProcess_FreeRunning.PpImageProcess_ParkingLot_20ms.DeSVParkingSlot.gstSpaceRight[3].fReserved CtApImageProcess_FreeRunning.PpImageProcess_ParkingLot_20ms.DeSVParkingSlot.gstSpaceRight[4].nValid CtApImageProcess_FreeRunning.PpImageProcess_ParkingLot_20ms.DeSVParkingSlot.gstSpaceRight[4].gfPos[0] CtApImageProcess_FreeRunning.PpImageProcess_ParkingLot_20ms.DeSVParkingSlot.gstSpaceRight[4].gfPos[1] CtApImageProcess_FreeRunning.PpImageProcess_ParkingLot_20ms.DeSVParkingSlot.gstSpaceRight[4].gfPos[2] CtApImageProcess_FreeRunning.PpImageProcess_ParkingLot_20ms.DeSVParkingSlot.gstSpaceRight[4].gfPos[3] CtApImageProcess_FreeRunning.PpImageProcess_ParkingLot_20ms.DeSVParkingSlot.gstSpaceRight[4].nQuality CtApImageProcess_FreeRunning.PpImageProcess_ParkingLot_20ms.DeSVParkingSlot.gstSpaceRight[4].nType CtApImageProcess_FreeRunning.PpImageProcess_ParkingLot_20ms.DeSVParkingSlot.gstSpaceRight[4].nParkingGarageID CtApImageProcess_FreeRunning.PpImageProcess_ParkingLot_20ms.DeSVParkingSlot.gstSpaceRight[4].fLineWith CtApImageProcess_FreeRunning.PpImageProcess_ParkingLot_20ms.DeSVParkingSlot.gstSpaceRight[4].fSita CtApImageProcess_FreeRunning.PpImageProcess_ParkingLot_20ms.DeSVParkingSlot.gstSpaceRight[4].fIdentifierNum CtApImageProcess_FreeRunning.PpImageProcess_ParkingLot_20ms.DeSVParkingSlot.gstSpaceRight[4].fReserved CtApImageProcess_FreeRunning.PpImageProcess_ParkingLot_20ms.DeSVParkingSlot.gstSpaceRight[5].nValid CtApImageProcess_FreeRunning.PpImageProcess_ParkingLot_20ms.DeSVParkingSlot.gstSpaceRight[5].gfPos[0] CtApImageProcess_FreeRunning.PpImageProcess_ParkingLot_20ms.DeSVParkingSlot.gstSpaceRight[5].gfPos[1] CtApImageProcess_FreeRunning.PpImageProcess_ParkingLot_20ms.DeSVParkingSlot.gstSpaceRight[5].gfPos[2] CtApImageProcess_FreeRunning.PpImageProcess_ParkingLot_20ms.DeSVParkingSlot.gstSpaceRight[5].gfPos[3] CtApImageProcess_FreeRunning.PpImageProcess_ParkingLot_20ms.DeSVParkingSlot.gstSpaceRight[5].nQuality CtApImageProcess_FreeRunning.PpImageProcess_ParkingLot_20ms.DeSVParkingSlot.gstSpaceRight[5].nType CtApImageProcess_FreeRunning.PpImageProcess_ParkingLot_20ms.DeSVParkingSlot.gstSpaceRight[5].nParkingGarageID CtApImageProcess_FreeRunning.PpImageProcess_ParkingLot_20ms.DeSVParkingSlot.gstSpaceRight[5].fLineWith CtApImageProcess_FreeRunning.PpImageProcess_ParkingLot_20ms.DeSVParkingSlot.gstSpaceRight[5].fSita CtApImageProcess_FreeRunning.PpImageProcess_ParkingLot_20ms.DeSVParkingSlot.gstSpaceRight[5].fIdentifierNum CtApImageProcess_FreeRunning.PpImageProcess_ParkingLot_20ms.DeSVParkingSlot.gstSpaceRight[5].fReserved CtApImageProcess_FreeRunning.PpImageProcess_ParkingLot_20ms.DeSVParkingSlot.gstSpaceRight[6].nValid CtApImageProcess_FreeRunning.PpImageProcess_ParkingLot_20ms.DeSVParkingSlot.gstSpaceRight[6].gfPos[0] CtApImageProcess_FreeRunning.PpImageProcess_ParkingLot_20ms.DeSVParkingSlot.gstSpaceRight[6].gfPos[1] CtApImageProcess_FreeRunning.PpImageProcess_ParkingLot_20ms.DeSVParkingSlot.gstSpaceRight[6].gfPos[2] CtApImageProcess_FreeRunning.PpImageProcess_ParkingLot_20ms.DeSVParkingSlot.gstSpaceRight[6].gfPos[3] CtApImageProcess_FreeRunning.PpImageProcess_ParkingLot_20ms.DeSVParkingSlot.gstSpaceRight[6].nQuality CtApImageProcess_FreeRunning.PpImageProcess_ParkingLot_20ms.DeSVParkingSlot.gstSpaceRight[6].nType CtApImageProcess_FreeRunning.PpImageProcess_ParkingLot_20ms.DeSVParkingSlot.gstSpaceRight[6].nParkingGarageID CtApImageProcess_FreeRunning.PpImageProcess_ParkingLot_20ms.DeSVParkingSlot.gstSpaceRight[6].fLineWith CtApImageProcess_FreeRunning.PpImageProcess_ParkingLot_20ms.DeSVParkingSlot.gstSpaceRight[6].fSita CtApImageProcess_FreeRunning.PpImageProcess_ParkingLot_20ms.DeSVParkingSlot.gstSpaceRight[6].fIdentifierNum CtApImageProcess_FreeRunning.PpImageProcess_ParkingLot_20ms.DeSVParkingSlot.gstSpaceRight[6].fReserved CtApImageProcess_FreeRunning.PpImageProcess_ParkingLot_20ms.DeSVParkingSlot.gstSpaceRight[7].nValid CtApImageProcess_FreeRunning.PpImageProcess_ParkingLot_20ms.DeSVParkingSlot.gstSpaceRight[7].gfPos[0] CtApImageProcess_FreeRunning.PpImageProcess_ParkingLot_20ms.DeSVParkingSlot.gstSpaceRight[7].gfPos[1] CtApImageProcess_FreeRunning.PpImageProcess_ParkingLot_20ms.DeSVParkingSlot.gstSpaceRight[7].gfPos[2] CtApImageProcess_FreeRunning.PpImageProcess_ParkingLot_20ms.DeSVParkingSlot.gstSpaceRight[7].gfPos[3] CtApImageProcess_FreeRunning.PpImageProcess_ParkingLot_20ms.DeSVParkingSlot.gstSpaceRight[7].nQuality CtApImageProcess_FreeRunning.PpImageProcess_ParkingLot_20ms.DeSVParkingSlot.gstSpaceRight[7].nType CtApImageProcess_FreeRunning.PpImageProcess_ParkingLot_20ms.DeSVParkingSlot.gstSpaceRight[7].nParkingGarageID CtApImageProcess_FreeRunning.PpImageProcess_ParkingLot_20ms.DeSVParkingSlot.gstSpaceRight[7].fLineWith CtApImageProcess_FreeRunning.PpImageProcess_ParkingLot_20ms.DeSVParkingSlot.gstSpaceRight[7].fSita CtApImageProcess_FreeRunning.PpImageProcess_ParkingLot_20ms.DeSVParkingSlot.gstSpaceRight[7].fIdentifierNum CtApImageProcess_FreeRunning.PpImageProcess_ParkingLot_20ms.DeSVParkingSlot.gstSpaceRight[7].fReserved CtApImageProcess_FreeRunning.PpImageProcess_ParkingLot_20ms.DeSVParkingSlot.gstSpaceLeft[0].nValid CtApImageProcess_FreeRunning.PpImageProcess_ParkingLot_20ms.DeSVParkingSlot.gstSpaceLeft[0].gfPos[0] CtApImageProcess_FreeRunning.PpImageProcess_ParkingLot_20ms.DeSVParkingSlot.gstSpaceLeft[0].gfPos[1] CtApImageProcess_FreeRunning.PpImageProcess_ParkingLot_20ms.DeSVParkingSlot.gstSpaceLeft[0].gfPos[2] CtApImageProcess_FreeRunning.PpImageProcess_ParkingLot_20ms.DeSVParkingSlot.gstSpaceLeft[0].gfPos[3] CtApImageProcess_FreeRunning.PpImageProcess_ParkingLot_20ms.DeSVParkingSlot.gstSpaceLeft[0].nQuality CtApImageProcess_FreeRunning.PpImageProcess_ParkingLot_20ms.DeSVParkingSlot.gstSpaceLeft[0].nType CtApImageProcess_FreeRunning.PpImageProcess_ParkingLot_20ms.DeSVParkingSlot.gstSpaceLeft[0].nParkingGarageID CtApImageProcess_FreeRunning.PpImageProcess_ParkingLot_20ms.DeSVParkingSlot.gstSpaceLeft[0].fLineWith CtApImageProcess_FreeRunning.PpImageProcess_ParkingLot_20ms.DeSVParkingSlot.gstSpaceLeft[0].fSita CtApImageProcess_FreeRunning.PpImageProcess_ParkingLot_20ms.DeSVParkingSlot.gstSpaceLeft[0].fIdentifierNum CtApImageProcess_FreeRunning.PpImageProcess_ParkingLot_20ms.DeSVParkingSlot.gstSpaceLeft[0].fReserved CtApImageProcess_FreeRunning.PpImageProcess_ParkingLot_20ms.DeSVParkingSlot.gstSpaceLeft[1].nValid CtApImageProcess_FreeRunning.PpImageProcess_ParkingLot_20ms.DeSVParkingSlot.gstSpaceLeft[1].gfPos[0] CtApImageProcess_FreeRunning.PpImageProcess_ParkingLot_20ms.DeSVParkingSlot.gstSpaceLeft[1].gfPos[1] CtApImageProcess_FreeRunning.PpImageProcess_ParkingLot_20ms.DeSVParkingSlot.gstSpaceLeft[1].gfPos[2] CtApImageProcess_FreeRunning.PpImageProcess_ParkingLot_20ms.DeSVParkingSlot.gstSpaceLeft[1].gfPos[3] CtApImageProcess_FreeRunning.PpImageProcess_ParkingLot_20ms.DeSVParkingSlot.gstSpaceLeft[1].nQuality CtApImageProcess_FreeRunning.PpImageProcess_ParkingLot_20ms.DeSVParkingSlot.gstSpaceLeft[1].nType CtApImageProcess_FreeRunning.PpImageProcess_ParkingLot_20ms.DeSVParkingSlot.gstSpaceLeft[1].nParkingGarageID /end REF_CHARACTERISTIC
/end GROUP
/begin RECORD_LAYOUT __UBYTE_S FNC_VALUES 1 UBYTE COLUMN_DIR DIRECT /end RECORD_LAYOUT
/begin RECORD_LAYOUT __UWORD_S FNC_VALUES 1 UWORD COLUMN_DIR DIRECT /end RECORD_LAYOUT
/begin RECORD_LAYOUT __ULONG_S FNC_VALUES 1 ULONG COLUMN_DIR DIRECT /end RECORD_LAYOUT
/begin RECORD_LAYOUT __FLOAT32_IEEE_S FNC_VALUES 1 FLOAT32_IEEE COLUMN_DIR DIRECT /end RECORD_LAYOUT
/end MODULE
/end PROJECT
