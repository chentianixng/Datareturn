/* @@@@ File written by CANAPE_VERSION 11 0 10 @@@@ */
ASAP2_VERSION 1 61
/begin PROJECT MotionWise_PerformanceHost00_XCPonEthernet ""
/begin MODULE CPP ""
/begin MOD_COMMON "" BYTE_ORDER MSB_LAST ALIGNMENT_BYTE 1 ALIGNMENT_WORD 2 ALIGNMENT_LONG 4 ALIGNMENT_INT64 1 ALIGNMENT_FLOAT32_IEEE 4 ALIGNMENT_FLOAT64_IEEE 8 /end MOD_COMMON
/begin IF_DATA XCP
 /begin PROTOCOL_LAYER 0x0101 2000 10000 2000 2000 2000 2000 0 255 /* kXcpMaxCto */ 255 /* kXcpMaxDto */ BYTE_ORDER_MSB_LAST ADDRESS_GRANULARITY_BYTE OPTIONAL_CMD ALLOC_ODT_ENTRY OPTIONAL_CMD ALLOC_ODT OPTIONAL_CMD ALLOC_DAQ OPTIONAL_CMD FREE_DAQ OPTIONAL_CMD GET_DAQ_EVENT_INFO OPTIONAL_CMD GET_DAQ_RESOLUTION_INFO OPTIONAL_CMD GET_DAQ_PROCESSOR_INFO OPTIONAL_CMD START_STOP_SYNCH OPTIONAL_CMD START_STOP_DAQ_LIST OPTIONAL_CMD GET_DAQ_LIST_MODE OPTIONAL_CMD SET_DAQ_LIST_MODE OPTIONAL_CMD WRITE_DAQ OPTIONAL_CMD SET_DAQ_PTR OPTIONAL_CMD CLEAR_DAQ_LIST OPTIONAL_CMD DOWNLOAD OPTIONAL_CMD SHORT_UPLOAD OPTIONAL_CMD UPLOAD OPTIONAL_CMD SET_MTA OPTIONAL_CMD GET_COMM_MODE_INFO /end PROTOCOL_LAYER
 /begin PAG 0x00 /end PAG
 /begin XCP_ON_UDP_IP 0x0100 0xC418 ADDRESS "192.168.1.70" /end XCP_ON_UDP_IP
/end IF_DATA
/begin IF_DATA GENERIC_BSW_TEMPLATE_VERSION 0x010000 /end IF_DATA
/begin MOD_PAR "" /end MOD_PAR
/begin CHARACTERISTIC CtApImageProcess_FreeRunning.PpBdImageProcessWrite.BdSV_Normal.DeStatus "" VALUE 0x300000 __UWORD_S 0 CtApImageProcess_FreeRunning.PpBdImageProcessWrite.BdSV_Normal.DeStatus.Dt_ENUM_PdDatablockStatus.CONVERSION 0 65535 ECU_ADDRESS_EXTENSION 0x80 /end CHARACTERISTIC
/begin CHARACTERISTIC CtApImageProcess_FreeRunning.PpBdImageProcessWrite.BdSV_Normal.DeVersion.DeExpectedVersion.DeMajor "" VALUE 0x300004 __UBYTE_S 0 NO_COMPU_METHOD 0 255 ECU_ADDRESS_EXTENSION 0x80 /end CHARACTERISTIC
/begin CHARACTERISTIC CtApImageProcess_FreeRunning.PpBdImageProcessWrite.BdSV_Normal.DeVersion.DeExpectedVersion.DeMinor "" VALUE 0x300005 __UBYTE_S 0 NO_COMPU_METHOD 0 255 ECU_ADDRESS_EXTENSION 0x80 /end CHARACTERISTIC
/begin CHARACTERISTIC CtApImageProcess_FreeRunning.PpBdImageProcessWrite.BdSV_Normal.DeVersion.DeVersion.DeMajor "" VALUE 0x300008 __UBYTE_S 0 NO_COMPU_METHOD 0 255 ECU_ADDRESS_EXTENSION 0x80 /end CHARACTERISTIC
/begin CHARACTERISTIC CtApImageProcess_FreeRunning.PpBdImageProcessWrite.BdSV_Normal.DeVersion.DeVersion.DeMinor "" VALUE 0x300009 __UBYTE_S 0 NO_COMPU_METHOD 0 255 ECU_ADDRESS_EXTENSION 0x80 /end CHARACTERISTIC
/begin CHARACTERISTIC CtApImageProcess_FreeRunning.PpBdImageProcessWrite.BdSV_Normal.DeData "4694304 uint8 array" VAL_BLK 0x30000c __UBYTE_S 0 NO_COMPU_METHOD 0 255 ECU_ADDRESS_EXTENSION 0x80 MATRIX_DIM 4694304 1 1 /end CHARACTERISTIC
/begin CHARACTERISTIC CtApImageProcess_FreeRunning.PpDiagImageProcess_FreeRunningWrite.DeMeasuredValue_ImageProcess_FreeRunning.SvCamCalFail_0xb030.Right_camera_calibration_fail "" VALUE 0x310000 __UBYTE_S 0 NO_COMPU_METHOD 0 255 ECU_ADDRESS_EXTENSION 0x80 /end CHARACTERISTIC
/begin CHARACTERISTIC CtApImageProcess_FreeRunning.PpDiagImageProcess_FreeRunningWrite.DeMeasuredValue_ImageProcess_FreeRunning.SvCamCalFail_0xb030.Reserved "" VALUE 0x310001 __UBYTE_S 0 NO_COMPU_METHOD 0 255 ECU_ADDRESS_EXTENSION 0x80 /end CHARACTERISTIC
/begin CHARACTERISTIC CtApImageProcess_FreeRunning.PpDiagImageProcess_FreeRunningWrite.DeMeasuredValue_ImageProcess_FreeRunning.SvCamCalFail_0xb030.Rear_camera_calibration_fail "" VALUE 0x310002 __UBYTE_S 0 NO_COMPU_METHOD 0 255 ECU_ADDRESS_EXTENSION 0x80 /end CHARACTERISTIC
/begin CHARACTERISTIC CtApImageProcess_FreeRunning.PpDiagImageProcess_FreeRunningWrite.DeMeasuredValue_ImageProcess_FreeRunning.SvCamCalFail_0xb030.Front_camera_calibration_fail "" VALUE 0x310003 __UBYTE_S 0 NO_COMPU_METHOD 0 255 ECU_ADDRESS_EXTENSION 0x80 /end CHARACTERISTIC
/begin CHARACTERISTIC CtApImageProcess_FreeRunning.PpDiagImageProcess_FreeRunningWrite.DeMeasuredValue_ImageProcess_FreeRunning.SvCamCalFail_0xb030.Left_camera_calibration_fail "" VALUE 0x310004 __UBYTE_S 0 NO_COMPU_METHOD 0 255 ECU_ADDRESS_EXTENSION 0x80 /end CHARACTERISTIC
/begin CHARACTERISTIC CtApImageProcess_FreeRunning.PpDiagImageProcess_FreeRunningWrite.DeMeasuredValue_ImageProcess_FreeRunning.SvCamDatafail_0xb036.Reserved "" VALUE 0x310008 __UBYTE_S 0 NO_COMPU_METHOD 0 255 ECU_ADDRESS_EXTENSION 0x80 /end CHARACTERISTIC
/begin CHARACTERISTIC CtApImageProcess_FreeRunning.PpDiagImageProcess_FreeRunningWrite.DeMeasuredValue_ImageProcess_FreeRunning.SvCamDatafail_0xb036.Front_camera_Hue_value "" VALUE 0x310009 __UBYTE_S 0 NO_COMPU_METHOD 0 255 ECU_ADDRESS_EXTENSION 0x80 /end CHARACTERISTIC
/begin CHARACTERISTIC CtApImageProcess_FreeRunning.PpDiagImageProcess_FreeRunningWrite.DeMeasuredValue_ImageProcess_FreeRunning.SvCamDatafail_0xb036.Rear_camera_Hue_value "" VALUE 0x31000a __UBYTE_S 0 NO_COMPU_METHOD 0 255 ECU_ADDRESS_EXTENSION 0x80 /end CHARACTERISTIC
/begin CHARACTERISTIC CtApImageProcess_FreeRunning.PpDiagImageProcess_FreeRunningWrite.DeMeasuredValue_ImageProcess_FreeRunning.SvCamDatafail_0xb036.Rear_camera_loss_signal "" VALUE 0x31000b __UBYTE_S 0 NO_COMPU_METHOD 0 255 ECU_ADDRESS_EXTENSION 0x80 /end CHARACTERISTIC
/begin CHARACTERISTIC CtApImageProcess_FreeRunning.PpDiagImageProcess_FreeRunningWrite.DeMeasuredValue_ImageProcess_FreeRunning.SvCamDatafail_0xb036.Left_camera_loss_signal "" VALUE 0x31000c __UBYTE_S 0 NO_COMPU_METHOD 0 255 ECU_ADDRESS_EXTENSION 0x80 /end CHARACTERISTIC
/begin CHARACTERISTIC CtApImageProcess_FreeRunning.PpDiagImageProcess_FreeRunningWrite.DeMeasuredValue_ImageProcess_FreeRunning.SvCamDatafail_0xb036.Right_camera_loss_signal "" VALUE 0x31000d __UBYTE_S 0 NO_COMPU_METHOD 0 255 ECU_ADDRESS_EXTENSION 0x80 /end CHARACTERISTIC
/begin CHARACTERISTIC CtApImageProcess_FreeRunning.PpDiagImageProcess_FreeRunningWrite.DeMeasuredValue_ImageProcess_FreeRunning.SvCamDatafail_0xb036.Left_camera_Hue_value "" VALUE 0x31000e __UBYTE_S 0 NO_COMPU_METHOD 0 255 ECU_ADDRESS_EXTENSION 0x80 /end CHARACTERISTIC
/begin CHARACTERISTIC CtApImageProcess_FreeRunning.PpDiagImageProcess_FreeRunningWrite.DeMeasuredValue_ImageProcess_FreeRunning.SvCamDatafail_0xb036.Front_camera_loss_signal "" VALUE 0x31000f __UBYTE_S 0 NO_COMPU_METHOD 0 255 ECU_ADDRESS_EXTENSION 0x80 /end CHARACTERISTIC
/begin CHARACTERISTIC CtApImageProcess_FreeRunning.PpDiagImageProcess_FreeRunningWrite.DeMeasuredValue_ImageProcess_FreeRunning.SvCamDatafail_0xb036.Right_camera_Hue_value "" VALUE 0x310010 __UBYTE_S 0 NO_COMPU_METHOD 0 255 ECU_ADDRESS_EXTENSION 0x80 /end CHARACTERISTIC
/begin CHARACTERISTIC CtApImageProcess_FreeRunning.PpDiagImageProcess_FreeRunningWrite.DeMeasuredValue_ImageProcess_FreeRunning.SvCamTemperature_0xb031.Front_camera_temperatureRange "" VALUE 0x310014 __SBYTE_S 0 NO_COMPU_METHOD -128 127 ECU_ADDRESS_EXTENSION 0x80 /end CHARACTERISTIC
/begin CHARACTERISTIC CtApImageProcess_FreeRunning.PpDiagImageProcess_FreeRunningWrite.DeMeasuredValue_ImageProcess_FreeRunning.SvCamTemperature_0xb031.Right_camera_temperatureRange "" VALUE 0x310015 __SBYTE_S 0 NO_COMPU_METHOD -128 127 ECU_ADDRESS_EXTENSION 0x80 /end CHARACTERISTIC
/begin CHARACTERISTIC CtApImageProcess_FreeRunning.PpDiagImageProcess_FreeRunningWrite.DeMeasuredValue_ImageProcess_FreeRunning.SvCamTemperature_0xb031.Left_camera_temperatureRange "" VALUE 0x310016 __SBYTE_S 0 NO_COMPU_METHOD -128 127 ECU_ADDRESS_EXTENSION 0x80 /end CHARACTERISTIC
/begin CHARACTERISTIC CtApImageProcess_FreeRunning.PpDiagImageProcess_FreeRunningWrite.DeMeasuredValue_ImageProcess_FreeRunning.SvCamTemperature_0xb031.Reserved "" VALUE 0x310017 __UBYTE_S 0 NO_COMPU_METHOD 0 255 ECU_ADDRESS_EXTENSION 0x80 /end CHARACTERISTIC
/begin CHARACTERISTIC CtApImageProcess_FreeRunning.PpDiagImageProcess_FreeRunningWrite.DeMeasuredValue_ImageProcess_FreeRunning.SvCamTemperature_0xb031.Rear_camera_temperatureRange "" VALUE 0x310018 __SBYTE_S 0 NO_COMPU_METHOD -128 127 ECU_ADDRESS_EXTENSION 0x80 /end CHARACTERISTIC
/begin CHARACTERISTIC CtApImageProcess_FreeRunning.PpDiagImageProcess_FreeRunningWrite.DeMeasuredValue_ImageProcess_FreeRunning.RearviewMirrorStatu_0xb032.Left_rearview_mirror_is_not_folding "" VALUE 0x31001c __UBYTE_S 0 NO_COMPU_METHOD 0 255 ECU_ADDRESS_EXTENSION 0x80 /end CHARACTERISTIC
/begin CHARACTERISTIC CtApImageProcess_FreeRunning.PpDiagImageProcess_FreeRunningWrite.DeMeasuredValue_ImageProcess_FreeRunning.RearviewMirrorStatu_0xb032.Reserved "" VALUE 0x31001d __UBYTE_S 0 NO_COMPU_METHOD 0 255 ECU_ADDRESS_EXTENSION 0x80 /end CHARACTERISTIC
/begin CHARACTERISTIC CtApImageProcess_FreeRunning.PpDiagImageProcess_FreeRunningWrite.DeMeasuredValue_ImageProcess_FreeRunning.RearviewMirrorStatu_0xb032.Right_rearview_mirror_is_not_folding "" VALUE 0x31001e __UBYTE_S 0 NO_COMPU_METHOD 0 255 ECU_ADDRESS_EXTENSION 0x80 /end CHARACTERISTIC
/begin CHARACTERISTIC CtApImageProcess_FreeRunning.PpDiagImageProcess_FreeRunningWrite.DeMeasuredValue_ImageProcess_FreeRunning.FrontCamFailsafe_0xb033.Low_Illumination_Scene "" VALUE 0x310020 __UBYTE_S 0 NO_COMPU_METHOD 0 255 ECU_ADDRESS_EXTENSION 0x80 /end CHARACTERISTIC
/begin CHARACTERISTIC CtApImageProcess_FreeRunning.PpDiagImageProcess_FreeRunningWrite.DeMeasuredValue_ImageProcess_FreeRunning.FrontCamFailsafe_0xb033.Reserved "" VALUE 0x310021 __UBYTE_S 0 NO_COMPU_METHOD 0 255 ECU_ADDRESS_EXTENSION 0x80 /end CHARACTERISTIC
/begin CHARACTERISTIC CtApImageProcess_FreeRunning.PpDiagImageProcess_FreeRunningWrite.DeMeasuredValue_ImageProcess_FreeRunning.FrontCamFailsafe_0xb033.CAM_LOW_FPS "" VALUE 0x310022 __UBYTE_S 0 NO_COMPU_METHOD 0 255 ECU_ADDRESS_EXTENSION 0x80 /end CHARACTERISTIC
/begin CHARACTERISTIC CtApImageProcess_FreeRunning.PpDiagImageProcess_FreeRunningWrite.DeMeasuredValue_ImageProcess_FreeRunning.FrontCamFailsafe_0xb033.Image_freeze "" VALUE 0x310023 __UBYTE_S 0 NO_COMPU_METHOD 0 255 ECU_ADDRESS_EXTENSION 0x80 /end CHARACTERISTIC
/begin CHARACTERISTIC CtApImageProcess_FreeRunning.PpDiagImageProcess_FreeRunningWrite.DeMeasuredValue_ImageProcess_FreeRunning.FrontCamFailsafe_0xb033.WET_CAMLENS "" VALUE 0x310024 __UBYTE_S 0 NO_COMPU_METHOD 0 255 ECU_ADDRESS_EXTENSION 0x80 /end CHARACTERISTIC
/begin CHARACTERISTIC CtApImageProcess_FreeRunning.PpDiagImageProcess_FreeRunningWrite.DeMeasuredValue_ImageProcess_FreeRunning.FrontCamFailsafe_0xb033.ABCOLOR_CAM "" VALUE 0x310025 __UBYTE_S 0 NO_COMPU_METHOD 0 255 ECU_ADDRESS_EXTENSION 0x80 /end CHARACTERISTIC
/begin CHARACTERISTIC CtApImageProcess_FreeRunning.PpDiagImageProcess_FreeRunningWrite.DeMeasuredValue_ImageProcess_FreeRunning.FrontCamFailsafe_0xb033.CAM_BLOCKED "" VALUE 0x310026 __UBYTE_S 0 NO_COMPU_METHOD 0 255 ECU_ADDRESS_EXTENSION 0x80 /end CHARACTERISTIC
/begin CHARACTERISTIC CtApImageProcess_FreeRunning.PpDiagImageProcess_FreeRunningWrite.DeMeasuredValue_ImageProcess_FreeRunning.FrontCamFailsafe_0xb033.DIRTY_CAMLENS "" VALUE 0x310027 __UBYTE_S 0 NO_COMPU_METHOD 0 255 ECU_ADDRESS_EXTENSION 0x80 /end CHARACTERISTIC
/begin CHARACTERISTIC CtApImageProcess_FreeRunning.PpDiagImageProcess_FreeRunningWrite.DeMeasuredValue_ImageProcess_FreeRunning.FrontCamFailsafe_0xb033.Direct_sunlight "" VALUE 0x310028 __UBYTE_S 0 NO_COMPU_METHOD 0 255 ECU_ADDRESS_EXTENSION 0x80 /end CHARACTERISTIC
/begin CHARACTERISTIC CtApImageProcess_FreeRunning.PpDiagImageProcess_FreeRunningWrite.DeMeasuredValue_ImageProcess_FreeRunning.FrontCamFailsafe_0xb033.BLUR_IMG "" VALUE 0x310029 __UBYTE_S 0 NO_COMPU_METHOD 0 255 ECU_ADDRESS_EXTENSION 0x80 /end CHARACTERISTIC
/begin CHARACTERISTIC CtApImageProcess_FreeRunning.PpDiagImageProcess_FreeRunningWrite.DeMeasuredValue_ImageProcess_FreeRunning.FrontCamFailsafe_0xb033.GROUND_REFLECT "" VALUE 0x31002a __UBYTE_S 0 NO_COMPU_METHOD 0 255 ECU_ADDRESS_EXTENSION 0x80 /end CHARACTERISTIC
/begin CHARACTERISTIC CtApImageProcess_FreeRunning.PpDiagImageProcess_FreeRunningWrite.DeMeasuredValue_ImageProcess_FreeRunning.LeftCamFailsafe_0xb034.Low_Illumination_Scene "" VALUE 0x31002c __UBYTE_S 0 NO_COMPU_METHOD 0 255 ECU_ADDRESS_EXTENSION 0x80 /end CHARACTERISTIC
/begin CHARACTERISTIC CtApImageProcess_FreeRunning.PpDiagImageProcess_FreeRunningWrite.DeMeasuredValue_ImageProcess_FreeRunning.LeftCamFailsafe_0xb034.Reserved "" VALUE 0x31002d __UBYTE_S 0 NO_COMPU_METHOD 0 255 ECU_ADDRESS_EXTENSION 0x80 /end CHARACTERISTIC
/begin CHARACTERISTIC CtApImageProcess_FreeRunning.PpDiagImageProcess_FreeRunningWrite.DeMeasuredValue_ImageProcess_FreeRunning.LeftCamFailsafe_0xb034.CAM_LOW_FPS "" VALUE 0x31002e __UBYTE_S 0 NO_COMPU_METHOD 0 255 ECU_ADDRESS_EXTENSION 0x80 /end CHARACTERISTIC
/begin CHARACTERISTIC CtApImageProcess_FreeRunning.PpDiagImageProcess_FreeRunningWrite.DeMeasuredValue_ImageProcess_FreeRunning.LeftCamFailsafe_0xb034.Image_freeze "" VALUE 0x31002f __UBYTE_S 0 NO_COMPU_METHOD 0 255 ECU_ADDRESS_EXTENSION 0x80 /end CHARACTERISTIC
/begin CHARACTERISTIC CtApImageProcess_FreeRunning.PpDiagImageProcess_FreeRunningWrite.DeMeasuredValue_ImageProcess_FreeRunning.LeftCamFailsafe_0xb034.WET_CAMLENS "" VALUE 0x310030 __UBYTE_S 0 NO_COMPU_METHOD 0 255 ECU_ADDRESS_EXTENSION 0x80 /end CHARACTERISTIC
/begin CHARACTERISTIC CtApImageProcess_FreeRunning.PpDiagImageProcess_FreeRunningWrite.DeMeasuredValue_ImageProcess_FreeRunning.LeftCamFailsafe_0xb034.ABCOLOR_CAM "" VALUE 0x310031 __UBYTE_S 0 NO_COMPU_METHOD 0 255 ECU_ADDRESS_EXTENSION 0x80 /end CHARACTERISTIC
/begin CHARACTERISTIC CtApImageProcess_FreeRunning.PpDiagImageProcess_FreeRunningWrite.DeMeasuredValue_ImageProcess_FreeRunning.LeftCamFailsafe_0xb034.CAM_BLOCKED "" VALUE 0x310032 __UBYTE_S 0 NO_COMPU_METHOD 0 255 ECU_ADDRESS_EXTENSION 0x80 /end CHARACTERISTIC
/begin CHARACTERISTIC CtApImageProcess_FreeRunning.PpDiagImageProcess_FreeRunningWrite.DeMeasuredValue_ImageProcess_FreeRunning.LeftCamFailsafe_0xb034.DIRTY_CAMLENS "" VALUE 0x310033 __UBYTE_S 0 NO_COMPU_METHOD 0 255 ECU_ADDRESS_EXTENSION 0x80 /end CHARACTERISTIC
/begin CHARACTERISTIC CtApImageProcess_FreeRunning.PpDiagImageProcess_FreeRunningWrite.DeMeasuredValue_ImageProcess_FreeRunning.LeftCamFailsafe_0xb034.Direct_sunlight "" VALUE 0x310034 __UBYTE_S 0 NO_COMPU_METHOD 0 255 ECU_ADDRESS_EXTENSION 0x80 /end CHARACTERISTIC
/begin CHARACTERISTIC CtApImageProcess_FreeRunning.PpDiagImageProcess_FreeRunningWrite.DeMeasuredValue_ImageProcess_FreeRunning.LeftCamFailsafe_0xb034.BLUR_IMG "" VALUE 0x310035 __UBYTE_S 0 NO_COMPU_METHOD 0 255 ECU_ADDRESS_EXTENSION 0x80 /end CHARACTERISTIC
/begin CHARACTERISTIC CtApImageProcess_FreeRunning.PpDiagImageProcess_FreeRunningWrite.DeMeasuredValue_ImageProcess_FreeRunning.LeftCamFailsafe_0xb034.GROUND_REFLECT "" VALUE 0x310036 __UBYTE_S 0 NO_COMPU_METHOD 0 255 ECU_ADDRESS_EXTENSION 0x80 /end CHARACTERISTIC
/begin CHARACTERISTIC CtApImageProcess_FreeRunning.PpDiagImageProcess_FreeRunningWrite.DeMeasuredValue_ImageProcess_FreeRunning.RightCamFailsafe_0xb035.Low_Illumination_Scene "" VALUE 0x310038 __UBYTE_S 0 NO_COMPU_METHOD 0 255 ECU_ADDRESS_EXTENSION 0x80 /end CHARACTERISTIC
/begin CHARACTERISTIC CtApImageProcess_FreeRunning.PpDiagImageProcess_FreeRunningWrite.DeMeasuredValue_ImageProcess_FreeRunning.RightCamFailsafe_0xb035.Reserved "" VALUE 0x310039 __UBYTE_S 0 NO_COMPU_METHOD 0 255 ECU_ADDRESS_EXTENSION 0x80 /end CHARACTERISTIC
/begin CHARACTERISTIC CtApImageProcess_FreeRunning.PpDiagImageProcess_FreeRunningWrite.DeMeasuredValue_ImageProcess_FreeRunning.RightCamFailsafe_0xb035.CAM_LOW_FPS "" VALUE 0x31003a __UBYTE_S 0 NO_COMPU_METHOD 0 255 ECU_ADDRESS_EXTENSION 0x80 /end CHARACTERISTIC
/begin CHARACTERISTIC CtApImageProcess_FreeRunning.PpDiagImageProcess_FreeRunningWrite.DeMeasuredValue_ImageProcess_FreeRunning.RightCamFailsafe_0xb035.Image_freeze "" VALUE 0x31003b __UBYTE_S 0 NO_COMPU_METHOD 0 255 ECU_ADDRESS_EXTENSION 0x80 /end CHARACTERISTIC
/begin CHARACTERISTIC CtApImageProcess_FreeRunning.PpDiagImageProcess_FreeRunningWrite.DeMeasuredValue_ImageProcess_FreeRunning.RightCamFailsafe_0xb035.WET_CAMLENS "" VALUE 0x31003c __UBYTE_S 0 NO_COMPU_METHOD 0 255 ECU_ADDRESS_EXTENSION 0x80 /end CHARACTERISTIC
/begin CHARACTERISTIC CtApImageProcess_FreeRunning.PpDiagImageProcess_FreeRunningWrite.DeMeasuredValue_ImageProcess_FreeRunning.RightCamFailsafe_0xb035.ABCOLOR_CAM "" VALUE 0x31003d __UBYTE_S 0 NO_COMPU_METHOD 0 255 ECU_ADDRESS_EXTENSION 0x80 /end CHARACTERISTIC
/begin CHARACTERISTIC CtApImageProcess_FreeRunning.PpDiagImageProcess_FreeRunningWrite.DeMeasuredValue_ImageProcess_FreeRunning.RightCamFailsafe_0xb035.CAM_BLOCKED "" VALUE 0x31003e __UBYTE_S 0 NO_COMPU_METHOD 0 255 ECU_ADDRESS_EXTENSION 0x80 /end CHARACTERISTIC
/begin CHARACTERISTIC CtApImageProcess_FreeRunning.PpDiagImageProcess_FreeRunningWrite.DeMeasuredValue_ImageProcess_FreeRunning.RightCamFailsafe_0xb035.DIRTY_CAMLENS "" VALUE 0x31003f __UBYTE_S 0 NO_COMPU_METHOD 0 255 ECU_ADDRESS_EXTENSION 0x80 /end CHARACTERISTIC
/begin CHARACTERISTIC CtApImageProcess_FreeRunning.PpDiagImageProcess_FreeRunningWrite.DeMeasuredValue_ImageProcess_FreeRunning.RightCamFailsafe_0xb035.Direct_sunlight "" VALUE 0x310040 __UBYTE_S 0 NO_COMPU_METHOD 0 255 ECU_ADDRESS_EXTENSION 0x80 /end CHARACTERISTIC
/begin CHARACTERISTIC CtApImageProcess_FreeRunning.PpDiagImageProcess_FreeRunningWrite.DeMeasuredValue_ImageProcess_FreeRunning.RightCamFailsafe_0xb035.BLUR_IMG "" VALUE 0x310041 __UBYTE_S 0 NO_COMPU_METHOD 0 255 ECU_ADDRESS_EXTENSION 0x80 /end CHARACTERISTIC
/begin CHARACTERISTIC CtApImageProcess_FreeRunning.PpDiagImageProcess_FreeRunningWrite.DeMeasuredValue_ImageProcess_FreeRunning.RightCamFailsafe_0xb035.GROUND_REFLECT "" VALUE 0x310042 __UBYTE_S 0 NO_COMPU_METHOD 0 255 ECU_ADDRESS_EXTENSION 0x80 /end CHARACTERISTIC
/begin CHARACTERISTIC CtApImageProcess_FreeRunning.PpDiagImageProcess_FreeRunningWrite.DeMeasuredValue_ImageProcess_FreeRunning.RearCamFailsafe_0xb0cf.Low_Illumination_Scene "" VALUE 0x310044 __UBYTE_S 0 NO_COMPU_METHOD 0 255 ECU_ADDRESS_EXTENSION 0x80 /end CHARACTERISTIC
/begin CHARACTERISTIC CtApImageProcess_FreeRunning.PpDiagImageProcess_FreeRunningWrite.DeMeasuredValue_ImageProcess_FreeRunning.RearCamFailsafe_0xb0cf.Reserved "" VALUE 0x310045 __UBYTE_S 0 NO_COMPU_METHOD 0 255 ECU_ADDRESS_EXTENSION 0x80 /end CHARACTERISTIC
/begin CHARACTERISTIC CtApImageProcess_FreeRunning.PpDiagImageProcess_FreeRunningWrite.DeMeasuredValue_ImageProcess_FreeRunning.RearCamFailsafe_0xb0cf.CAM_LOW_FPS "" VALUE 0x310046 __UBYTE_S 0 NO_COMPU_METHOD 0 255 ECU_ADDRESS_EXTENSION 0x80 /end CHARACTERISTIC
/begin CHARACTERISTIC CtApImageProcess_FreeRunning.PpDiagImageProcess_FreeRunningWrite.DeMeasuredValue_ImageProcess_FreeRunning.RearCamFailsafe_0xb0cf.Image_freeze "" VALUE 0x310047 __UBYTE_S 0 NO_COMPU_METHOD 0 255 ECU_ADDRESS_EXTENSION 0x80 /end CHARACTERISTIC
/begin CHARACTERISTIC CtApImageProcess_FreeRunning.PpDiagImageProcess_FreeRunningWrite.DeMeasuredValue_ImageProcess_FreeRunning.RearCamFailsafe_0xb0cf.WET_CAMLENS "" VALUE 0x310048 __UBYTE_S 0 NO_COMPU_METHOD 0 255 ECU_ADDRESS_EXTENSION 0x80 /end CHARACTERISTIC
/begin CHARACTERISTIC CtApImageProcess_FreeRunning.PpDiagImageProcess_FreeRunningWrite.DeMeasuredValue_ImageProcess_FreeRunning.RearCamFailsafe_0xb0cf.ABCOLOR_CAM "" VALUE 0x310049 __UBYTE_S 0 NO_COMPU_METHOD 0 255 ECU_ADDRESS_EXTENSION 0x80 /end CHARACTERISTIC
/begin CHARACTERISTIC CtApImageProcess_FreeRunning.PpDiagImageProcess_FreeRunningWrite.DeMeasuredValue_ImageProcess_FreeRunning.RearCamFailsafe_0xb0cf.CAM_BLOCKED "" VALUE 0x31004a __UBYTE_S 0 NO_COMPU_METHOD 0 255 ECU_ADDRESS_EXTENSION 0x80 /end CHARACTERISTIC
/begin CHARACTERISTIC CtApImageProcess_FreeRunning.PpDiagImageProcess_FreeRunningWrite.DeMeasuredValue_ImageProcess_FreeRunning.RearCamFailsafe_0xb0cf.DIRTY_CAMLENS "" VALUE 0x31004b __UBYTE_S 0 NO_COMPU_METHOD 0 255 ECU_ADDRESS_EXTENSION 0x80 /end CHARACTERISTIC
/begin CHARACTERISTIC CtApImageProcess_FreeRunning.PpDiagImageProcess_FreeRunningWrite.DeMeasuredValue_ImageProcess_FreeRunning.RearCamFailsafe_0xb0cf.Direct_sunlight "" VALUE 0x31004c __UBYTE_S 0 NO_COMPU_METHOD 0 255 ECU_ADDRESS_EXTENSION 0x80 /end CHARACTERISTIC
/begin CHARACTERISTIC CtApImageProcess_FreeRunning.PpDiagImageProcess_FreeRunningWrite.DeMeasuredValue_ImageProcess_FreeRunning.RearCamFailsafe_0xb0cf.BLUR_IMG "" VALUE 0x31004d __UBYTE_S 0 NO_COMPU_METHOD 0 255 ECU_ADDRESS_EXTENSION 0x80 /end CHARACTERISTIC
/begin CHARACTERISTIC CtApImageProcess_FreeRunning.PpDiagImageProcess_FreeRunningWrite.DeMeasuredValue_ImageProcess_FreeRunning.RearCamFailsafe_0xb0cf.GROUND_REFLECT "" VALUE 0x31004e __UBYTE_S 0 NO_COMPU_METHOD 0 255 ECU_ADDRESS_EXTENSION 0x80 /end CHARACTERISTIC
/begin CHARACTERISTIC CtApImageProcess_FreeRunning.PpDiagImageProcess_FreeRunningWrite.DeMeasuredValue_ImageProcess_FreeRunning.InputRteMsgErr_0xb0d0.CH_CAN_Speed_ERR "" VALUE 0x310050 __UBYTE_S 0 NO_COMPU_METHOD 0 255 ECU_ADDRESS_EXTENSION 0x80 /end CHARACTERISTIC
/begin CHARACTERISTIC CtApImageProcess_FreeRunning.PpDiagImageProcess_FreeRunningWrite.DeMeasuredValue_ImageProcess_FreeRunning.InputRteMsgErr_0xb0d0.Reserved "" VALUE 0x310051 __UBYTE_S 0 NO_COMPU_METHOD 0 255 ECU_ADDRESS_EXTENSION 0x80 /end CHARACTERISTIC
/begin CHARACTERISTIC CtApImageProcess_FreeRunning.PpDiagImageProcess_FreeRunningWrite.DeMeasuredValue_ImageProcess_FreeRunning.InputRteMsgErr_0xb0d0.CH_CAN_Yawrate_ERR "" VALUE 0x310052 __UBYTE_S 0 NO_COMPU_METHOD 0 255 ECU_ADDRESS_EXTENSION 0x80 /end CHARACTERISTIC
/begin CHARACTERISTIC CtApImageProcess_FreeRunning.PpDiagImageProcess_FreeRunningWrite.DeMeasuredValue_ImageProcess_FreeRunning.FunctionERR_0xb0d1.Freespace_fusion_error "" VALUE 0x310054 __UBYTE_S 0 NO_COMPU_METHOD 0 255 ECU_ADDRESS_EXTENSION 0x80 /end CHARACTERISTIC
/begin CHARACTERISTIC CtApImageProcess_FreeRunning.PpDiagImageProcess_FreeRunningWrite.DeMeasuredValue_ImageProcess_FreeRunning.FunctionERR_0xb0d1.Freespace_other_error "" VALUE 0x310055 __UBYTE_S 0 NO_COMPU_METHOD 0 255 ECU_ADDRESS_EXTENSION 0x80 /end CHARACTERISTIC
/begin CHARACTERISTIC CtApImageProcess_FreeRunning.PpDiagImageProcess_FreeRunningWrite.DeMeasuredValue_ImageProcess_FreeRunning.FunctionERR_0xb0d1.PLD_detection_error "" VALUE 0x310056 __UBYTE_S 0 NO_COMPU_METHOD 0 255 ECU_ADDRESS_EXTENSION 0x80 /end CHARACTERISTIC
/begin CHARACTERISTIC CtApImageProcess_FreeRunning.PpDiagImageProcess_FreeRunningWrite.DeMeasuredValue_ImageProcess_FreeRunning.FunctionERR_0xb0d1.AVM_fusion_error "" VALUE 0x310057 __UBYTE_S 0 NO_COMPU_METHOD 0 255 ECU_ADDRESS_EXTENSION 0x80 /end CHARACTERISTIC
/begin CHARACTERISTIC CtApImageProcess_FreeRunning.PpDiagImageProcess_FreeRunningWrite.DeMeasuredValue_ImageProcess_FreeRunning.FunctionERR_0xb0d1.AVM_other_error "" VALUE 0x310058 __UBYTE_S 0 NO_COMPU_METHOD 0 255 ECU_ADDRESS_EXTENSION 0x80 /end CHARACTERISTIC
/begin CHARACTERISTIC CtApImageProcess_FreeRunning.PpDiagImageProcess_FreeRunningWrite.DeMeasuredValue_ImageProcess_FreeRunning.FunctionERR_0xb0d1.Freespace_detection_error "" VALUE 0x310059 __UBYTE_S 0 NO_COMPU_METHOD 0 255 ECU_ADDRESS_EXTENSION 0x80 /end CHARACTERISTIC
/begin CHARACTERISTIC CtApImageProcess_FreeRunning.PpDiagImageProcess_FreeRunningWrite.DeMeasuredValue_ImageProcess_FreeRunning.FunctionERR_0xb0d1.AVM_model_run_error "" VALUE 0x31005a __UBYTE_S 0 NO_COMPU_METHOD 0 255 ECU_ADDRESS_EXTENSION 0x80 /end CHARACTERISTIC
/begin CHARACTERISTIC CtApImageProcess_FreeRunning.PpDiagImageProcess_FreeRunningWrite.DeMeasuredValue_ImageProcess_FreeRunning.FunctionERR_0xb0d1.PLD_fusion_error "" VALUE 0x31005b __UBYTE_S 0 NO_COMPU_METHOD 0 255 ECU_ADDRESS_EXTENSION 0x80 /end CHARACTERISTIC
/begin CHARACTERISTIC CtApImageProcess_FreeRunning.PpDiagImageProcess_FreeRunningWrite.DeMeasuredValue_ImageProcess_FreeRunning.FunctionERR_0xb0d1.PLD_stitching_error "" VALUE 0x31005c __UBYTE_S 0 NO_COMPU_METHOD 0 255 ECU_ADDRESS_EXTENSION 0x80 /end CHARACTERISTIC
/begin CHARACTERISTIC CtApImageProcess_FreeRunning.PpDiagImageProcess_FreeRunningWrite.DeMeasuredValue_ImageProcess_FreeRunning.FunctionERR_0xb0d1.AVM_calibration_file_error "" VALUE 0x31005d __UBYTE_S 0 NO_COMPU_METHOD 0 255 ECU_ADDRESS_EXTENSION 0x80 /end CHARACTERISTIC
/begin CHARACTERISTIC CtApImageProcess_FreeRunning.PpDiagImageProcess_FreeRunningWrite.DeMeasuredValue_ImageProcess_FreeRunning.FunctionERR_0xb0d1.Freespace_model_run_error "" VALUE 0x31005e __UBYTE_S 0 NO_COMPU_METHOD 0 255 ECU_ADDRESS_EXTENSION 0x80 /end CHARACTERISTIC
/begin CHARACTERISTIC CtApImageProcess_FreeRunning.PpDiagImageProcess_FreeRunningWrite.DeMeasuredValue_ImageProcess_FreeRunning.FunctionERR_0xb0d1.Freespace_stitching_error "" VALUE 0x31005f __UBYTE_S 0 NO_COMPU_METHOD 0 255 ECU_ADDRESS_EXTENSION 0x80 /end CHARACTERISTIC
/begin CHARACTERISTIC CtApImageProcess_FreeRunning.PpDiagImageProcess_FreeRunningWrite.DeMeasuredValue_ImageProcess_FreeRunning.FunctionERR_0xb0d1.AVM_car_color_profile_error "" VALUE 0x310060 __UBYTE_S 0 NO_COMPU_METHOD 0 255 ECU_ADDRESS_EXTENSION 0x80 /end CHARACTERISTIC
/begin CHARACTERISTIC CtApImageProcess_FreeRunning.PpDiagImageProcess_FreeRunningWrite.DeMeasuredValue_ImageProcess_FreeRunning.FunctionERR_0xb0d1.OD_fusion_error "" VALUE 0x310061 __UBYTE_S 0 NO_COMPU_METHOD 0 255 ECU_ADDRESS_EXTENSION 0x80 /end CHARACTERISTIC
/begin CHARACTERISTIC CtApImageProcess_FreeRunning.PpDiagImageProcess_FreeRunningWrite.DeMeasuredValue_ImageProcess_FreeRunning.FunctionERR_0xb0d1.AVM_car_model_error "" VALUE 0x310062 __UBYTE_S 0 NO_COMPU_METHOD 0 255 ECU_ADDRESS_EXTENSION 0x80 /end CHARACTERISTIC
/begin CHARACTERISTIC CtApImageProcess_FreeRunning.PpDiagImageProcess_FreeRunningWrite.DeMeasuredValue_ImageProcess_FreeRunning.FunctionERR_0xb0d1.AVM_stitching_error "" VALUE 0x310063 __UBYTE_S 0 NO_COMPU_METHOD 0 255 ECU_ADDRESS_EXTENSION 0x80 /end CHARACTERISTIC
/begin CHARACTERISTIC CtApImageProcess_FreeRunning.PpDiagImageProcess_FreeRunningWrite.DeMeasuredValue_ImageProcess_FreeRunning.FunctionERR_0xb0d1.Reserved "" VALUE 0x310064 __UBYTE_S 0 NO_COMPU_METHOD 0 255 ECU_ADDRESS_EXTENSION 0x80 /end CHARACTERISTIC
/begin CHARACTERISTIC CtApImageProcess_FreeRunning.PpDiagImageProcess_FreeRunningWrite.DeMeasuredValue_ImageProcess_FreeRunning.FunctionERR_0xb0d1.OD_other_error "" VALUE 0x310065 __UBYTE_S 0 NO_COMPU_METHOD 0 255 ECU_ADDRESS_EXTENSION 0x80 /end CHARACTERISTIC
/begin CHARACTERISTIC CtApImageProcess_FreeRunning.PpDiagImageProcess_FreeRunningWrite.DeMeasuredValue_ImageProcess_FreeRunning.FunctionERR_0xb0d1.OD_detection_error "" VALUE 0x310066 __UBYTE_S 0 NO_COMPU_METHOD 0 255 ECU_ADDRESS_EXTENSION 0x80 /end CHARACTERISTIC
/begin CHARACTERISTIC CtApImageProcess_FreeRunning.PpDiagImageProcess_FreeRunningWrite.DeMeasuredValue_ImageProcess_FreeRunning.FunctionERR_0xb0d1.AVM_bowl_model_error "" VALUE 0x310067 __UBYTE_S 0 NO_COMPU_METHOD 0 255 ECU_ADDRESS_EXTENSION 0x80 /end CHARACTERISTIC
/begin CHARACTERISTIC CtApImageProcess_FreeRunning.PpDiagImageProcess_FreeRunningWrite.DeMeasuredValue_ImageProcess_FreeRunning.FunctionERR_0xb0d1.PLD_model_run_error "" VALUE 0x310068 __UBYTE_S 0 NO_COMPU_METHOD 0 255 ECU_ADDRESS_EXTENSION 0x80 /end CHARACTERISTIC
/begin CHARACTERISTIC CtApImageProcess_FreeRunning.PpDiagImageProcess_FreeRunningWrite.DeMeasuredValue_ImageProcess_FreeRunning.FunctionERR_0xb0d1.AVM_mapping_file_error "" VALUE 0x310069 __UBYTE_S 0 NO_COMPU_METHOD 0 255 ECU_ADDRESS_EXTENSION 0x80 /end CHARACTERISTIC
/begin CHARACTERISTIC CtApImageProcess_FreeRunning.PpDiagImageProcess_FreeRunningWrite.DeMeasuredValue_ImageProcess_FreeRunning.FunctionERR_0xb0d1.OD_model_run_error "" VALUE 0x31006a __UBYTE_S 0 NO_COMPU_METHOD 0 255 ECU_ADDRESS_EXTENSION 0x80 /end CHARACTERISTIC
/begin CHARACTERISTIC CtApImageProcess_FreeRunning.PpDiagImageProcess_FreeRunningWrite.DeMeasuredValue_ImageProcess_FreeRunning.FunctionERR_0xb0d1.AVM_perspective_file_error "" VALUE 0x31006b __UBYTE_S 0 NO_COMPU_METHOD 0 255 ECU_ADDRESS_EXTENSION 0x80 /end CHARACTERISTIC
/begin CHARACTERISTIC CtApImageProcess_FreeRunning.PpDiagImageProcess_FreeRunningWrite.DeMeasuredValue_ImageProcess_FreeRunning.FunctionERR_0xb0d1.OD_stitching_error "" VALUE 0x31006c __UBYTE_S 0 NO_COMPU_METHOD 0 255 ECU_ADDRESS_EXTENSION 0x80 /end CHARACTERISTIC
/begin CHARACTERISTIC CtApImageProcess_FreeRunning.PpDiagImageProcess_FreeRunningWrite.DeMeasuredValue_ImageProcess_FreeRunning.FunctionERR_0xb0d1.PLD_other_error "" VALUE 0x31006d __UBYTE_S 0 NO_COMPU_METHOD 0 255 ECU_ADDRESS_EXTENSION 0x80 /end CHARACTERISTIC
/begin CHARACTERISTIC CtApImageProcess_FreeRunning.PpDiagImageProcess_FreeRunningWrite.DeMeasuredValue_ImageProcess_FreeRunning.SurroundView_System_ERR_0xb0d2.AVM_memory_leak "" VALUE 0x310070 __UBYTE_S 0 NO_COMPU_METHOD 0 255 ECU_ADDRESS_EXTENSION 0x80 /end CHARACTERISTIC
/begin CHARACTERISTIC CtApImageProcess_FreeRunning.PpDiagImageProcess_FreeRunningWrite.DeMeasuredValue_ImageProcess_FreeRunning.SurroundView_System_ERR_0xb0d2.AVM_process_error "" VALUE 0x310071 __UBYTE_S 0 NO_COMPU_METHOD 0 255 ECU_ADDRESS_EXTENSION 0x80 /end CHARACTERISTIC
/begin CHARACTERISTIC CtApImageProcess_FreeRunning.PpDiagImageProcess_FreeRunningWrite.DeMeasuredValue_ImageProcess_FreeRunning.SurroundView_System_ERR_0xb0d2.AVM_visit_uncreated_data "" VALUE 0x310072 __UBYTE_S 0 NO_COMPU_METHOD 0 255 ECU_ADDRESS_EXTENSION 0x80 /end CHARACTERISTIC
/begin CHARACTERISTIC CtApImageProcess_FreeRunning.PpDiagImageProcess_FreeRunningWrite.DeMeasuredValue_ImageProcess_FreeRunning.SurroundView_System_ERR_0xb0d2.OD_dispatch_monitor_faild "" VALUE 0x310073 __UBYTE_S 0 NO_COMPU_METHOD 0 255 ECU_ADDRESS_EXTENSION 0x80 /end CHARACTERISTIC
/begin CHARACTERISTIC CtApImageProcess_FreeRunning.PpDiagImageProcess_FreeRunningWrite.DeMeasuredValue_ImageProcess_FreeRunning.SurroundView_System_ERR_0xb0d2.AVM_heartbeat_monitor_faild "" VALUE 0x310074 __UBYTE_S 0 NO_COMPU_METHOD 0 255 ECU_ADDRESS_EXTENSION 0x80 /end CHARACTERISTIC
/begin CHARACTERISTIC CtApImageProcess_FreeRunning.PpDiagImageProcess_FreeRunningWrite.DeMeasuredValue_ImageProcess_FreeRunning.SurroundView_System_ERR_0xb0d2.camera_service_visit_uncreated_data "" VALUE 0x310075 __UBYTE_S 0 NO_COMPU_METHOD 0 255 ECU_ADDRESS_EXTENSION 0x80 /end CHARACTERISTIC
/begin CHARACTERISTIC CtApImageProcess_FreeRunning.PpDiagImageProcess_FreeRunningWrite.DeMeasuredValue_ImageProcess_FreeRunning.SurroundView_System_ERR_0xb0d2.AVM_visit_released_data "" VALUE 0x310076 __UBYTE_S 0 NO_COMPU_METHOD 0 255 ECU_ADDRESS_EXTENSION 0x80 /end CHARACTERISTIC
/begin CHARACTERISTIC CtApImageProcess_FreeRunning.PpDiagImageProcess_FreeRunningWrite.DeMeasuredValue_ImageProcess_FreeRunning.SurroundView_System_ERR_0xb0d2.Freeapce_process_error "" VALUE 0x310077 __UBYTE_S 0 NO_COMPU_METHOD 0 255 ECU_ADDRESS_EXTENSION 0x80 /end CHARACTERISTIC
/begin CHARACTERISTIC CtApImageProcess_FreeRunning.PpDiagImageProcess_FreeRunningWrite.DeMeasuredValue_ImageProcess_FreeRunning.SurroundView_System_ERR_0xb0d2.PLD_memory_leak "" VALUE 0x310078 __UBYTE_S 0 NO_COMPU_METHOD 0 255 ECU_ADDRESS_EXTENSION 0x80 /end CHARACTERISTIC
/begin CHARACTERISTIC CtApImageProcess_FreeRunning.PpDiagImageProcess_FreeRunningWrite.DeMeasuredValue_ImageProcess_FreeRunning.SurroundView_System_ERR_0xb0d2.OD_memory_leak "" VALUE 0x310079 __UBYTE_S 0 NO_COMPU_METHOD 0 255 ECU_ADDRESS_EXTENSION 0x80 /end CHARACTERISTIC
/begin CHARACTERISTIC CtApImageProcess_FreeRunning.PpDiagImageProcess_FreeRunningWrite.DeMeasuredValue_ImageProcess_FreeRunning.SurroundView_System_ERR_0xb0d2.PLD_data_visit_timeout "" VALUE 0x31007a __UBYTE_S 0 NO_COMPU_METHOD 0 255 ECU_ADDRESS_EXTENSION 0x80 /end CHARACTERISTIC
/begin CHARACTERISTIC CtApImageProcess_FreeRunning.PpDiagImageProcess_FreeRunningWrite.DeMeasuredValue_ImageProcess_FreeRunning.SurroundView_System_ERR_0xb0d2.OD_abnormal_break "" VALUE 0x31007b __UBYTE_S 0 NO_COMPU_METHOD 0 255 ECU_ADDRESS_EXTENSION 0x80 /end CHARACTERISTIC
/begin CHARACTERISTIC CtApImageProcess_FreeRunning.PpDiagImageProcess_FreeRunningWrite.DeMeasuredValue_ImageProcess_FreeRunning.SurroundView_System_ERR_0xb0d2.Abnormal_recovery_faild "" VALUE 0x31007c __UBYTE_S 0 NO_COMPU_METHOD 0 255 ECU_ADDRESS_EXTENSION 0x80 /end CHARACTERISTIC
/begin CHARACTERISTIC CtApImageProcess_FreeRunning.PpDiagImageProcess_FreeRunningWrite.DeMeasuredValue_ImageProcess_FreeRunning.SurroundView_System_ERR_0xb0d2.Shared_data_read_and_write_monitor_wrong "" VALUE 0x31007d __UBYTE_S 0 NO_COMPU_METHOD 0 255 ECU_ADDRESS_EXTENSION 0x80 /end CHARACTERISTIC
/begin CHARACTERISTIC CtApImageProcess_FreeRunning.PpDiagImageProcess_FreeRunningWrite.DeMeasuredValue_ImageProcess_FreeRunning.SurroundView_System_ERR_0xb0d2.FS_data_read_write_conflict "" VALUE 0x31007e __UBYTE_S 0 NO_COMPU_METHOD 0 255 ECU_ADDRESS_EXTENSION 0x80 /end CHARACTERISTIC
/begin CHARACTERISTIC CtApImageProcess_FreeRunning.PpDiagImageProcess_FreeRunningWrite.DeMeasuredValue_ImageProcess_FreeRunning.SurroundView_System_ERR_0xb0d2.PLD_process_error "" VALUE 0x31007f __UBYTE_S 0 NO_COMPU_METHOD 0 255 ECU_ADDRESS_EXTENSION 0x80 /end CHARACTERISTIC
/begin CHARACTERISTIC CtApImageProcess_FreeRunning.PpDiagImageProcess_FreeRunningWrite.DeMeasuredValue_ImageProcess_FreeRunning.SurroundView_System_ERR_0xb0d2.FS_visit_released_data "" VALUE 0x310080 __UBYTE_S 0 NO_COMPU_METHOD 0 255 ECU_ADDRESS_EXTENSION 0x80 /end CHARACTERISTIC
/begin CHARACTERISTIC CtApImageProcess_FreeRunning.PpDiagImageProcess_FreeRunningWrite.DeMeasuredValue_ImageProcess_FreeRunning.SurroundView_System_ERR_0xb0d2.OD_data_read_write_conflict "" VALUE 0x310081 __UBYTE_S 0 NO_COMPU_METHOD 0 255 ECU_ADDRESS_EXTENSION 0x80 /end CHARACTERISTIC
/begin CHARACTERISTIC CtApImageProcess_FreeRunning.PpDiagImageProcess_FreeRunningWrite.DeMeasuredValue_ImageProcess_FreeRunning.SurroundView_System_ERR_0xb0d2.FS_data_write_fail "" VALUE 0x310082 __UBYTE_S 0 NO_COMPU_METHOD 0 255 ECU_ADDRESS_EXTENSION 0x80 /end CHARACTERISTIC
/begin CHARACTERISTIC CtApImageProcess_FreeRunning.PpDiagImageProcess_FreeRunningWrite.DeMeasuredValue_ImageProcess_FreeRunning.SurroundView_System_ERR_0xb0d2.camera_service_process_timeout "" VALUE 0x310083 __UBYTE_S 0 NO_COMPU_METHOD 0 255 ECU_ADDRESS_EXTENSION 0x80 /end CHARACTERISTIC
/begin CHARACTERISTIC CtApImageProcess_FreeRunning.PpDiagImageProcess_FreeRunningWrite.DeMeasuredValue_ImageProcess_FreeRunning.SurroundView_System_ERR_0xb0d2.OD_process_error "" VALUE 0x310084 __UBYTE_S 0 NO_COMPU_METHOD 0 255 ECU_ADDRESS_EXTENSION 0x80 /end CHARACTERISTIC
/begin CHARACTERISTIC CtApImageProcess_FreeRunning.PpDiagImageProcess_FreeRunningWrite.DeMeasuredValue_ImageProcess_FreeRunning.SurroundView_System_ERR_0xb0d2.FS_process_timeout "" VALUE 0x310085 __UBYTE_S 0 NO_COMPU_METHOD 0 255 ECU_ADDRESS_EXTENSION 0x80 /end CHARACTERISTIC
/begin CHARACTERISTIC CtApImageProcess_FreeRunning.PpDiagImageProcess_FreeRunningWrite.DeMeasuredValue_ImageProcess_FreeRunning.SurroundView_System_ERR_0xb0d2.OD_data_write_fail "" VALUE 0x310086 __UBYTE_S 0 NO_COMPU_METHOD 0 255 ECU_ADDRESS_EXTENSION 0x80 /end CHARACTERISTIC
/begin CHARACTERISTIC CtApImageProcess_FreeRunning.PpDiagImageProcess_FreeRunningWrite.DeMeasuredValue_ImageProcess_FreeRunning.SurroundView_System_ERR_0xb0d2.camera_service_data_visit_timeout "" VALUE 0x310087 __UBYTE_S 0 NO_COMPU_METHOD 0 255 ECU_ADDRESS_EXTENSION 0x80 /end CHARACTERISTIC
/begin CHARACTERISTIC CtApImageProcess_FreeRunning.PpDiagImageProcess_FreeRunningWrite.DeMeasuredValue_ImageProcess_FreeRunning.SurroundView_System_ERR_0xb0d2.OD_visit_released_data "" VALUE 0x310088 __UBYTE_S 0 NO_COMPU_METHOD 0 255 ECU_ADDRESS_EXTENSION 0x80 /end CHARACTERISTIC
/begin CHARACTERISTIC CtApImageProcess_FreeRunning.PpDiagImageProcess_FreeRunningWrite.DeMeasuredValue_ImageProcess_FreeRunning.SurroundView_System_ERR_0xb0d2.camera_service_data_read_fail "" VALUE 0x310089 __UBYTE_S 0 NO_COMPU_METHOD 0 255 ECU_ADDRESS_EXTENSION 0x80 /end CHARACTERISTIC
/begin CHARACTERISTIC CtApImageProcess_FreeRunning.PpDiagImageProcess_FreeRunningWrite.DeMeasuredValue_ImageProcess_FreeRunning.SurroundView_System_ERR_0xb0d2.CamSer_heartbeat_monitor_faild "" VALUE 0x31008a __UBYTE_S 0 NO_COMPU_METHOD 0 255 ECU_ADDRESS_EXTENSION 0x80 /end CHARACTERISTIC
/begin CHARACTERISTIC CtApImageProcess_FreeRunning.PpDiagImageProcess_FreeRunningWrite.DeMeasuredValue_ImageProcess_FreeRunning.SurroundView_System_ERR_0xb0d2.PLD_visit_uncreated_data "" VALUE 0x31008b __UBYTE_S 0 NO_COMPU_METHOD 0 255 ECU_ADDRESS_EXTENSION 0x80 /end CHARACTERISTIC
/begin CHARACTERISTIC CtApImageProcess_FreeRunning.PpDiagImageProcess_FreeRunningWrite.DeMeasuredValue_ImageProcess_FreeRunning.SurroundView_System_ERR_0xb0d2.AVM_memory_application_fail "" VALUE 0x31008c __UBYTE_S 0 NO_COMPU_METHOD 0 255 ECU_ADDRESS_EXTENSION 0x80 /end CHARACTERISTIC
/begin CHARACTERISTIC CtApImageProcess_FreeRunning.PpDiagImageProcess_FreeRunningWrite.DeMeasuredValue_ImageProcess_FreeRunning.SurroundView_System_ERR_0xb0d2.FS_abnormal_break "" VALUE 0x31008d __UBYTE_S 0 NO_COMPU_METHOD 0 255 ECU_ADDRESS_EXTENSION 0x80 /end CHARACTERISTIC
/begin CHARACTERISTIC CtApImageProcess_FreeRunning.PpDiagImageProcess_FreeRunningWrite.DeMeasuredValue_ImageProcess_FreeRunning.SurroundView_System_ERR_0xb0d2.AVM_process_timeout "" VALUE 0x31008e __UBYTE_S 0 NO_COMPU_METHOD 0 255 ECU_ADDRESS_EXTENSION 0x80 /end CHARACTERISTIC
/begin CHARACTERISTIC CtApImageProcess_FreeRunning.PpDiagImageProcess_FreeRunningWrite.DeMeasuredValue_ImageProcess_FreeRunning.SurroundView_System_ERR_0xb0d2.OD_data_visit_timeout "" VALUE 0x31008f __UBYTE_S 0 NO_COMPU_METHOD 0 255 ECU_ADDRESS_EXTENSION 0x80 /end CHARACTERISTIC
/begin CHARACTERISTIC CtApImageProcess_FreeRunning.PpDiagImageProcess_FreeRunningWrite.DeMeasuredValue_ImageProcess_FreeRunning.SurroundView_System_ERR_0xb0d2.Freespace_dispatch_monitor_faild "" VALUE 0x310090 __UBYTE_S 0 NO_COMPU_METHOD 0 255 ECU_ADDRESS_EXTENSION 0x80 /end CHARACTERISTIC
/begin CHARACTERISTIC CtApImageProcess_FreeRunning.PpDiagImageProcess_FreeRunningWrite.DeMeasuredValue_ImageProcess_FreeRunning.SurroundView_System_ERR_0xb0d2.PLD_data_write_fail "" VALUE 0x310091 __UBYTE_S 0 NO_COMPU_METHOD 0 255 ECU_ADDRESS_EXTENSION 0x80 /end CHARACTERISTIC
/begin CHARACTERISTIC CtApImageProcess_FreeRunning.PpDiagImageProcess_FreeRunningWrite.DeMeasuredValue_ImageProcess_FreeRunning.SurroundView_System_ERR_0xb0d2.AVM_abnormal_break "" VALUE 0x310092 __UBYTE_S 0 NO_COMPU_METHOD 0 255 ECU_ADDRESS_EXTENSION 0x80 /end CHARACTERISTIC
/begin CHARACTERISTIC CtApImageProcess_FreeRunning.PpDiagImageProcess_FreeRunningWrite.DeMeasuredValue_ImageProcess_FreeRunning.SurroundView_System_ERR_0xb0d2.OD_heartbeat_monitor_faild "" VALUE 0x310093 __UBYTE_S 0 NO_COMPU_METHOD 0 255 ECU_ADDRESS_EXTENSION 0x80 /end CHARACTERISTIC
/begin CHARACTERISTIC CtApImageProcess_FreeRunning.PpDiagImageProcess_FreeRunningWrite.DeMeasuredValue_ImageProcess_FreeRunning.SurroundView_System_ERR_0xb0d2.Shared_data_lifecycle_monitor_wrong "" VALUE 0x310094 __UBYTE_S 0 NO_COMPU_METHOD 0 255 ECU_ADDRESS_EXTENSION 0x80 /end CHARACTERISTIC
/begin CHARACTERISTIC CtApImageProcess_FreeRunning.PpDiagImageProcess_FreeRunningWrite.DeMeasuredValue_ImageProcess_FreeRunning.SurroundView_System_ERR_0xb0d2.FS_memory_leak "" VALUE 0x310095 __UBYTE_S 0 NO_COMPU_METHOD 0 255 ECU_ADDRESS_EXTENSION 0x80 /end CHARACTERISTIC
/begin CHARACTERISTIC CtApImageProcess_FreeRunning.PpDiagImageProcess_FreeRunningWrite.DeMeasuredValue_ImageProcess_FreeRunning.SurroundView_System_ERR_0xb0d2.AVM_data_read_write_conflict "" VALUE 0x310096 __UBYTE_S 0 NO_COMPU_METHOD 0 255 ECU_ADDRESS_EXTENSION 0x80 /end CHARACTERISTIC
/begin CHARACTERISTIC CtApImageProcess_FreeRunning.PpDiagImageProcess_FreeRunningWrite.DeMeasuredValue_ImageProcess_FreeRunning.SurroundView_System_ERR_0xb0d2.FS_data_read_fail "" VALUE 0x310097 __UBYTE_S 0 NO_COMPU_METHOD 0 255 ECU_ADDRESS_EXTENSION 0x80 /end CHARACTERISTIC
/begin CHARACTERISTIC CtApImageProcess_FreeRunning.PpDiagImageProcess_FreeRunningWrite.DeMeasuredValue_ImageProcess_FreeRunning.SurroundView_System_ERR_0xb0d2.CamSer_process_error "" VALUE 0x310098 __UBYTE_S 0 NO_COMPU_METHOD 0 255 ECU_ADDRESS_EXTENSION 0x80 /end CHARACTERISTIC
/begin CHARACTERISTIC CtApImageProcess_FreeRunning.PpDiagImageProcess_FreeRunningWrite.DeMeasuredValue_ImageProcess_FreeRunning.SurroundView_System_ERR_0xb0d2.Freespace_heartbeat_monitor_faild "" VALUE 0x310099 __UBYTE_S 0 NO_COMPU_METHOD 0 255 ECU_ADDRESS_EXTENSION 0x80 /end CHARACTERISTIC
/begin CHARACTERISTIC CtApImageProcess_FreeRunning.PpDiagImageProcess_FreeRunningWrite.DeMeasuredValue_ImageProcess_FreeRunning.SurroundView_System_ERR_0xb0d2.PLD_data_read_write_conflict "" VALUE 0x31009a __UBYTE_S 0 NO_COMPU_METHOD 0 255 ECU_ADDRESS_EXTENSION 0x80 /end CHARACTERISTIC
/begin CHARACTERISTIC CtApImageProcess_FreeRunning.PpDiagImageProcess_FreeRunningWrite.DeMeasuredValue_ImageProcess_FreeRunning.SurroundView_System_ERR_0xb0d2.OD_memory_application_fail "" VALUE 0x31009b __UBYTE_S 0 NO_COMPU_METHOD 0 255 ECU_ADDRESS_EXTENSION 0x80 /end CHARACTERISTIC
/begin CHARACTERISTIC CtApImageProcess_FreeRunning.PpDiagImageProcess_FreeRunningWrite.DeMeasuredValue_ImageProcess_FreeRunning.SurroundView_System_ERR_0xb0d2.AVM_dispatch_monitor_faild "" VALUE 0x31009c __UBYTE_S 0 NO_COMPU_METHOD 0 255 ECU_ADDRESS_EXTENSION 0x80 /end CHARACTERISTIC
/begin CHARACTERISTIC CtApImageProcess_FreeRunning.PpDiagImageProcess_FreeRunningWrite.DeMeasuredValue_ImageProcess_FreeRunning.SurroundView_System_ERR_0xb0d2.AVM_data_write_fail "" VALUE 0x31009d __UBYTE_S 0 NO_COMPU_METHOD 0 255 ECU_ADDRESS_EXTENSION 0x80 /end CHARACTERISTIC
/begin CHARACTERISTIC CtApImageProcess_FreeRunning.PpDiagImageProcess_FreeRunningWrite.DeMeasuredValue_ImageProcess_FreeRunning.SurroundView_System_ERR_0xb0d2.camera_service_visit_released_data "" VALUE 0x31009e __UBYTE_S 0 NO_COMPU_METHOD 0 255 ECU_ADDRESS_EXTENSION 0x80 /end CHARACTERISTIC
/begin CHARACTERISTIC CtApImageProcess_FreeRunning.PpDiagImageProcess_FreeRunningWrite.DeMeasuredValue_ImageProcess_FreeRunning.SurroundView_System_ERR_0xb0d2.PLD_data_read_fail "" VALUE 0x31009f __UBYTE_S 0 NO_COMPU_METHOD 0 255 ECU_ADDRESS_EXTENSION 0x80 /end CHARACTERISTIC
/begin CHARACTERISTIC CtApImageProcess_FreeRunning.PpDiagImageProcess_FreeRunningWrite.DeMeasuredValue_ImageProcess_FreeRunning.SurroundView_System_ERR_0xb0d2.PLD_abnormal_break "" VALUE 0x3100a0 __UBYTE_S 0 NO_COMPU_METHOD 0 255 ECU_ADDRESS_EXTENSION 0x80 /end CHARACTERISTIC
/begin CHARACTERISTIC CtApImageProcess_FreeRunning.PpDiagImageProcess_FreeRunningWrite.DeMeasuredValue_ImageProcess_FreeRunning.SurroundView_System_ERR_0xb0d2.OD_data_read_fail "" VALUE 0x3100a1 __UBYTE_S 0 NO_COMPU_METHOD 0 255 ECU_ADDRESS_EXTENSION 0x80 /end CHARACTERISTIC
/begin CHARACTERISTIC CtApImageProcess_FreeRunning.PpDiagImageProcess_FreeRunningWrite.DeMeasuredValue_ImageProcess_FreeRunning.SurroundView_System_ERR_0xb0d2.camera_service_abnormal_break "" VALUE 0x3100a2 __UBYTE_S 0 NO_COMPU_METHOD 0 255 ECU_ADDRESS_EXTENSION 0x80 /end CHARACTERISTIC
/begin CHARACTERISTIC CtApImageProcess_FreeRunning.PpDiagImageProcess_FreeRunningWrite.DeMeasuredValue_ImageProcess_FreeRunning.SurroundView_System_ERR_0xb0d2.PLD_visit_released_data "" VALUE 0x3100a3 __UBYTE_S 0 NO_COMPU_METHOD 0 255 ECU_ADDRESS_EXTENSION 0x80 /end CHARACTERISTIC
/begin CHARACTERISTIC CtApImageProcess_FreeRunning.PpDiagImageProcess_FreeRunningWrite.DeMeasuredValue_ImageProcess_FreeRunning.SurroundView_System_ERR_0xb0d2.FS_memory_application_fail "" VALUE 0x3100a4 __UBYTE_S 0 NO_COMPU_METHOD 0 255 ECU_ADDRESS_EXTENSION 0x80 /end CHARACTERISTIC
/begin CHARACTERISTIC CtApImageProcess_FreeRunning.PpDiagImageProcess_FreeRunningWrite.DeMeasuredValue_ImageProcess_FreeRunning.SurroundView_System_ERR_0xb0d2.Reserved "" VALUE 0x3100a5 __UBYTE_S 0 NO_COMPU_METHOD 0 255 ECU_ADDRESS_EXTENSION 0x80 /end CHARACTERISTIC
/begin CHARACTERISTIC CtApImageProcess_FreeRunning.PpDiagImageProcess_FreeRunningWrite.DeMeasuredValue_ImageProcess_FreeRunning.SurroundView_System_ERR_0xb0d2.PLD_memory_application_fail "" VALUE 0x3100a6 __UBYTE_S 0 NO_COMPU_METHOD 0 255 ECU_ADDRESS_EXTENSION 0x80 /end CHARACTERISTIC
/begin CHARACTERISTIC CtApImageProcess_FreeRunning.PpDiagImageProcess_FreeRunningWrite.DeMeasuredValue_ImageProcess_FreeRunning.SurroundView_System_ERR_0xb0d2.PLD_process_timeout "" VALUE 0x3100a7 __UBYTE_S 0 NO_COMPU_METHOD 0 255 ECU_ADDRESS_EXTENSION 0x80 /end CHARACTERISTIC
/begin CHARACTERISTIC CtApImageProcess_FreeRunning.PpDiagImageProcess_FreeRunningWrite.DeMeasuredValue_ImageProcess_FreeRunning.SurroundView_System_ERR_0xb0d2.CamSer_dispatch_monitor_faild "" VALUE 0x3100a8 __UBYTE_S 0 NO_COMPU_METHOD 0 255 ECU_ADDRESS_EXTENSION 0x80 /end CHARACTERISTIC
/begin CHARACTERISTIC CtApImageProcess_FreeRunning.PpDiagImageProcess_FreeRunningWrite.DeMeasuredValue_ImageProcess_FreeRunning.SurroundView_System_ERR_0xb0d2.OD_process_timeout "" VALUE 0x3100a9 __UBYTE_S 0 NO_COMPU_METHOD 0 255 ECU_ADDRESS_EXTENSION 0x80 /end CHARACTERISTIC
/begin CHARACTERISTIC CtApImageProcess_FreeRunning.PpDiagImageProcess_FreeRunningWrite.DeMeasuredValue_ImageProcess_FreeRunning.SurroundView_System_ERR_0xb0d2.camera_service_memory_application_fail "" VALUE 0x3100aa __UBYTE_S 0 NO_COMPU_METHOD 0 255 ECU_ADDRESS_EXTENSION 0x80 /end CHARACTERISTIC
/begin CHARACTERISTIC CtApImageProcess_FreeRunning.PpDiagImageProcess_FreeRunningWrite.DeMeasuredValue_ImageProcess_FreeRunning.SurroundView_System_ERR_0xb0d2.OD_visit_uncreated_data "" VALUE 0x3100ab __UBYTE_S 0 NO_COMPU_METHOD 0 255 ECU_ADDRESS_EXTENSION 0x80 /end CHARACTERISTIC
/begin CHARACTERISTIC CtApImageProcess_FreeRunning.PpDiagImageProcess_FreeRunningWrite.DeMeasuredValue_ImageProcess_FreeRunning.SurroundView_System_ERR_0xb0d2.FS_data_visit_timeout "" VALUE 0x3100ac __UBYTE_S 0 NO_COMPU_METHOD 0 255 ECU_ADDRESS_EXTENSION 0x80 /end CHARACTERISTIC
/begin CHARACTERISTIC CtApImageProcess_FreeRunning.PpDiagImageProcess_FreeRunningWrite.DeMeasuredValue_ImageProcess_FreeRunning.SurroundView_System_ERR_0xb0d2.camera_service_data_read_write_conflict "" VALUE 0x3100ad __UBYTE_S 0 NO_COMPU_METHOD 0 255 ECU_ADDRESS_EXTENSION 0x80 /end CHARACTERISTIC
/begin CHARACTERISTIC CtApImageProcess_FreeRunning.PpDiagImageProcess_FreeRunningWrite.DeMeasuredValue_ImageProcess_FreeRunning.SurroundView_System_ERR_0xb0d2.PLD_dispatch_monitor_faild "" VALUE 0x3100ae __UBYTE_S 0 NO_COMPU_METHOD 0 255 ECU_ADDRESS_EXTENSION 0x80 /end CHARACTERISTIC
/begin CHARACTERISTIC CtApImageProcess_FreeRunning.PpDiagImageProcess_FreeRunningWrite.DeMeasuredValue_ImageProcess_FreeRunning.SurroundView_System_ERR_0xb0d2.camera_service_data_write_fail "" VALUE 0x3100af __UBYTE_S 0 NO_COMPU_METHOD 0 255 ECU_ADDRESS_EXTENSION 0x80 /end CHARACTERISTIC
/begin CHARACTERISTIC CtApImageProcess_FreeRunning.PpDiagImageProcess_FreeRunningWrite.DeMeasuredValue_ImageProcess_FreeRunning.SurroundView_System_ERR_0xb0d2.PLD_heartbeat_monitor_faild "" VALUE 0x3100b0 __UBYTE_S 0 NO_COMPU_METHOD 0 255 ECU_ADDRESS_EXTENSION 0x80 /end CHARACTERISTIC
/begin CHARACTERISTIC CtApImageProcess_FreeRunning.PpDiagImageProcess_FreeRunningWrite.DeMeasuredValue_ImageProcess_FreeRunning.SurroundView_System_ERR_0xb0d2.AVM_data_visit_timeout "" VALUE 0x3100b1 __UBYTE_S 0 NO_COMPU_METHOD 0 255 ECU_ADDRESS_EXTENSION 0x80 /end CHARACTERISTIC
/begin CHARACTERISTIC CtApImageProcess_FreeRunning.PpDiagImageProcess_FreeRunningWrite.DeMeasuredValue_ImageProcess_FreeRunning.SurroundView_System_ERR_0xb0d2.FS_visit_uncreated_data "" VALUE 0x3100b2 __UBYTE_S 0 NO_COMPU_METHOD 0 255 ECU_ADDRESS_EXTENSION 0x80 /end CHARACTERISTIC
/begin CHARACTERISTIC CtApImageProcess_FreeRunning.PpDiagImageProcess_FreeRunningWrite.DeMeasuredValue_ImageProcess_FreeRunning.SurroundView_System_ERR_0xb0d2.AVM_data_read_fail "" VALUE 0x3100b3 __UBYTE_S 0 NO_COMPU_METHOD 0 255 ECU_ADDRESS_EXTENSION 0x80 /end CHARACTERISTIC
/begin CHARACTERISTIC CtApImageProcess_FreeRunning.PpDiagImageProcess_FreeRunningWrite.DeMeasuredValue_ImageProcess_FreeRunning.SurroundView_System_ERR_0xb0d2.camera_service_memory_leak "" VALUE 0x3100b4 __UBYTE_S 0 NO_COMPU_METHOD 0 255 ECU_ADDRESS_EXTENSION 0x80 /end CHARACTERISTIC
/begin CHARACTERISTIC CtApImageProcess_FreeRunning.PpImageProcess_FaultCondition_60ms.DeBKP.FaultCondition_BKP "5 uint32 array" VAL_BLK 0x320000 __ULONG_S 0 NO_COMPU_METHOD 0 4294967295 ECU_ADDRESS_EXTENSION 0x80 MATRIX_DIM 5 1 1 /end CHARACTERISTIC
/begin CHARACTERISTIC CtApImageProcess_FreeRunning.PpImageProcess_FaultCondition_60ms.DeFailureCondition.stHeader.Counter "" VALUE 0x330000 __UWORD_S 0 NO_COMPU_METHOD 0 65535 ECU_ADDRESS_EXTENSION 0x80 /end CHARACTERISTIC
/begin CHARACTERISTIC CtApImageProcess_FreeRunning.PpImageProcess_FaultCondition_60ms.DeFailureCondition.stHeader.FrameID "" VALUE 0x330002 __UBYTE_S 0 NO_COMPU_METHOD 0 255 ECU_ADDRESS_EXTENSION 0x80 /end CHARACTERISTIC
/begin CHARACTERISTIC CtApImageProcess_FreeRunning.PpImageProcess_FaultCondition_60ms.DeFailureCondition.stHeader.TimeStamp "2 uint32 array" VAL_BLK 0x330004 __ULONG_S 0 NO_COMPU_METHOD 0 4294967295 ECU_ADDRESS_EXTENSION 0x80 MATRIX_DIM 2 1 1 /end CHARACTERISTIC
/begin CHARACTERISTIC CtApImageProcess_FreeRunning.PpImageProcess_FaultCondition_60ms.DeFailureCondition.nFailureConditionCode "" VALUE 0x33000c __ULONG_S 0 NO_COMPU_METHOD 0 4294967295 ECU_ADDRESS_EXTENSION 0x80 /end CHARACTERISTIC
/begin CHARACTERISTIC CtApImageProcess_FreeRunning.PpImageProcess_FaultCondition_60ms.DeFailureCondition.nReserved "" VALUE 0x330010 __ULONG_S 0 NO_COMPU_METHOD 0 4294967295 ECU_ADDRESS_EXTENSION 0x80 /end CHARACTERISTIC
/begin CHARACTERISTIC CtApImageProcess_FreeRunning.PpImageProcess_FaultCondition_60ms.DeFaultCondition.stHeader.Counter "" VALUE 0x340000 __UWORD_S 0 NO_COMPU_METHOD 0 65535 ECU_ADDRESS_EXTENSION 0x80 /end CHARACTERISTIC
/begin CHARACTERISTIC CtApImageProcess_FreeRunning.PpImageProcess_FaultCondition_60ms.DeFaultCondition.stHeader.FrameID "" VALUE 0x340002 __UBYTE_S 0 NO_COMPU_METHOD 0 255 ECU_ADDRESS_EXTENSION 0x80 /end CHARACTERISTIC
/begin CHARACTERISTIC CtApImageProcess_FreeRunning.PpImageProcess_FaultCondition_60ms.DeFaultCondition.stHeader.TimeStamp "2 uint32 array" VAL_BLK 0x340004 __ULONG_S 0 NO_COMPU_METHOD 0 4294967295 ECU_ADDRESS_EXTENSION 0x80 MATRIX_DIM 2 1 1 /end CHARACTERISTIC
/begin CHARACTERISTIC CtApImageProcess_FreeRunning.PpImageProcess_FaultCondition_60ms.DeFaultCondition.nFaultConditionCode "" VALUE 0x34000c __ULONG_S 0 NO_COMPU_METHOD 0 4294967295 ECU_ADDRESS_EXTENSION 0x80 /end CHARACTERISTIC
/begin CHARACTERISTIC CtApImageProcess_FreeRunning.PpImageProcess_FaultCondition_60ms.DeFaultCondition.nReserved "" VALUE 0x340010 __ULONG_S 0 NO_COMPU_METHOD 0 4294967295 ECU_ADDRESS_EXTENSION 0x80 /end CHARACTERISTIC
/begin CHARACTERISTIC CtApImageProcess_FreeRunning.PpImageProcess_FaultCondition_60ms.DeTriggerCondition.stHeader.Counter "" VALUE 0x350000 __UWORD_S 0 NO_COMPU_METHOD 0 65535 ECU_ADDRESS_EXTENSION 0x80 /end CHARACTERISTIC
/begin CHARACTERISTIC CtApImageProcess_FreeRunning.PpImageProcess_FaultCondition_60ms.DeTriggerCondition.stHeader.FrameID "" VALUE 0x350002 __UBYTE_S 0 NO_COMPU_METHOD 0 255 ECU_ADDRESS_EXTENSION 0x80 /end CHARACTERISTIC
/begin CHARACTERISTIC CtApImageProcess_FreeRunning.PpImageProcess_FaultCondition_60ms.DeTriggerCondition.stHeader.TimeStamp "2 uint32 array" VAL_BLK 0x350004 __ULONG_S 0 NO_COMPU_METHOD 0 4294967295 ECU_ADDRESS_EXTENSION 0x80 MATRIX_DIM 2 1 1 /end CHARACTERISTIC
/begin CHARACTERISTIC CtApImageProcess_FreeRunning.PpImageProcess_FaultCondition_60ms.DeTriggerCondition.nTriggerConditionCode "" VALUE 0x35000c __ULONG_S 0 NO_COMPU_METHOD 0 4294967295 ECU_ADDRESS_EXTENSION 0x80 /end CHARACTERISTIC
/begin CHARACTERISTIC CtApImageProcess_FreeRunning.PpImageProcess_FaultCondition_60ms.DeTriggerCondition.nReserved "" VALUE 0x350010 __ULONG_S 0 NO_COMPU_METHOD 0 4294967295 ECU_ADDRESS_EXTENSION 0x80 /end CHARACTERISTIC
/begin CHARACTERISTIC CtApImageProcess_FreeRunning.PpImageProcess_FreeRunning2EyeQCom_100ms.DeImageProcess2EyeQ.RSD_Sensor_Message_Reserved "" VALUE 0x360000 __UBYTE_S 0 NO_COMPU_METHOD 0 255 ECU_ADDRESS_EXTENSION 0x80 /end CHARACTERISTIC
/begin CHARACTERISTIC CtApImageProcess_FreeRunning.PpImageProcess_FreeRunning2EyeQCom_100ms.DeImageProcess2EyeQ.RSD_EthernetCom_Received_Sync_ID "" VALUE 0x360001 __UBYTE_S 0 NO_COMPU_METHOD 0 255 ECU_ADDRESS_EXTENSION 0x80 /end CHARACTERISTIC
/begin CHARACTERISTIC CtApImageProcess_FreeRunning.PpImageProcess_FreeRunning2EyeQCom_100ms.DeImageProcess2EyeQ.RSDS_Zero_Byte "" VALUE 0x360002 __UBYTE_S 0 NO_COMPU_METHOD 0 255 ECU_ADDRESS_EXTENSION 0x80 /end CHARACTERISTIC
/begin CHARACTERISTIC CtApImageProcess_FreeRunning.PpImageProcess_FreeRunning2EyeQCom_100ms.DeImageProcess2EyeQ.RSDS_Version "" VALUE 0x360003 __UBYTE_S 0 NO_COMPU_METHOD 0 255 ECU_ADDRESS_EXTENSION 0x80 /end CHARACTERISTIC
/begin CHARACTERISTIC CtApImageProcess_FreeRunning.PpImageProcess_FreeRunning2EyeQCom_100ms.DeImageProcess2EyeQ.RSDS_Cyclic_Counter "" VALUE 0x360004 __UBYTE_S 0 NO_COMPU_METHOD 0 255 ECU_ADDRESS_EXTENSION 0x80 /end CHARACTERISTIC
/begin CHARACTERISTIC CtApImageProcess_FreeRunning.PpImageProcess_FreeRunning2EyeQCom_100ms.DeImageProcess2EyeQ.RSDS_Buffer_0 "" VALUE 0x360005 __UBYTE_S 0 NO_COMPU_METHOD 0 255 ECU_ADDRESS_EXTENSION 0x80 /end CHARACTERISTIC
/begin CHARACTERISTIC CtApImageProcess_FreeRunning.PpImageProcess_FreeRunning2EyeQCom_100ms.DeImageProcess2EyeQ.RSDS_Message_ID "" VALUE 0x360006 __UBYTE_S 0 NO_COMPU_METHOD 0 255 ECU_ADDRESS_EXTENSION 0x80 /end CHARACTERISTIC
/begin CHARACTERISTIC CtApImageProcess_FreeRunning.PpImageProcess_FreeRunning2EyeQCom_100ms.DeImageProcess2EyeQ.RSDS_Type "" VALUE 0x360007 __UBYTE_S 0 NO_COMPU_METHOD 0 255 ECU_ADDRESS_EXTENSION 0x80 /end CHARACTERISTIC
/begin CHARACTERISTIC CtApImageProcess_FreeRunning.PpImageProcess_FreeRunning2EyeQCom_100ms.DeImageProcess2EyeQ.RSDS_B_Received "" VALUE 0x360008 __UBYTE_S 0 NO_COMPU_METHOD 0 1 ECU_ADDRESS_EXTENSION 0x80 /end CHARACTERISTIC
/begin CHARACTERISTIC CtApImageProcess_FreeRunning.PpImageProcess_FreeRunning2EyeQCom_100ms.DeImageProcess2EyeQ.RSDS_P_Count "" VALUE 0x360009 __UBYTE_S 0 NO_COMPU_METHOD 0 255 ECU_ADDRESS_EXTENSION 0x80 /end CHARACTERISTIC
/begin CHARACTERISTIC CtApImageProcess_FreeRunning.PpImageProcess_FreeRunning2EyeQCom_100ms.DeImageProcess2EyeQ.RSDS_CRC "" VALUE 0x36000a __UWORD_S 0 NO_COMPU_METHOD 0 65535 ECU_ADDRESS_EXTENSION 0x80 /end CHARACTERISTIC
/begin CHARACTERISTIC CtApImageProcess_FreeRunning.PpImageProcess_FreeRunning2EyeQCom_100ms.DeImageProcess2EyeQ.RSDS_Message_Type "" VALUE 0x36000c __UBYTE_S 0 NO_COMPU_METHOD 0 255 ECU_ADDRESS_EXTENSION 0x80 /end CHARACTERISTIC
/begin CHARACTERISTIC CtApImageProcess_FreeRunning.PpImageProcess_FreeRunning2EyeQCom_100ms.DeImageProcess2EyeQ.RSDS_Size "" VALUE 0x360010 __ULONG_S 0 NO_COMPU_METHOD 0 4294967295 ECU_ADDRESS_EXTENSION 0x80 /end CHARACTERISTIC
/begin CHARACTERISTIC CtApImageProcess_FreeRunning.PpImageProcess_FreeRunning2EyeQCom_100ms.DeImageProcess2EyeQ.RSDS_Buffer_1 "" VALUE 0x360014 __UBYTE_S 0 NO_COMPU_METHOD 0 255 ECU_ADDRESS_EXTENSION 0x80 /end CHARACTERISTIC
/begin CHARACTERISTIC CtApImageProcess_FreeRunning.PpImageProcess_FreeRunning2EyeQCom_100ms.DeImageProcess2EyeQ.RSDS_Reserved_1 "" VALUE 0x360015 __UBYTE_S 0 NO_COMPU_METHOD 0 255 ECU_ADDRESS_EXTENSION 0x80 /end CHARACTERISTIC
/begin CHARACTERISTIC CtApImageProcess_FreeRunning.PpImageProcess_FreeSpace_60ms.DeBKP "200 uint8 array" VAL_BLK 0x370000 __UBYTE_S 0 NO_COMPU_METHOD 0 255 ECU_ADDRESS_EXTENSION 0x80 MATRIX_DIM 200 1 1 /end CHARACTERISTIC
/begin CHARACTERISTIC CtApImageProcess_FreeRunning.PpImageProcess_FreeSpace_60ms.DeFreeSpcae.stHeader.Counter "" VALUE 0x380000 __UWORD_S 0 NO_COMPU_METHOD 0 65535 ECU_ADDRESS_EXTENSION 0x80 /end CHARACTERISTIC
/begin CHARACTERISTIC CtApImageProcess_FreeRunning.PpImageProcess_FreeSpace_60ms.DeFreeSpcae.stHeader.FrameID "" VALUE 0x380002 __UBYTE_S 0 NO_COMPU_METHOD 0 255 ECU_ADDRESS_EXTENSION 0x80 /end CHARACTERISTIC
/begin CHARACTERISTIC CtApImageProcess_FreeRunning.PpImageProcess_FreeSpace_60ms.DeFreeSpcae.stHeader.TimeStamp "2 uint32 array" VAL_BLK 0x380004 __ULONG_S 0 NO_COMPU_METHOD 0 4294967295 ECU_ADDRESS_EXTENSION 0x80 MATRIX_DIM 2 1 1 /end CHARACTERISTIC
/begin CHARACTERISTIC CtApImageProcess_FreeRunning.PpImageProcess_FreeSpace_60ms.DeFreeSpcae.nImageTimeStamp "2 uint32 array" VAL_BLK 0x38000c __ULONG_S 0 NO_COMPU_METHOD 0 4294967295 ECU_ADDRESS_EXTENSION 0x80 MATRIX_DIM 2 1 1 /end CHARACTERISTIC
/begin CHARACTERISTIC CtApImageProcess_FreeRunning.PpImageProcess_FreeSpace_60ms.DeFreeSpcae.gstSVFreespaces[0].stHeader.Counter "" VALUE 0x380014 __UWORD_S 0 NO_COMPU_METHOD 0 65535 ECU_ADDRESS_EXTENSION 0x80 /end CHARACTERISTIC
/begin CHARACTERISTIC CtApImageProcess_FreeRunning.PpImageProcess_FreeSpace_60ms.DeFreeSpcae.gstSVFreespaces[0].stHeader.FrameID "" VALUE 0x380016 __UBYTE_S 0 NO_COMPU_METHOD 0 255 ECU_ADDRESS_EXTENSION 0x80 /end CHARACTERISTIC
/begin CHARACTERISTIC CtApImageProcess_FreeRunning.PpImageProcess_FreeSpace_60ms.DeFreeSpcae.gstSVFreespaces[0].stHeader.TimeStamp "2 uint32 array" VAL_BLK 0x380018 __ULONG_S 0 NO_COMPU_METHOD 0 4294967295 ECU_ADDRESS_EXTENSION 0x80 MATRIX_DIM 2 1 1 /end CHARACTERISTIC
/begin CHARACTERISTIC CtApImageProcess_FreeRunning.PpImageProcess_FreeSpace_60ms.DeFreeSpcae.gstSVFreespaces[0].Is_Valid "" VALUE 0x380020 __UBYTE_S 0 NO_COMPU_METHOD 0 255 ECU_ADDRESS_EXTENSION 0x80 /end CHARACTERISTIC
/begin CHARACTERISTIC CtApImageProcess_FreeRunning.PpImageProcess_FreeSpace_60ms.DeFreeSpcae.gstSVFreespaces[0].Existence_Prob "" VALUE 0x380024 __FLOAT32_IEEE_S 0 NO_COMPU_METHOD 0 3.402823e+38 ECU_ADDRESS_EXTENSION 0x80 /end CHARACTERISTIC
/begin CHARACTERISTIC CtApImageProcess_FreeRunning.PpImageProcess_FreeSpace_60ms.DeFreeSpcae.gstSVFreespaces[0].Classification_Conf "" VALUE 0x380028 __FLOAT32_IEEE_S 0 NO_COMPU_METHOD 0 3.402823e+38 ECU_ADDRESS_EXTENSION 0x80 /end CHARACTERISTIC
/begin CHARACTERISTIC CtApImageProcess_FreeRunning.PpImageProcess_FreeSpace_60ms.DeFreeSpcae.gstSVFreespaces[0].Classification_Type "" VALUE 0x38002c __UBYTE_S 0 NO_COMPU_METHOD 0 255 ECU_ADDRESS_EXTENSION 0x80 /end CHARACTERISTIC
/begin CHARACTERISTIC CtApImageProcess_FreeRunning.PpImageProcess_FreeSpace_60ms.DeFreeSpcae.gstSVFreespaces[0].fPointX "" VALUE 0x380030 __FLOAT32_IEEE_S 0 NO_COMPU_METHOD 0 3.402823e+38 ECU_ADDRESS_EXTENSION 0x80 /end CHARACTERISTIC
/begin CHARACTERISTIC CtApImageProcess_FreeRunning.PpImageProcess_FreeSpace_60ms.DeFreeSpcae.gstSVFreespaces[0].fPointY "" VALUE 0x380034 __FLOAT32_IEEE_S 0 NO_COMPU_METHOD 0 3.402823e+38 ECU_ADDRESS_EXTENSION 0x80 /end CHARACTERISTIC
/begin CHARACTERISTIC CtApImageProcess_FreeRunning.PpImageProcess_FreeSpace_60ms.DeFreeSpcae.gstSVFreespaces[0].fPointZ "" VALUE 0x380038 __FLOAT32_IEEE_S 0 NO_COMPU_METHOD 0 3.402823e+38 ECU_ADDRESS_EXTENSION 0x80 /end CHARACTERISTIC
/begin CHARACTERISTIC CtApImageProcess_FreeRunning.PpImageProcess_FreeSpace_60ms.DeFreeSpcae.gstSVFreespaces[1].stHeader.Counter "" VALUE 0x38003c __UWORD_S 0 NO_COMPU_METHOD 0 65535 ECU_ADDRESS_EXTENSION 0x80 /end CHARACTERISTIC
/begin CHARACTERISTIC CtApImageProcess_FreeRunning.PpImageProcess_FreeSpace_60ms.DeFreeSpcae.gstSVFreespaces[1].stHeader.FrameID "" VALUE 0x38003e __UBYTE_S 0 NO_COMPU_METHOD 0 255 ECU_ADDRESS_EXTENSION 0x80 /end CHARACTERISTIC
/begin CHARACTERISTIC CtApImageProcess_FreeRunning.PpImageProcess_FreeSpace_60ms.DeFreeSpcae.gstSVFreespaces[1].stHeader.TimeStamp "2 uint32 array" VAL_BLK 0x380040 __ULONG_S 0 NO_COMPU_METHOD 0 4294967295 ECU_ADDRESS_EXTENSION 0x80 MATRIX_DIM 2 1 1 /end CHARACTERISTIC
/begin CHARACTERISTIC CtApImageProcess_FreeRunning.PpImageProcess_FreeSpace_60ms.DeFreeSpcae.gstSVFreespaces[1].Is_Valid "" VALUE 0x380048 __UBYTE_S 0 NO_COMPU_METHOD 0 255 ECU_ADDRESS_EXTENSION 0x80 /end CHARACTERISTIC
/begin CHARACTERISTIC CtApImageProcess_FreeRunning.PpImageProcess_FreeSpace_60ms.DeFreeSpcae.gstSVFreespaces[1].Existence_Prob "" VALUE 0x38004c __FLOAT32_IEEE_S 0 NO_COMPU_METHOD 0 3.402823e+38 ECU_ADDRESS_EXTENSION 0x80 /end CHARACTERISTIC
/begin CHARACTERISTIC CtApImageProcess_FreeRunning.PpImageProcess_FreeSpace_60ms.DeFreeSpcae.gstSVFreespaces[1].Classification_Conf "" VALUE 0x380050 __FLOAT32_IEEE_S 0 NO_COMPU_METHOD 0 3.402823e+38 ECU_ADDRESS_EXTENSION 0x80 /end CHARACTERISTIC
/begin CHARACTERISTIC CtApImageProcess_FreeRunning.PpImageProcess_FreeSpace_60ms.DeFreeSpcae.gstSVFreespaces[1].Classification_Type "" VALUE 0x380054 __UBYTE_S 0 NO_COMPU_METHOD 0 255 ECU_ADDRESS_EXTENSION 0x80 /end CHARACTERISTIC
/begin CHARACTERISTIC CtApImageProcess_FreeRunning.PpImageProcess_FreeSpace_60ms.DeFreeSpcae.gstSVFreespaces[1].fPointX "" VALUE 0x380058 __FLOAT32_IEEE_S 0 NO_COMPU_METHOD 0 3.402823e+38 ECU_ADDRESS_EXTENSION 0x80 /end CHARACTERISTIC
/begin CHARACTERISTIC CtApImageProcess_FreeRunning.PpImageProcess_FreeSpace_60ms.DeFreeSpcae.gstSVFreespaces[1].fPointY "" VALUE 0x38005c __FLOAT32_IEEE_S 0 NO_COMPU_METHOD 0 3.402823e+38 ECU_ADDRESS_EXTENSION 0x80 /end CHARACTERISTIC
/begin CHARACTERISTIC CtApImageProcess_FreeRunning.PpImageProcess_FreeSpace_60ms.DeFreeSpcae.gstSVFreespaces[1].fPointZ "" VALUE 0x380060 __FLOAT32_IEEE_S 0 NO_COMPU_METHOD 0 3.402823e+38 ECU_ADDRESS_EXTENSION 0x80 /end CHARACTERISTIC
/begin CHARACTERISTIC CtApImageProcess_FreeRunning.PpImageProcess_FreeSpace_60ms.DeFreeSpcae.gstSVFreespaces[2].stHeader.Counter "" VALUE 0x380064 __UWORD_S 0 NO_COMPU_METHOD 0 65535 ECU_ADDRESS_EXTENSION 0x80 /end CHARACTERISTIC
/begin CHARACTERISTIC CtApImageProcess_FreeRunning.PpImageProcess_FreeSpace_60ms.DeFreeSpcae.gstSVFreespaces[2].stHeader.FrameID "" VALUE 0x380066 __UBYTE_S 0 NO_COMPU_METHOD 0 255 ECU_ADDRESS_EXTENSION 0x80 /end CHARACTERISTIC
/begin CHARACTERISTIC CtApImageProcess_FreeRunning.PpImageProcess_FreeSpace_60ms.DeFreeSpcae.gstSVFreespaces[2].stHeader.TimeStamp "2 uint32 array" VAL_BLK 0x380068 __ULONG_S 0 NO_COMPU_METHOD 0 4294967295 ECU_ADDRESS_EXTENSION 0x80 MATRIX_DIM 2 1 1 /end CHARACTERISTIC
/begin CHARACTERISTIC CtApImageProcess_FreeRunning.PpImageProcess_FreeSpace_60ms.DeFreeSpcae.gstSVFreespaces[2].Is_Valid "" VALUE 0x380070 __UBYTE_S 0 NO_COMPU_METHOD 0 255 ECU_ADDRESS_EXTENSION 0x80 /end CHARACTERISTIC
/begin CHARACTERISTIC CtApImageProcess_FreeRunning.PpImageProcess_FreeSpace_60ms.DeFreeSpcae.gstSVFreespaces[2].Existence_Prob "" VALUE 0x380074 __FLOAT32_IEEE_S 0 NO_COMPU_METHOD 0 3.402823e+38 ECU_ADDRESS_EXTENSION 0x80 /end CHARACTERISTIC
/begin CHARACTERISTIC CtApImageProcess_FreeRunning.PpImageProcess_FreeSpace_60ms.DeFreeSpcae.gstSVFreespaces[2].Classification_Conf "" VALUE 0x380078 __FLOAT32_IEEE_S 0 NO_COMPU_METHOD 0 3.402823e+38 ECU_ADDRESS_EXTENSION 0x80 /end CHARACTERISTIC
/begin CHARACTERISTIC CtApImageProcess_FreeRunning.PpImageProcess_FreeSpace_60ms.DeFreeSpcae.gstSVFreespaces[2].Classification_Type "" VALUE 0x38007c __UBYTE_S 0 NO_COMPU_METHOD 0 255 ECU_ADDRESS_EXTENSION 0x80 /end CHARACTERISTIC
/begin CHARACTERISTIC CtApImageProcess_FreeRunning.PpImageProcess_FreeSpace_60ms.DeFreeSpcae.gstSVFreespaces[2].fPointX "" VALUE 0x380080 __FLOAT32_IEEE_S 0 NO_COMPU_METHOD 0 3.402823e+38 ECU_ADDRESS_EXTENSION 0x80 /end CHARACTERISTIC
/begin CHARACTERISTIC CtApImageProcess_FreeRunning.PpImageProcess_FreeSpace_60ms.DeFreeSpcae.gstSVFreespaces[2].fPointY "" VALUE 0x380084 __FLOAT32_IEEE_S 0 NO_COMPU_METHOD 0 3.402823e+38 ECU_ADDRESS_EXTENSION 0x80 /end CHARACTERISTIC
/begin CHARACTERISTIC CtApImageProcess_FreeRunning.PpImageProcess_FreeSpace_60ms.DeFreeSpcae.gstSVFreespaces[2].fPointZ "" VALUE 0x380088 __FLOAT32_IEEE_S 0 NO_COMPU_METHOD 0 3.402823e+38 ECU_ADDRESS_EXTENSION 0x80 /end CHARACTERISTIC
/begin CHARACTERISTIC CtApImageProcess_FreeRunning.PpImageProcess_FreeSpace_60ms.DeFreeSpcae.gstSVFreespaces[3].stHeader.Counter "" VALUE 0x38008c __UWORD_S 0 NO_COMPU_METHOD 0 65535 ECU_ADDRESS_EXTENSION 0x80 /end CHARACTERISTIC
/begin CHARACTERISTIC CtApImageProcess_FreeRunning.PpImageProcess_FreeSpace_60ms.DeFreeSpcae.gstSVFreespaces[3].stHeader.FrameID "" VALUE 0x38008e __UBYTE_S 0 NO_COMPU_METHOD 0 255 ECU_ADDRESS_EXTENSION 0x80 /end CHARACTERISTIC
/begin CHARACTERISTIC CtApImageProcess_FreeRunning.PpImageProcess_FreeSpace_60ms.DeFreeSpcae.gstSVFreespaces[3].stHeader.TimeStamp "2 uint32 array" VAL_BLK 0x380090 __ULONG_S 0 NO_COMPU_METHOD 0 4294967295 ECU_ADDRESS_EXTENSION 0x80 MATRIX_DIM 2 1 1 /end CHARACTERISTIC
/begin CHARACTERISTIC CtApImageProcess_FreeRunning.PpImageProcess_FreeSpace_60ms.DeFreeSpcae.gstSVFreespaces[3].Is_Valid "" VALUE 0x380098 __UBYTE_S 0 NO_COMPU_METHOD 0 255 ECU_ADDRESS_EXTENSION 0x80 /end CHARACTERISTIC
/begin CHARACTERISTIC CtApImageProcess_FreeRunning.PpImageProcess_FreeSpace_60ms.DeFreeSpcae.gstSVFreespaces[3].Existence_Prob "" VALUE 0x38009c __FLOAT32_IEEE_S 0 NO_COMPU_METHOD 0 3.402823e+38 ECU_ADDRESS_EXTENSION 0x80 /end CHARACTERISTIC
/begin CHARACTERISTIC CtApImageProcess_FreeRunning.PpImageProcess_FreeSpace_60ms.DeFreeSpcae.gstSVFreespaces[3].Classification_Conf "" VALUE 0x3800a0 __FLOAT32_IEEE_S 0 NO_COMPU_METHOD 0 3.402823e+38 ECU_ADDRESS_EXTENSION 0x80 /end CHARACTERISTIC
/begin CHARACTERISTIC CtApImageProcess_FreeRunning.PpImageProcess_FreeSpace_60ms.DeFreeSpcae.gstSVFreespaces[3].Classification_Type "" VALUE 0x3800a4 __UBYTE_S 0 NO_COMPU_METHOD 0 255 ECU_ADDRESS_EXTENSION 0x80 /end CHARACTERISTIC
/begin CHARACTERISTIC CtApImageProcess_FreeRunning.PpImageProcess_FreeSpace_60ms.DeFreeSpcae.gstSVFreespaces[3].fPointX "" VALUE 0x3800a8 __FLOAT32_IEEE_S 0 NO_COMPU_METHOD 0 3.402823e+38 ECU_ADDRESS_EXTENSION 0x80 /end CHARACTERISTIC
/begin CHARACTERISTIC CtApImageProcess_FreeRunning.PpImageProcess_FreeSpace_60ms.DeFreeSpcae.gstSVFreespaces[3].fPointY "" VALUE 0x3800ac __FLOAT32_IEEE_S 0 NO_COMPU_METHOD 0 3.402823e+38 ECU_ADDRESS_EXTENSION 0x80 /end CHARACTERISTIC
/begin CHARACTERISTIC CtApImageProcess_FreeRunning.PpImageProcess_FreeSpace_60ms.DeFreeSpcae.gstSVFreespaces[3].fPointZ "" VALUE 0x3800b0 __FLOAT32_IEEE_S 0 NO_COMPU_METHOD 0 3.402823e+38 ECU_ADDRESS_EXTENSION 0x80 /end CHARACTERISTIC
/begin CHARACTERISTIC CtApImageProcess_FreeRunning.PpImageProcess_FreeSpace_60ms.DeFreeSpcae.gstSVFreespaces[4].stHeader.Counter "" VALUE 0x3800b4 __UWORD_S 0 NO_COMPU_METHOD 0 65535 ECU_ADDRESS_EXTENSION 0x80 /end CHARACTERISTIC
/begin CHARACTERISTIC CtApImageProcess_FreeRunning.PpImageProcess_FreeSpace_60ms.DeFreeSpcae.gstSVFreespaces[4].stHeader.FrameID "" VALUE 0x3800b6 __UBYTE_S 0 NO_COMPU_METHOD 0 255 ECU_ADDRESS_EXTENSION 0x80 /end CHARACTERISTIC
/begin CHARACTERISTIC CtApImageProcess_FreeRunning.PpImageProcess_FreeSpace_60ms.DeFreeSpcae.gstSVFreespaces[4].stHeader.TimeStamp "2 uint32 array" VAL_BLK 0x3800b8 __ULONG_S 0 NO_COMPU_METHOD 0 4294967295 ECU_ADDRESS_EXTENSION 0x80 MATRIX_DIM 2 1 1 /end CHARACTERISTIC
/begin CHARACTERISTIC CtApImageProcess_FreeRunning.PpImageProcess_FreeSpace_60ms.DeFreeSpcae.gstSVFreespaces[4].Is_Valid "" VALUE 0x3800c0 __UBYTE_S 0 NO_COMPU_METHOD 0 255 ECU_ADDRESS_EXTENSION 0x80 /end CHARACTERISTIC
/begin CHARACTERISTIC CtApImageProcess_FreeRunning.PpImageProcess_FreeSpace_60ms.DeFreeSpcae.gstSVFreespaces[4].Existence_Prob "" VALUE 0x3800c4 __FLOAT32_IEEE_S 0 NO_COMPU_METHOD 0 3.402823e+38 ECU_ADDRESS_EXTENSION 0x80 /end CHARACTERISTIC
/begin CHARACTERISTIC CtApImageProcess_FreeRunning.PpImageProcess_FreeSpace_60ms.DeFreeSpcae.gstSVFreespaces[4].Classification_Conf "" VALUE 0x3800c8 __FLOAT32_IEEE_S 0 NO_COMPU_METHOD 0 3.402823e+38 ECU_ADDRESS_EXTENSION 0x80 /end CHARACTERISTIC
/begin CHARACTERISTIC CtApImageProcess_FreeRunning.PpImageProcess_FreeSpace_60ms.DeFreeSpcae.gstSVFreespaces[4].Classification_Type "" VALUE 0x3800cc __UBYTE_S 0 NO_COMPU_METHOD 0 255 ECU_ADDRESS_EXTENSION 0x80 /end CHARACTERISTIC
/begin CHARACTERISTIC CtApImageProcess_FreeRunning.PpImageProcess_FreeSpace_60ms.DeFreeSpcae.gstSVFreespaces[4].fPointX "" VALUE 0x3800d0 __FLOAT32_IEEE_S 0 NO_COMPU_METHOD 0 3.402823e+38 ECU_ADDRESS_EXTENSION 0x80 /end CHARACTERISTIC
/begin CHARACTERISTIC CtApImageProcess_FreeRunning.PpImageProcess_FreeSpace_60ms.DeFreeSpcae.gstSVFreespaces[4].fPointY "" VALUE 0x3800d4 __FLOAT32_IEEE_S 0 NO_COMPU_METHOD 0 3.402823e+38 ECU_ADDRESS_EXTENSION 0x80 /end CHARACTERISTIC
/begin CHARACTERISTIC CtApImageProcess_FreeRunning.PpImageProcess_FreeSpace_60ms.DeFreeSpcae.gstSVFreespaces[4].fPointZ "" VALUE 0x3800d8 __FLOAT32_IEEE_S 0 NO_COMPU_METHOD 0 3.402823e+38 ECU_ADDRESS_EXTENSION 0x80 /end CHARACTERISTIC
/begin CHARACTERISTIC CtApImageProcess_FreeRunning.PpImageProcess_FreeSpace_60ms.DeFreeSpcae.gstSVFreespaces[5].stHeader.Counter "" VALUE 0x3800dc __UWORD_S 0 NO_COMPU_METHOD 0 65535 ECU_ADDRESS_EXTENSION 0x80 /end CHARACTERISTIC
/begin CHARACTERISTIC CtApImageProcess_FreeRunning.PpImageProcess_FreeSpace_60ms.DeFreeSpcae.gstSVFreespaces[5].stHeader.FrameID "" VALUE 0x3800de __UBYTE_S 0 NO_COMPU_METHOD 0 255 ECU_ADDRESS_EXTENSION 0x80 /end CHARACTERISTIC
/begin CHARACTERISTIC CtApImageProcess_FreeRunning.PpImageProcess_FreeSpace_60ms.DeFreeSpcae.gstSVFreespaces[5].stHeader.TimeStamp "2 uint32 array" VAL_BLK 0x3800e0 __ULONG_S 0 NO_COMPU_METHOD 0 4294967295 ECU_ADDRESS_EXTENSION 0x80 MATRIX_DIM 2 1 1 /end CHARACTERISTIC
/begin CHARACTERISTIC CtApImageProcess_FreeRunning.PpImageProcess_FreeSpace_60ms.DeFreeSpcae.gstSVFreespaces[5].Is_Valid "" VALUE 0x3800e8 __UBYTE_S 0 NO_COMPU_METHOD 0 255 ECU_ADDRESS_EXTENSION 0x80 /end CHARACTERISTIC
/begin CHARACTERISTIC CtApImageProcess_FreeRunning.PpImageProcess_FreeSpace_60ms.DeFreeSpcae.gstSVFreespaces[5].Existence_Prob "" VALUE 0x3800ec __FLOAT32_IEEE_S 0 NO_COMPU_METHOD 0 3.402823e+38 ECU_ADDRESS_EXTENSION 0x80 /end CHARACTERISTIC
/begin CHARACTERISTIC CtApImageProcess_FreeRunning.PpImageProcess_FreeSpace_60ms.DeFreeSpcae.gstSVFreespaces[5].Classification_Conf "" VALUE 0x3800f0 __FLOAT32_IEEE_S 0 NO_COMPU_METHOD 0 3.402823e+38 ECU_ADDRESS_EXTENSION 0x80 /end CHARACTERISTIC
/begin CHARACTERISTIC CtApImageProcess_FreeRunning.PpImageProcess_FreeSpace_60ms.DeFreeSpcae.gstSVFreespaces[5].Classification_Type "" VALUE 0x3800f4 __UBYTE_S 0 NO_COMPU_METHOD 0 255 ECU_ADDRESS_EXTENSION 0x80 /end CHARACTERISTIC
/begin CHARACTERISTIC CtApImageProcess_FreeRunning.PpImageProcess_FreeSpace_60ms.DeFreeSpcae.gstSVFreespaces[5].fPointX "" VALUE 0x3800f8 __FLOAT32_IEEE_S 0 NO_COMPU_METHOD 0 3.402823e+38 ECU_ADDRESS_EXTENSION 0x80 /end CHARACTERISTIC
/begin CHARACTERISTIC CtApImageProcess_FreeRunning.PpImageProcess_FreeSpace_60ms.DeFreeSpcae.gstSVFreespaces[5].fPointY "" VALUE 0x3800fc __FLOAT32_IEEE_S 0 NO_COMPU_METHOD 0 3.402823e+38 ECU_ADDRESS_EXTENSION 0x80 /end CHARACTERISTIC
/begin CHARACTERISTIC CtApImageProcess_FreeRunning.PpImageProcess_FreeSpace_60ms.DeFreeSpcae.gstSVFreespaces[5].fPointZ "" VALUE 0x380100 __FLOAT32_IEEE_S 0 NO_COMPU_METHOD 0 3.402823e+38 ECU_ADDRESS_EXTENSION 0x80 /end CHARACTERISTIC
/begin CHARACTERISTIC CtApImageProcess_FreeRunning.PpImageProcess_FreeSpace_60ms.DeFreeSpcae.gstSVFreespaces[6].stHeader.Counter "" VALUE 0x380104 __UWORD_S 0 NO_COMPU_METHOD 0 65535 ECU_ADDRESS_EXTENSION 0x80 /end CHARACTERISTIC
/begin CHARACTERISTIC CtApImageProcess_FreeRunning.PpImageProcess_FreeSpace_60ms.DeFreeSpcae.gstSVFreespaces[6].stHeader.FrameID "" VALUE 0x380106 __UBYTE_S 0 NO_COMPU_METHOD 0 255 ECU_ADDRESS_EXTENSION 0x80 /end CHARACTERISTIC
/begin CHARACTERISTIC CtApImageProcess_FreeRunning.PpImageProcess_FreeSpace_60ms.DeFreeSpcae.gstSVFreespaces[6].stHeader.TimeStamp "2 uint32 array" VAL_BLK 0x380108 __ULONG_S 0 NO_COMPU_METHOD 0 4294967295 ECU_ADDRESS_EXTENSION 0x80 MATRIX_DIM 2 1 1 /end CHARACTERISTIC
/begin CHARACTERISTIC CtApImageProcess_FreeRunning.PpImageProcess_FreeSpace_60ms.DeFreeSpcae.gstSVFreespaces[6].Is_Valid "" VALUE 0x380110 __UBYTE_S 0 NO_COMPU_METHOD 0 255 ECU_ADDRESS_EXTENSION 0x80 /end CHARACTERISTIC
/begin CHARACTERISTIC CtApImageProcess_FreeRunning.PpImageProcess_FreeSpace_60ms.DeFreeSpcae.gstSVFreespaces[6].Existence_Prob "" VALUE 0x380114 __FLOAT32_IEEE_S 0 NO_COMPU_METHOD 0 3.402823e+38 ECU_ADDRESS_EXTENSION 0x80 /end CHARACTERISTIC
/begin CHARACTERISTIC CtApImageProcess_FreeRunning.PpImageProcess_FreeSpace_60ms.DeFreeSpcae.gstSVFreespaces[6].Classification_Conf "" VALUE 0x380118 __FLOAT32_IEEE_S 0 NO_COMPU_METHOD 0 3.402823e+38 ECU_ADDRESS_EXTENSION 0x80 /end CHARACTERISTIC
/begin CHARACTERISTIC CtApImageProcess_FreeRunning.PpImageProcess_FreeSpace_60ms.DeFreeSpcae.gstSVFreespaces[6].Classification_Type "" VALUE 0x38011c __UBYTE_S 0 NO_COMPU_METHOD 0 255 ECU_ADDRESS_EXTENSION 0x80 /end CHARACTERISTIC
/begin CHARACTERISTIC CtApImageProcess_FreeRunning.PpImageProcess_FreeSpace_60ms.DeFreeSpcae.gstSVFreespaces[6].fPointX "" VALUE 0x380120 __FLOAT32_IEEE_S 0 NO_COMPU_METHOD 0 3.402823e+38 ECU_ADDRESS_EXTENSION 0x80 /end CHARACTERISTIC
/begin CHARACTERISTIC CtApImageProcess_FreeRunning.PpImageProcess_FreeSpace_60ms.DeFreeSpcae.gstSVFreespaces[6].fPointY "" VALUE 0x380124 __FLOAT32_IEEE_S 0 NO_COMPU_METHOD 0 3.402823e+38 ECU_ADDRESS_EXTENSION 0x80 /end CHARACTERISTIC
/begin CHARACTERISTIC CtApImageProcess_FreeRunning.PpImageProcess_FreeSpace_60ms.DeFreeSpcae.gstSVFreespaces[6].fPointZ "" VALUE 0x380128 __FLOAT32_IEEE_S 0 NO_COMPU_METHOD 0 3.402823e+38 ECU_ADDRESS_EXTENSION 0x80 /end CHARACTERISTIC
/begin CHARACTERISTIC CtApImageProcess_FreeRunning.PpImageProcess_FreeSpace_60ms.DeFreeSpcae.gstSVFreespaces[7].stHeader.Counter "" VALUE 0x38012c __UWORD_S 0 NO_COMPU_METHOD 0 65535 ECU_ADDRESS_EXTENSION 0x80 /end CHARACTERISTIC
/begin CHARACTERISTIC CtApImageProcess_FreeRunning.PpImageProcess_FreeSpace_60ms.DeFreeSpcae.gstSVFreespaces[7].stHeader.FrameID "" VALUE 0x38012e __UBYTE_S 0 NO_COMPU_METHOD 0 255 ECU_ADDRESS_EXTENSION 0x80 /end CHARACTERISTIC
/begin CHARACTERISTIC CtApImageProcess_FreeRunning.PpImageProcess_FreeSpace_60ms.DeFreeSpcae.gstSVFreespaces[7].stHeader.TimeStamp "2 uint32 array" VAL_BLK 0x380130 __ULONG_S 0 NO_COMPU_METHOD 0 4294967295 ECU_ADDRESS_EXTENSION 0x80 MATRIX_DIM 2 1 1 /end CHARACTERISTIC
/begin CHARACTERISTIC CtApImageProcess_FreeRunning.PpImageProcess_FreeSpace_60ms.DeFreeSpcae.gstSVFreespaces[7].Is_Valid "" VALUE 0x380138 __UBYTE_S 0 NO_COMPU_METHOD 0 255 ECU_ADDRESS_EXTENSION 0x80 /end CHARACTERISTIC
/begin CHARACTERISTIC CtApImageProcess_FreeRunning.PpImageProcess_FreeSpace_60ms.DeFreeSpcae.gstSVFreespaces[7].Existence_Prob "" VALUE 0x38013c __FLOAT32_IEEE_S 0 NO_COMPU_METHOD 0 3.402823e+38 ECU_ADDRESS_EXTENSION 0x80 /end CHARACTERISTIC
/begin CHARACTERISTIC CtApImageProcess_FreeRunning.PpImageProcess_FreeSpace_60ms.DeFreeSpcae.gstSVFreespaces[7].Classification_Conf "" VALUE 0x380140 __FLOAT32_IEEE_S 0 NO_COMPU_METHOD 0 3.402823e+38 ECU_ADDRESS_EXTENSION 0x80 /end CHARACTERISTIC
/begin CHARACTERISTIC CtApImageProcess_FreeRunning.PpImageProcess_FreeSpace_60ms.DeFreeSpcae.gstSVFreespaces[7].Classification_Type "" VALUE 0x380144 __UBYTE_S 0 NO_COMPU_METHOD 0 255 ECU_ADDRESS_EXTENSION 0x80 /end CHARACTERISTIC
/begin CHARACTERISTIC CtApImageProcess_FreeRunning.PpImageProcess_FreeSpace_60ms.DeFreeSpcae.gstSVFreespaces[7].fPointX "" VALUE 0x380148 __FLOAT32_IEEE_S 0 NO_COMPU_METHOD 0 3.402823e+38 ECU_ADDRESS_EXTENSION 0x80 /end CHARACTERISTIC
/begin CHARACTERISTIC CtApImageProcess_FreeRunning.PpImageProcess_FreeSpace_60ms.DeFreeSpcae.gstSVFreespaces[7].fPointY "" VALUE 0x38014c __FLOAT32_IEEE_S 0 NO_COMPU_METHOD 0 3.402823e+38 ECU_ADDRESS_EXTENSION 0x80 /end CHARACTERISTIC
/begin CHARACTERISTIC CtApImageProcess_FreeRunning.PpImageProcess_FreeSpace_60ms.DeFreeSpcae.gstSVFreespaces[7].fPointZ "" VALUE 0x380150 __FLOAT32_IEEE_S 0 NO_COMPU_METHOD 0 3.402823e+38 ECU_ADDRESS_EXTENSION 0x80 /end CHARACTERISTIC
/begin CHARACTERISTIC CtApImageProcess_FreeRunning.PpImageProcess_FreeSpace_60ms.DeFreeSpcae.gstSVFreespaces[8].stHeader.Counter "" VALUE 0x380154 __UWORD_S 0 NO_COMPU_METHOD 0 65535 ECU_ADDRESS_EXTENSION 0x80 /end CHARACTERISTIC
/begin CHARACTERISTIC CtApImageProcess_FreeRunning.PpImageProcess_FreeSpace_60ms.DeFreeSpcae.gstSVFreespaces[8].stHeader.FrameID "" VALUE 0x380156 __UBYTE_S 0 NO_COMPU_METHOD 0 255 ECU_ADDRESS_EXTENSION 0x80 /end CHARACTERISTIC
/begin CHARACTERISTIC CtApImageProcess_FreeRunning.PpImageProcess_FreeSpace_60ms.DeFreeSpcae.gstSVFreespaces[8].stHeader.TimeStamp "2 uint32 array" VAL_BLK 0x380158 __ULONG_S 0 NO_COMPU_METHOD 0 4294967295 ECU_ADDRESS_EXTENSION 0x80 MATRIX_DIM 2 1 1 /end CHARACTERISTIC
/begin CHARACTERISTIC CtApImageProcess_FreeRunning.PpImageProcess_FreeSpace_60ms.DeFreeSpcae.gstSVFreespaces[8].Is_Valid "" VALUE 0x380160 __UBYTE_S 0 NO_COMPU_METHOD 0 255 ECU_ADDRESS_EXTENSION 0x80 /end CHARACTERISTIC
/begin CHARACTERISTIC CtApImageProcess_FreeRunning.PpImageProcess_FreeSpace_60ms.DeFreeSpcae.gstSVFreespaces[8].Existence_Prob "" VALUE 0x380164 __FLOAT32_IEEE_S 0 NO_COMPU_METHOD 0 3.402823e+38 ECU_ADDRESS_EXTENSION 0x80 /end CHARACTERISTIC
/begin CHARACTERISTIC CtApImageProcess_FreeRunning.PpImageProcess_FreeSpace_60ms.DeFreeSpcae.gstSVFreespaces[8].Classification_Conf "" VALUE 0x380168 __FLOAT32_IEEE_S 0 NO_COMPU_METHOD 0 3.402823e+38 ECU_ADDRESS_EXTENSION 0x80 /end CHARACTERISTIC
/begin CHARACTERISTIC CtApImageProcess_FreeRunning.PpImageProcess_FreeSpace_60ms.DeFreeSpcae.gstSVFreespaces[8].Classification_Type "" VALUE 0x38016c __UBYTE_S 0 NO_COMPU_METHOD 0 255 ECU_ADDRESS_EXTENSION 0x80 /end CHARACTERISTIC
/begin CHARACTERISTIC CtApImageProcess_FreeRunning.PpImageProcess_FreeSpace_60ms.DeFreeSpcae.gstSVFreespaces[8].fPointX "" VALUE 0x380170 __FLOAT32_IEEE_S 0 NO_COMPU_METHOD 0 3.402823e+38 ECU_ADDRESS_EXTENSION 0x80 /end CHARACTERISTIC
/begin CHARACTERISTIC CtApImageProcess_FreeRunning.PpImageProcess_FreeSpace_60ms.DeFreeSpcae.gstSVFreespaces[8].fPointY "" VALUE 0x380174 __FLOAT32_IEEE_S 0 NO_COMPU_METHOD 0 3.402823e+38 ECU_ADDRESS_EXTENSION 0x80 /end CHARACTERISTIC
/begin CHARACTERISTIC CtApImageProcess_FreeRunning.PpImageProcess_FreeSpace_60ms.DeFreeSpcae.gstSVFreespaces[8].fPointZ "" VALUE 0x380178 __FLOAT32_IEEE_S 0 NO_COMPU_METHOD 0 3.402823e+38 ECU_ADDRESS_EXTENSION 0x80 /end CHARACTERISTIC
/begin CHARACTERISTIC CtApImageProcess_FreeRunning.PpImageProcess_FreeSpace_60ms.DeFreeSpcae.gstSVFreespaces[9].stHeader.Counter "" VALUE 0x38017c __UWORD_S 0 NO_COMPU_METHOD 0 65535 ECU_ADDRESS_EXTENSION 0x80 /end CHARACTERISTIC
/begin CHARACTERISTIC CtApImageProcess_FreeRunning.PpImageProcess_FreeSpace_60ms.DeFreeSpcae.gstSVFreespaces[9].stHeader.FrameID "" VALUE 0x38017e __UBYTE_S 0 NO_COMPU_METHOD 0 255 ECU_ADDRESS_EXTENSION 0x80 /end CHARACTERISTIC
/begin CHARACTERISTIC CtApImageProcess_FreeRunning.PpImageProcess_FreeSpace_60ms.DeFreeSpcae.gstSVFreespaces[9].stHeader.TimeStamp "2 uint32 array" VAL_BLK 0x380180 __ULONG_S 0 NO_COMPU_METHOD 0 4294967295 ECU_ADDRESS_EXTENSION 0x80 MATRIX_DIM 2 1 1 /end CHARACTERISTIC
/begin CHARACTERISTIC CtApImageProcess_FreeRunning.PpImageProcess_FreeSpace_60ms.DeFreeSpcae.gstSVFreespaces[9].Is_Valid "" VALUE 0x380188 __UBYTE_S 0 NO_COMPU_METHOD 0 255 ECU_ADDRESS_EXTENSION 0x80 /end CHARACTERISTIC
/begin CHARACTERISTIC CtApImageProcess_FreeRunning.PpImageProcess_FreeSpace_60ms.DeFreeSpcae.gstSVFreespaces[9].Existence_Prob "" VALUE 0x38018c __FLOAT32_IEEE_S 0 NO_COMPU_METHOD 0 3.402823e+38 ECU_ADDRESS_EXTENSION 0x80 /end CHARACTERISTIC
/begin CHARACTERISTIC CtApImageProcess_FreeRunning.PpImageProcess_FreeSpace_60ms.DeFreeSpcae.gstSVFreespaces[9].Classification_Conf "" VALUE 0x380190 __FLOAT32_IEEE_S 0 NO_COMPU_METHOD 0 3.402823e+38 ECU_ADDRESS_EXTENSION 0x80 /end CHARACTERISTIC
/begin CHARACTERISTIC CtApImageProcess_FreeRunning.PpImageProcess_FreeSpace_60ms.DeFreeSpcae.gstSVFreespaces[9].Classification_Type "" VALUE 0x380194 __UBYTE_S 0 NO_COMPU_METHOD 0 255 ECU_ADDRESS_EXTENSION 0x80 /end CHARACTERISTIC
/begin CHARACTERISTIC CtApImageProcess_FreeRunning.PpImageProcess_FreeSpace_60ms.DeFreeSpcae.gstSVFreespaces[9].fPointX "" VALUE 0x380198 __FLOAT32_IEEE_S 0 NO_COMPU_METHOD 0 3.402823e+38 ECU_ADDRESS_EXTENSION 0x80 /end CHARACTERISTIC
/begin CHARACTERISTIC CtApImageProcess_FreeRunning.PpImageProcess_FreeSpace_60ms.DeFreeSpcae.gstSVFreespaces[9].fPointY "" VALUE 0x38019c __FLOAT32_IEEE_S 0 NO_COMPU_METHOD 0 3.402823e+38 ECU_ADDRESS_EXTENSION 0x80 /end CHARACTERISTIC
/begin CHARACTERISTIC CtApImageProcess_FreeRunning.PpImageProcess_FreeSpace_60ms.DeFreeSpcae.gstSVFreespaces[9].fPointZ "" VALUE 0x3801a0 __FLOAT32_IEEE_S 0 NO_COMPU_METHOD 0 3.402823e+38 ECU_ADDRESS_EXTENSION 0x80 /end CHARACTERISTIC
/begin CHARACTERISTIC CtApImageProcess_FreeRunning.PpImageProcess_FreeSpace_60ms.DeFreeSpcae.gstSVFreespaces[10].stHeader.Counter "" VALUE 0x3801a4 __UWORD_S 0 NO_COMPU_METHOD 0 65535 ECU_ADDRESS_EXTENSION 0x80 /end CHARACTERISTIC
/begin CHARACTERISTIC CtApImageProcess_FreeRunning.PpImageProcess_FreeSpace_60ms.DeFreeSpcae.gstSVFreespaces[10].stHeader.FrameID "" VALUE 0x3801a6 __UBYTE_S 0 NO_COMPU_METHOD 0 255 ECU_ADDRESS_EXTENSION 0x80 /end CHARACTERISTIC
/begin CHARACTERISTIC CtApImageProcess_FreeRunning.PpImageProcess_FreeSpace_60ms.DeFreeSpcae.gstSVFreespaces[10].stHeader.TimeStamp "2 uint32 array" VAL_BLK 0x3801a8 __ULONG_S 0 NO_COMPU_METHOD 0 4294967295 ECU_ADDRESS_EXTENSION 0x80 MATRIX_DIM 2 1 1 /end CHARACTERISTIC
/begin CHARACTERISTIC CtApImageProcess_FreeRunning.PpImageProcess_FreeSpace_60ms.DeFreeSpcae.gstSVFreespaces[10].Is_Valid "" VALUE 0x3801b0 __UBYTE_S 0 NO_COMPU_METHOD 0 255 ECU_ADDRESS_EXTENSION 0x80 /end CHARACTERISTIC
/begin CHARACTERISTIC CtApImageProcess_FreeRunning.PpImageProcess_FreeSpace_60ms.DeFreeSpcae.gstSVFreespaces[10].Existence_Prob "" VALUE 0x3801b4 __FLOAT32_IEEE_S 0 NO_COMPU_METHOD 0 3.402823e+38 ECU_ADDRESS_EXTENSION 0x80 /end CHARACTERISTIC
/begin CHARACTERISTIC CtApImageProcess_FreeRunning.PpImageProcess_FreeSpace_60ms.DeFreeSpcae.gstSVFreespaces[10].Classification_Conf "" VALUE 0x3801b8 __FLOAT32_IEEE_S 0 NO_COMPU_METHOD 0 3.402823e+38 ECU_ADDRESS_EXTENSION 0x80 /end CHARACTERISTIC
/begin CHARACTERISTIC CtApImageProcess_FreeRunning.PpImageProcess_FreeSpace_60ms.DeFreeSpcae.gstSVFreespaces[10].Classification_Type "" VALUE 0x3801bc __UBYTE_S 0 NO_COMPU_METHOD 0 255 ECU_ADDRESS_EXTENSION 0x80 /end CHARACTERISTIC
/begin CHARACTERISTIC CtApImageProcess_FreeRunning.PpImageProcess_FreeSpace_60ms.DeFreeSpcae.gstSVFreespaces[10].fPointX "" VALUE 0x3801c0 __FLOAT32_IEEE_S 0 NO_COMPU_METHOD 0 3.402823e+38 ECU_ADDRESS_EXTENSION 0x80 /end CHARACTERISTIC
/begin CHARACTERISTIC CtApImageProcess_FreeRunning.PpImageProcess_FreeSpace_60ms.DeFreeSpcae.gstSVFreespaces[10].fPointY "" VALUE 0x3801c4 __FLOAT32_IEEE_S 0 NO_COMPU_METHOD 0 3.402823e+38 ECU_ADDRESS_EXTENSION 0x80 /end CHARACTERISTIC
/begin CHARACTERISTIC CtApImageProcess_FreeRunning.PpImageProcess_FreeSpace_60ms.DeFreeSpcae.gstSVFreespaces[10].fPointZ "" VALUE 0x3801c8 __FLOAT32_IEEE_S 0 NO_COMPU_METHOD 0 3.402823e+38 ECU_ADDRESS_EXTENSION 0x80 /end CHARACTERISTIC
/begin CHARACTERISTIC CtApImageProcess_FreeRunning.PpImageProcess_FreeSpace_60ms.DeFreeSpcae.gstSVFreespaces[11].stHeader.Counter "" VALUE 0x3801cc __UWORD_S 0 NO_COMPU_METHOD 0 65535 ECU_ADDRESS_EXTENSION 0x80 /end CHARACTERISTIC
/begin CHARACTERISTIC CtApImageProcess_FreeRunning.PpImageProcess_FreeSpace_60ms.DeFreeSpcae.gstSVFreespaces[11].stHeader.FrameID "" VALUE 0x3801ce __UBYTE_S 0 NO_COMPU_METHOD 0 255 ECU_ADDRESS_EXTENSION 0x80 /end CHARACTERISTIC
/begin CHARACTERISTIC CtApImageProcess_FreeRunning.PpImageProcess_FreeSpace_60ms.DeFreeSpcae.gstSVFreespaces[11].stHeader.TimeStamp "2 uint32 array" VAL_BLK 0x3801d0 __ULONG_S 0 NO_COMPU_METHOD 0 4294967295 ECU_ADDRESS_EXTENSION 0x80 MATRIX_DIM 2 1 1 /end CHARACTERISTIC
/begin CHARACTERISTIC CtApImageProcess_FreeRunning.PpImageProcess_FreeSpace_60ms.DeFreeSpcae.gstSVFreespaces[11].Is_Valid "" VALUE 0x3801d8 __UBYTE_S 0 NO_COMPU_METHOD 0 255 ECU_ADDRESS_EXTENSION 0x80 /end CHARACTERISTIC
/begin CHARACTERISTIC CtApImageProcess_FreeRunning.PpImageProcess_FreeSpace_60ms.DeFreeSpcae.gstSVFreespaces[11].Existence_Prob "" VALUE 0x3801dc __FLOAT32_IEEE_S 0 NO_COMPU_METHOD 0 3.402823e+38 ECU_ADDRESS_EXTENSION 0x80 /end CHARACTERISTIC
/begin CHARACTERISTIC CtApImageProcess_FreeRunning.PpImageProcess_FreeSpace_60ms.DeFreeSpcae.gstSVFreespaces[11].Classification_Conf "" VALUE 0x3801e0 __FLOAT32_IEEE_S 0 NO_COMPU_METHOD 0 3.402823e+38 ECU_ADDRESS_EXTENSION 0x80 /end CHARACTERISTIC
/begin CHARACTERISTIC CtApImageProcess_FreeRunning.PpImageProcess_FreeSpace_60ms.DeFreeSpcae.gstSVFreespaces[11].Classification_Type "" VALUE 0x3801e4 __UBYTE_S 0 NO_COMPU_METHOD 0 255 ECU_ADDRESS_EXTENSION 0x80 /end CHARACTERISTIC
/begin CHARACTERISTIC CtApImageProcess_FreeRunning.PpImageProcess_FreeSpace_60ms.DeFreeSpcae.gstSVFreespaces[11].fPointX "" VALUE 0x3801e8 __FLOAT32_IEEE_S 0 NO_COMPU_METHOD 0 3.402823e+38 ECU_ADDRESS_EXTENSION 0x80 /end CHARACTERISTIC
/begin CHARACTERISTIC CtApImageProcess_FreeRunning.PpImageProcess_FreeSpace_60ms.DeFreeSpcae.gstSVFreespaces[11].fPointY "" VALUE 0x3801ec __FLOAT32_IEEE_S 0 NO_COMPU_METHOD 0 3.402823e+38 ECU_ADDRESS_EXTENSION 0x80 /end CHARACTERISTIC
/begin CHARACTERISTIC CtApImageProcess_FreeRunning.PpImageProcess_FreeSpace_60ms.DeFreeSpcae.gstSVFreespaces[11].fPointZ "" VALUE 0x3801f0 __FLOAT32_IEEE_S 0 NO_COMPU_METHOD 0 3.402823e+38 ECU_ADDRESS_EXTENSION 0x80 /end CHARACTERISTIC
/begin CHARACTERISTIC CtApImageProcess_FreeRunning.PpImageProcess_FreeSpace_60ms.DeFreeSpcae.gstSVFreespaces[12].stHeader.Counter "" VALUE 0x3801f4 __UWORD_S 0 NO_COMPU_METHOD 0 65535 ECU_ADDRESS_EXTENSION 0x80 /end CHARACTERISTIC
/begin CHARACTERISTIC CtApImageProcess_FreeRunning.PpImageProcess_FreeSpace_60ms.DeFreeSpcae.gstSVFreespaces[12].stHeader.FrameID "" VALUE 0x3801f6 __UBYTE_S 0 NO_COMPU_METHOD 0 255 ECU_ADDRESS_EXTENSION 0x80 /end CHARACTERISTIC
/begin CHARACTERISTIC CtApImageProcess_FreeRunning.PpImageProcess_FreeSpace_60ms.DeFreeSpcae.gstSVFreespaces[12].stHeader.TimeStamp "2 uint32 array" VAL_BLK 0x3801f8 __ULONG_S 0 NO_COMPU_METHOD 0 4294967295 ECU_ADDRESS_EXTENSION 0x80 MATRIX_DIM 2 1 1 /end CHARACTERISTIC
/begin CHARACTERISTIC CtApImageProcess_FreeRunning.PpImageProcess_FreeSpace_60ms.DeFreeSpcae.gstSVFreespaces[12].Is_Valid "" VALUE 0x380200 __UBYTE_S 0 NO_COMPU_METHOD 0 255 ECU_ADDRESS_EXTENSION 0x80 /end CHARACTERISTIC
/begin CHARACTERISTIC CtApImageProcess_FreeRunning.PpImageProcess_FreeSpace_60ms.DeFreeSpcae.gstSVFreespaces[12].Existence_Prob "" VALUE 0x380204 __FLOAT32_IEEE_S 0 NO_COMPU_METHOD 0 3.402823e+38 ECU_ADDRESS_EXTENSION 0x80 /end CHARACTERISTIC
/begin CHARACTERISTIC CtApImageProcess_FreeRunning.PpImageProcess_FreeSpace_60ms.DeFreeSpcae.gstSVFreespaces[12].Classification_Conf "" VALUE 0x380208 __FLOAT32_IEEE_S 0 NO_COMPU_METHOD 0 3.402823e+38 ECU_ADDRESS_EXTENSION 0x80 /end CHARACTERISTIC
/begin CHARACTERISTIC CtApImageProcess_FreeRunning.PpImageProcess_FreeSpace_60ms.DeFreeSpcae.gstSVFreespaces[12].Classification_Type "" VALUE 0x38020c __UBYTE_S 0 NO_COMPU_METHOD 0 255 ECU_ADDRESS_EXTENSION 0x80 /end CHARACTERISTIC
/begin CHARACTERISTIC CtApImageProcess_FreeRunning.PpImageProcess_FreeSpace_60ms.DeFreeSpcae.gstSVFreespaces[12].fPointX "" VALUE 0x380210 __FLOAT32_IEEE_S 0 NO_COMPU_METHOD 0 3.402823e+38 ECU_ADDRESS_EXTENSION 0x80 /end CHARACTERISTIC
/begin CHARACTERISTIC CtApImageProcess_FreeRunning.PpImageProcess_FreeSpace_60ms.DeFreeSpcae.gstSVFreespaces[12].fPointY "" VALUE 0x380214 __FLOAT32_IEEE_S 0 NO_COMPU_METHOD 0 3.402823e+38 ECU_ADDRESS_EXTENSION 0x80 /end CHARACTERISTIC
/begin CHARACTERISTIC CtApImageProcess_FreeRunning.PpImageProcess_FreeSpace_60ms.DeFreeSpcae.gstSVFreespaces[12].fPointZ "" VALUE 0x380218 __FLOAT32_IEEE_S 0 NO_COMPU_METHOD 0 3.402823e+38 ECU_ADDRESS_EXTENSION 0x80 /end CHARACTERISTIC
/begin CHARACTERISTIC CtApImageProcess_FreeRunning.PpImageProcess_FreeSpace_60ms.DeFreeSpcae.gstSVFreespaces[13].stHeader.Counter "" VALUE 0x38021c __UWORD_S 0 NO_COMPU_METHOD 0 65535 ECU_ADDRESS_EXTENSION 0x80 /end CHARACTERISTIC
/begin CHARACTERISTIC CtApImageProcess_FreeRunning.PpImageProcess_FreeSpace_60ms.DeFreeSpcae.gstSVFreespaces[13].stHeader.FrameID "" VALUE 0x38021e __UBYTE_S 0 NO_COMPU_METHOD 0 255 ECU_ADDRESS_EXTENSION 0x80 /end CHARACTERISTIC
/begin CHARACTERISTIC CtApImageProcess_FreeRunning.PpImageProcess_FreeSpace_60ms.DeFreeSpcae.gstSVFreespaces[13].stHeader.TimeStamp "2 uint32 array" VAL_BLK 0x380220 __ULONG_S 0 NO_COMPU_METHOD 0 4294967295 ECU_ADDRESS_EXTENSION 0x80 MATRIX_DIM 2 1 1 /end CHARACTERISTIC
/begin CHARACTERISTIC CtApImageProcess_FreeRunning.PpImageProcess_FreeSpace_60ms.DeFreeSpcae.gstSVFreespaces[13].Is_Valid "" VALUE 0x380228 __UBYTE_S 0 NO_COMPU_METHOD 0 255 ECU_ADDRESS_EXTENSION 0x80 /end CHARACTERISTIC
/begin CHARACTERISTIC CtApImageProcess_FreeRunning.PpImageProcess_FreeSpace_60ms.DeFreeSpcae.gstSVFreespaces[13].Existence_Prob "" VALUE 0x38022c __FLOAT32_IEEE_S 0 NO_COMPU_METHOD 0 3.402823e+38 ECU_ADDRESS_EXTENSION 0x80 /end CHARACTERISTIC
/begin CHARACTERISTIC CtApImageProcess_FreeRunning.PpImageProcess_FreeSpace_60ms.DeFreeSpcae.gstSVFreespaces[13].Classification_Conf "" VALUE 0x380230 __FLOAT32_IEEE_S 0 NO_COMPU_METHOD 0 3.402823e+38 ECU_ADDRESS_EXTENSION 0x80 /end CHARACTERISTIC
/begin CHARACTERISTIC CtApImageProcess_FreeRunning.PpImageProcess_FreeSpace_60ms.DeFreeSpcae.gstSVFreespaces[13].Classification_Type "" VALUE 0x380234 __UBYTE_S 0 NO_COMPU_METHOD 0 255 ECU_ADDRESS_EXTENSION 0x80 /end CHARACTERISTIC
/begin CHARACTERISTIC CtApImageProcess_FreeRunning.PpImageProcess_FreeSpace_60ms.DeFreeSpcae.gstSVFreespaces[13].fPointX "" VALUE 0x380238 __FLOAT32_IEEE_S 0 NO_COMPU_METHOD 0 3.402823e+38 ECU_ADDRESS_EXTENSION 0x80 /end CHARACTERISTIC
/begin CHARACTERISTIC CtApImageProcess_FreeRunning.PpImageProcess_FreeSpace_60ms.DeFreeSpcae.gstSVFreespaces[13].fPointY "" VALUE 0x38023c __FLOAT32_IEEE_S 0 NO_COMPU_METHOD 0 3.402823e+38 ECU_ADDRESS_EXTENSION 0x80 /end CHARACTERISTIC
/begin CHARACTERISTIC CtApImageProcess_FreeRunning.PpImageProcess_FreeSpace_60ms.DeFreeSpcae.gstSVFreespaces[13].fPointZ "" VALUE 0x380240 __FLOAT32_IEEE_S 0 NO_COMPU_METHOD 0 3.402823e+38 ECU_ADDRESS_EXTENSION 0x80 /end CHARACTERISTIC
/begin CHARACTERISTIC CtApImageProcess_FreeRunning.PpImageProcess_FreeSpace_60ms.DeFreeSpcae.gstSVFreespaces[14].stHeader.Counter "" VALUE 0x380244 __UWORD_S 0 NO_COMPU_METHOD 0 65535 ECU_ADDRESS_EXTENSION 0x80 /end CHARACTERISTIC
/begin CHARACTERISTIC CtApImageProcess_FreeRunning.PpImageProcess_FreeSpace_60ms.DeFreeSpcae.gstSVFreespaces[14].stHeader.FrameID "" VALUE 0x380246 __UBYTE_S 0 NO_COMPU_METHOD 0 255 ECU_ADDRESS_EXTENSION 0x80 /end CHARACTERISTIC
/begin CHARACTERISTIC CtApImageProcess_FreeRunning.PpImageProcess_FreeSpace_60ms.DeFreeSpcae.gstSVFreespaces[14].stHeader.TimeStamp "2 uint32 array" VAL_BLK 0x380248 __ULONG_S 0 NO_COMPU_METHOD 0 4294967295 ECU_ADDRESS_EXTENSION 0x80 MATRIX_DIM 2 1 1 /end CHARACTERISTIC
/begin CHARACTERISTIC CtApImageProcess_FreeRunning.PpImageProcess_FreeSpace_60ms.DeFreeSpcae.gstSVFreespaces[14].Is_Valid "" VALUE 0x380250 __UBYTE_S 0 NO_COMPU_METHOD 0 255 ECU_ADDRESS_EXTENSION 0x80 /end CHARACTERISTIC
/begin CHARACTERISTIC CtApImageProcess_FreeRunning.PpImageProcess_FreeSpace_60ms.DeFreeSpcae.gstSVFreespaces[14].Existence_Prob "" VALUE 0x380254 __FLOAT32_IEEE_S 0 NO_COMPU_METHOD 0 3.402823e+38 ECU_ADDRESS_EXTENSION 0x80 /end CHARACTERISTIC
/begin CHARACTERISTIC CtApImageProcess_FreeRunning.PpImageProcess_FreeSpace_60ms.DeFreeSpcae.gstSVFreespaces[14].Classification_Conf "" VALUE 0x380258 __FLOAT32_IEEE_S 0 NO_COMPU_METHOD 0 3.402823e+38 ECU_ADDRESS_EXTENSION 0x80 /end CHARACTERISTIC
/begin CHARACTERISTIC CtApImageProcess_FreeRunning.PpImageProcess_FreeSpace_60ms.DeFreeSpcae.gstSVFreespaces[14].Classification_Type "" VALUE 0x38025c __UBYTE_S 0 NO_COMPU_METHOD 0 255 ECU_ADDRESS_EXTENSION 0x80 /end CHARACTERISTIC
/begin CHARACTERISTIC CtApImageProcess_FreeRunning.PpImageProcess_FreeSpace_60ms.DeFreeSpcae.gstSVFreespaces[14].fPointX "" VALUE 0x380260 __FLOAT32_IEEE_S 0 NO_COMPU_METHOD 0 3.402823e+38 ECU_ADDRESS_EXTENSION 0x80 /end CHARACTERISTIC
/begin CHARACTERISTIC CtApImageProcess_FreeRunning.PpImageProcess_FreeSpace_60ms.DeFreeSpcae.gstSVFreespaces[14].fPointY "" VALUE 0x380264 __FLOAT32_IEEE_S 0 NO_COMPU_METHOD 0 3.402823e+38 ECU_ADDRESS_EXTENSION 0x80 /end CHARACTERISTIC
/begin CHARACTERISTIC CtApImageProcess_FreeRunning.PpImageProcess_FreeSpace_60ms.DeFreeSpcae.gstSVFreespaces[14].fPointZ "" VALUE 0x380268 __FLOAT32_IEEE_S 0 NO_COMPU_METHOD 0 3.402823e+38 ECU_ADDRESS_EXTENSION 0x80 /end CHARACTERISTIC
/begin CHARACTERISTIC CtApImageProcess_FreeRunning.PpImageProcess_FreeSpace_60ms.DeFreeSpcae.gstSVFreespaces[15].stHeader.Counter "" VALUE 0x38026c __UWORD_S 0 NO_COMPU_METHOD 0 65535 ECU_ADDRESS_EXTENSION 0x80 /end CHARACTERISTIC
/begin CHARACTERISTIC CtApImageProcess_FreeRunning.PpImageProcess_FreeSpace_60ms.DeFreeSpcae.gstSVFreespaces[15].stHeader.FrameID "" VALUE 0x38026e __UBYTE_S 0 NO_COMPU_METHOD 0 255 ECU_ADDRESS_EXTENSION 0x80 /end CHARACTERISTIC
/begin CHARACTERISTIC CtApImageProcess_FreeRunning.PpImageProcess_FreeSpace_60ms.DeFreeSpcae.gstSVFreespaces[15].stHeader.TimeStamp "2 uint32 array" VAL_BLK 0x380270 __ULONG_S 0 NO_COMPU_METHOD 0 4294967295 ECU_ADDRESS_EXTENSION 0x80 MATRIX_DIM 2 1 1 /end CHARACTERISTIC
/begin CHARACTERISTIC CtApImageProcess_FreeRunning.PpImageProcess_FreeSpace_60ms.DeFreeSpcae.gstSVFreespaces[15].Is_Valid "" VALUE 0x380278 __UBYTE_S 0 NO_COMPU_METHOD 0 255 ECU_ADDRESS_EXTENSION 0x80 /end CHARACTERISTIC
/begin CHARACTERISTIC CtApImageProcess_FreeRunning.PpImageProcess_FreeSpace_60ms.DeFreeSpcae.gstSVFreespaces[15].Existence_Prob "" VALUE 0x38027c __FLOAT32_IEEE_S 0 NO_COMPU_METHOD 0 3.402823e+38 ECU_ADDRESS_EXTENSION 0x80 /end CHARACTERISTIC
/begin CHARACTERISTIC CtApImageProcess_FreeRunning.PpImageProcess_FreeSpace_60ms.DeFreeSpcae.gstSVFreespaces[15].Classification_Conf "" VALUE 0x380280 __FLOAT32_IEEE_S 0 NO_COMPU_METHOD 0 3.402823e+38 ECU_ADDRESS_EXTENSION 0x80 /end CHARACTERISTIC
/begin CHARACTERISTIC CtApImageProcess_FreeRunning.PpImageProcess_FreeSpace_60ms.DeFreeSpcae.gstSVFreespaces[15].Classification_Type "" VALUE 0x380284 __UBYTE_S 0 NO_COMPU_METHOD 0 255 ECU_ADDRESS_EXTENSION 0x80 /end CHARACTERISTIC
/begin CHARACTERISTIC CtApImageProcess_FreeRunning.PpImageProcess_FreeSpace_60ms.DeFreeSpcae.gstSVFreespaces[15].fPointX "" VALUE 0x380288 __FLOAT32_IEEE_S 0 NO_COMPU_METHOD 0 3.402823e+38 ECU_ADDRESS_EXTENSION 0x80 /end CHARACTERISTIC
/begin CHARACTERISTIC CtApImageProcess_FreeRunning.PpImageProcess_FreeSpace_60ms.DeFreeSpcae.gstSVFreespaces[15].fPointY "" VALUE 0x38028c __FLOAT32_IEEE_S 0 NO_COMPU_METHOD 0 3.402823e+38 ECU_ADDRESS_EXTENSION 0x80 /end CHARACTERISTIC
/begin CHARACTERISTIC CtApImageProcess_FreeRunning.PpImageProcess_FreeSpace_60ms.DeFreeSpcae.gstSVFreespaces[15].fPointZ "" VALUE 0x380290 __FLOAT32_IEEE_S 0 NO_COMPU_METHOD 0 3.402823e+38 ECU_ADDRESS_EXTENSION 0x80 /end CHARACTERISTIC
/begin CHARACTERISTIC CtApImageProcess_FreeRunning.PpImageProcess_FreeSpace_60ms.DeFreeSpcae.gstSVFreespaces[16].stHeader.Counter "" VALUE 0x380294 __UWORD_S 0 NO_COMPU_METHOD 0 65535 ECU_ADDRESS_EXTENSION 0x80 /end CHARACTERISTIC
/begin CHARACTERISTIC CtApImageProcess_FreeRunning.PpImageProcess_FreeSpace_60ms.DeFreeSpcae.gstSVFreespaces[16].stHeader.FrameID "" VALUE 0x380296 __UBYTE_S 0 NO_COMPU_METHOD 0 255 ECU_ADDRESS_EXTENSION 0x80 /end CHARACTERISTIC
/begin CHARACTERISTIC CtApImageProcess_FreeRunning.PpImageProcess_FreeSpace_60ms.DeFreeSpcae.gstSVFreespaces[16].stHeader.TimeStamp "2 uint32 array" VAL_BLK 0x380298 __ULONG_S 0 NO_COMPU_METHOD 0 4294967295 ECU_ADDRESS_EXTENSION 0x80 MATRIX_DIM 2 1 1 /end CHARACTERISTIC
/begin CHARACTERISTIC CtApImageProcess_FreeRunning.PpImageProcess_FreeSpace_60ms.DeFreeSpcae.gstSVFreespaces[16].Is_Valid "" VALUE 0x3802a0 __UBYTE_S 0 NO_COMPU_METHOD 0 255 ECU_ADDRESS_EXTENSION 0x80 /end CHARACTERISTIC
/begin CHARACTERISTIC CtApImageProcess_FreeRunning.PpImageProcess_FreeSpace_60ms.DeFreeSpcae.gstSVFreespaces[16].Existence_Prob "" VALUE 0x3802a4 __FLOAT32_IEEE_S 0 NO_COMPU_METHOD 0 3.402823e+38 ECU_ADDRESS_EXTENSION 0x80 /end CHARACTERISTIC
/begin CHARACTERISTIC CtApImageProcess_FreeRunning.PpImageProcess_FreeSpace_60ms.DeFreeSpcae.gstSVFreespaces[16].Classification_Conf "" VALUE 0x3802a8 __FLOAT32_IEEE_S 0 NO_COMPU_METHOD 0 3.402823e+38 ECU_ADDRESS_EXTENSION 0x80 /end CHARACTERISTIC
/begin CHARACTERISTIC CtApImageProcess_FreeRunning.PpImageProcess_FreeSpace_60ms.DeFreeSpcae.gstSVFreespaces[16].Classification_Type "" VALUE 0x3802ac __UBYTE_S 0 NO_COMPU_METHOD 0 255 ECU_ADDRESS_EXTENSION 0x80 /end CHARACTERISTIC
/begin CHARACTERISTIC CtApImageProcess_FreeRunning.PpImageProcess_FreeSpace_60ms.DeFreeSpcae.gstSVFreespaces[16].fPointX "" VALUE 0x3802b0 __FLOAT32_IEEE_S 0 NO_COMPU_METHOD 0 3.402823e+38 ECU_ADDRESS_EXTENSION 0x80 /end CHARACTERISTIC
/begin CHARACTERISTIC CtApImageProcess_FreeRunning.PpImageProcess_FreeSpace_60ms.DeFreeSpcae.gstSVFreespaces[16].fPointY "" VALUE 0x3802b4 __FLOAT32_IEEE_S 0 NO_COMPU_METHOD 0 3.402823e+38 ECU_ADDRESS_EXTENSION 0x80 /end CHARACTERISTIC
/begin CHARACTERISTIC CtApImageProcess_FreeRunning.PpImageProcess_FreeSpace_60ms.DeFreeSpcae.gstSVFreespaces[16].fPointZ "" VALUE 0x3802b8 __FLOAT32_IEEE_S 0 NO_COMPU_METHOD 0 3.402823e+38 ECU_ADDRESS_EXTENSION 0x80 /end CHARACTERISTIC
/begin CHARACTERISTIC CtApImageProcess_FreeRunning.PpImageProcess_FreeSpace_60ms.DeFreeSpcae.gstSVFreespaces[17].stHeader.Counter "" VALUE 0x3802bc __UWORD_S 0 NO_COMPU_METHOD 0 65535 ECU_ADDRESS_EXTENSION 0x80 /end CHARACTERISTIC
/begin CHARACTERISTIC CtApImageProcess_FreeRunning.PpImageProcess_FreeSpace_60ms.DeFreeSpcae.gstSVFreespaces[17].stHeader.FrameID "" VALUE 0x3802be __UBYTE_S 0 NO_COMPU_METHOD 0 255 ECU_ADDRESS_EXTENSION 0x80 /end CHARACTERISTIC
/begin CHARACTERISTIC CtApImageProcess_FreeRunning.PpImageProcess_FreeSpace_60ms.DeFreeSpcae.gstSVFreespaces[17].stHeader.TimeStamp "2 uint32 array" VAL_BLK 0x3802c0 __ULONG_S 0 NO_COMPU_METHOD 0 4294967295 ECU_ADDRESS_EXTENSION 0x80 MATRIX_DIM 2 1 1 /end CHARACTERISTIC
/begin CHARACTERISTIC CtApImageProcess_FreeRunning.PpImageProcess_FreeSpace_60ms.DeFreeSpcae.gstSVFreespaces[17].Is_Valid "" VALUE 0x3802c8 __UBYTE_S 0 NO_COMPU_METHOD 0 255 ECU_ADDRESS_EXTENSION 0x80 /end CHARACTERISTIC
/begin CHARACTERISTIC CtApImageProcess_FreeRunning.PpImageProcess_FreeSpace_60ms.DeFreeSpcae.gstSVFreespaces[17].Existence_Prob "" VALUE 0x3802cc __FLOAT32_IEEE_S 0 NO_COMPU_METHOD 0 3.402823e+38 ECU_ADDRESS_EXTENSION 0x80 /end CHARACTERISTIC
/begin CHARACTERISTIC CtApImageProcess_FreeRunning.PpImageProcess_FreeSpace_60ms.DeFreeSpcae.gstSVFreespaces[17].Classification_Conf "" VALUE 0x3802d0 __FLOAT32_IEEE_S 0 NO_COMPU_METHOD 0 3.402823e+38 ECU_ADDRESS_EXTENSION 0x80 /end CHARACTERISTIC
/begin CHARACTERISTIC CtApImageProcess_FreeRunning.PpImageProcess_FreeSpace_60ms.DeFreeSpcae.gstSVFreespaces[17].Classification_Type "" VALUE 0x3802d4 __UBYTE_S 0 NO_COMPU_METHOD 0 255 ECU_ADDRESS_EXTENSION 0x80 /end CHARACTERISTIC
/begin CHARACTERISTIC CtApImageProcess_FreeRunning.PpImageProcess_FreeSpace_60ms.DeFreeSpcae.gstSVFreespaces[17].fPointX "" VALUE 0x3802d8 __FLOAT32_IEEE_S 0 NO_COMPU_METHOD 0 3.402823e+38 ECU_ADDRESS_EXTENSION 0x80 /end CHARACTERISTIC
/begin CHARACTERISTIC CtApImageProcess_FreeRunning.PpImageProcess_FreeSpace_60ms.DeFreeSpcae.gstSVFreespaces[17].fPointY "" VALUE 0x3802dc __FLOAT32_IEEE_S 0 NO_COMPU_METHOD 0 3.402823e+38 ECU_ADDRESS_EXTENSION 0x80 /end CHARACTERISTIC
/begin CHARACTERISTIC CtApImageProcess_FreeRunning.PpImageProcess_FreeSpace_60ms.DeFreeSpcae.gstSVFreespaces[17].fPointZ "" VALUE 0x3802e0 __FLOAT32_IEEE_S 0 NO_COMPU_METHOD 0 3.402823e+38 ECU_ADDRESS_EXTENSION 0x80 /end CHARACTERISTIC
/begin CHARACTERISTIC CtApImageProcess_FreeRunning.PpImageProcess_FreeSpace_60ms.DeFreeSpcae.gstSVFreespaces[18].stHeader.Counter "" VALUE 0x3802e4 __UWORD_S 0 NO_COMPU_METHOD 0 65535 ECU_ADDRESS_EXTENSION 0x80 /end CHARACTERISTIC
/begin CHARACTERISTIC CtApImageProcess_FreeRunning.PpImageProcess_FreeSpace_60ms.DeFreeSpcae.gstSVFreespaces[18].stHeader.FrameID "" VALUE 0x3802e6 __UBYTE_S 0 NO_COMPU_METHOD 0 255 ECU_ADDRESS_EXTENSION 0x80 /end CHARACTERISTIC
/begin CHARACTERISTIC CtApImageProcess_FreeRunning.PpImageProcess_FreeSpace_60ms.DeFreeSpcae.gstSVFreespaces[18].stHeader.TimeStamp "2 uint32 array" VAL_BLK 0x3802e8 __ULONG_S 0 NO_COMPU_METHOD 0 4294967295 ECU_ADDRESS_EXTENSION 0x80 MATRIX_DIM 2 1 1 /end CHARACTERISTIC
/begin CHARACTERISTIC CtApImageProcess_FreeRunning.PpImageProcess_FreeSpace_60ms.DeFreeSpcae.gstSVFreespaces[18].Is_Valid "" VALUE 0x3802f0 __UBYTE_S 0 NO_COMPU_METHOD 0 255 ECU_ADDRESS_EXTENSION 0x80 /end CHARACTERISTIC
/begin CHARACTERISTIC CtApImageProcess_FreeRunning.PpImageProcess_FreeSpace_60ms.DeFreeSpcae.gstSVFreespaces[18].Existence_Prob "" VALUE 0x3802f4 __FLOAT32_IEEE_S 0 NO_COMPU_METHOD 0 3.402823e+38 ECU_ADDRESS_EXTENSION 0x80 /end CHARACTERISTIC
/begin CHARACTERISTIC CtApImageProcess_FreeRunning.PpImageProcess_FreeSpace_60ms.DeFreeSpcae.gstSVFreespaces[18].Classification_Conf "" VALUE 0x3802f8 __FLOAT32_IEEE_S 0 NO_COMPU_METHOD 0 3.402823e+38 ECU_ADDRESS_EXTENSION 0x80 /end CHARACTERISTIC
/begin CHARACTERISTIC CtApImageProcess_FreeRunning.PpImageProcess_FreeSpace_60ms.DeFreeSpcae.gstSVFreespaces[18].Classification_Type "" VALUE 0x3802fc __UBYTE_S 0 NO_COMPU_METHOD 0 255 ECU_ADDRESS_EXTENSION 0x80 /end CHARACTERISTIC
/begin CHARACTERISTIC CtApImageProcess_FreeRunning.PpImageProcess_FreeSpace_60ms.DeFreeSpcae.gstSVFreespaces[18].fPointX "" VALUE 0x380300 __FLOAT32_IEEE_S 0 NO_COMPU_METHOD 0 3.402823e+38 ECU_ADDRESS_EXTENSION 0x80 /end CHARACTERISTIC
/begin CHARACTERISTIC CtApImageProcess_FreeRunning.PpImageProcess_FreeSpace_60ms.DeFreeSpcae.gstSVFreespaces[18].fPointY "" VALUE 0x380304 __FLOAT32_IEEE_S 0 NO_COMPU_METHOD 0 3.402823e+38 ECU_ADDRESS_EXTENSION 0x80 /end CHARACTERISTIC
/begin CHARACTERISTIC CtApImageProcess_FreeRunning.PpImageProcess_FreeSpace_60ms.DeFreeSpcae.gstSVFreespaces[18].fPointZ "" VALUE 0x380308 __FLOAT32_IEEE_S 0 NO_COMPU_METHOD 0 3.402823e+38 ECU_ADDRESS_EXTENSION 0x80 /end CHARACTERISTIC
/begin CHARACTERISTIC CtApImageProcess_FreeRunning.PpImageProcess_FreeSpace_60ms.DeFreeSpcae.gstSVFreespaces[19].stHeader.Counter "" VALUE 0x38030c __UWORD_S 0 NO_COMPU_METHOD 0 65535 ECU_ADDRESS_EXTENSION 0x80 /end CHARACTERISTIC
/begin CHARACTERISTIC CtApImageProcess_FreeRunning.PpImageProcess_FreeSpace_60ms.DeFreeSpcae.gstSVFreespaces[19].stHeader.FrameID "" VALUE 0x38030e __UBYTE_S 0 NO_COMPU_METHOD 0 255 ECU_ADDRESS_EXTENSION 0x80 /end CHARACTERISTIC
/begin CHARACTERISTIC CtApImageProcess_FreeRunning.PpImageProcess_FreeSpace_60ms.DeFreeSpcae.gstSVFreespaces[19].stHeader.TimeStamp "2 uint32 array" VAL_BLK 0x380310 __ULONG_S 0 NO_COMPU_METHOD 0 4294967295 ECU_ADDRESS_EXTENSION 0x80 MATRIX_DIM 2 1 1 /end CHARACTERISTIC
/begin CHARACTERISTIC CtApImageProcess_FreeRunning.PpImageProcess_FreeSpace_60ms.DeFreeSpcae.gstSVFreespaces[19].Is_Valid "" VALUE 0x380318 __UBYTE_S 0 NO_COMPU_METHOD 0 255 ECU_ADDRESS_EXTENSION 0x80 /end CHARACTERISTIC
/begin CHARACTERISTIC CtApImageProcess_FreeRunning.PpImageProcess_FreeSpace_60ms.DeFreeSpcae.gstSVFreespaces[19].Existence_Prob "" VALUE 0x38031c __FLOAT32_IEEE_S 0 NO_COMPU_METHOD 0 3.402823e+38 ECU_ADDRESS_EXTENSION 0x80 /end CHARACTERISTIC
/begin CHARACTERISTIC CtApImageProcess_FreeRunning.PpImageProcess_FreeSpace_60ms.DeFreeSpcae.gstSVFreespaces[19].Classification_Conf "" VALUE 0x380320 __FLOAT32_IEEE_S 0 NO_COMPU_METHOD 0 3.402823e+38 ECU_ADDRESS_EXTENSION 0x80 /end CHARACTERISTIC
/begin CHARACTERISTIC CtApImageProcess_FreeRunning.PpImageProcess_FreeSpace_60ms.DeFreeSpcae.gstSVFreespaces[19].Classification_Type "" VALUE 0x380324 __UBYTE_S 0 NO_COMPU_METHOD 0 255 ECU_ADDRESS_EXTENSION 0x80 /end CHARACTERISTIC
/begin CHARACTERISTIC CtApImageProcess_FreeRunning.PpImageProcess_FreeSpace_60ms.DeFreeSpcae.gstSVFreespaces[19].fPointX "" VALUE 0x380328 __FLOAT32_IEEE_S 0 NO_COMPU_METHOD 0 3.402823e+38 ECU_ADDRESS_EXTENSION 0x80 /end CHARACTERISTIC
/begin CHARACTERISTIC CtApImageProcess_FreeRunning.PpImageProcess_FreeSpace_60ms.DeFreeSpcae.gstSVFreespaces[19].fPointY "" VALUE 0x38032c __FLOAT32_IEEE_S 0 NO_COMPU_METHOD 0 3.402823e+38 ECU_ADDRESS_EXTENSION 0x80 /end CHARACTERISTIC
/begin CHARACTERISTIC CtApImageProcess_FreeRunning.PpImageProcess_FreeSpace_60ms.DeFreeSpcae.gstSVFreespaces[19].fPointZ "" VALUE 0x380330 __FLOAT32_IEEE_S 0 NO_COMPU_METHOD 0 3.402823e+38 ECU_ADDRESS_EXTENSION 0x80 /end CHARACTERISTIC
/begin CHARACTERISTIC CtApImageProcess_FreeRunning.PpImageProcess_FreeSpace_60ms.DeFreeSpcae.gstSVFreespaces[20].stHeader.Counter "" VALUE 0x380334 __UWORD_S 0 NO_COMPU_METHOD 0 65535 ECU_ADDRESS_EXTENSION 0x80 /end CHARACTERISTIC
/begin CHARACTERISTIC CtApImageProcess_FreeRunning.PpImageProcess_FreeSpace_60ms.DeFreeSpcae.gstSVFreespaces[20].stHeader.FrameID "" VALUE 0x380336 __UBYTE_S 0 NO_COMPU_METHOD 0 255 ECU_ADDRESS_EXTENSION 0x80 /end CHARACTERISTIC
/begin CHARACTERISTIC CtApImageProcess_FreeRunning.PpImageProcess_FreeSpace_60ms.DeFreeSpcae.gstSVFreespaces[20].stHeader.TimeStamp "2 uint32 array" VAL_BLK 0x380338 __ULONG_S 0 NO_COMPU_METHOD 0 4294967295 ECU_ADDRESS_EXTENSION 0x80 MATRIX_DIM 2 1 1 /end CHARACTERISTIC
/begin CHARACTERISTIC CtApImageProcess_FreeRunning.PpImageProcess_FreeSpace_60ms.DeFreeSpcae.gstSVFreespaces[20].Is_Valid "" VALUE 0x380340 __UBYTE_S 0 NO_COMPU_METHOD 0 255 ECU_ADDRESS_EXTENSION 0x80 /end CHARACTERISTIC
/begin CHARACTERISTIC CtApImageProcess_FreeRunning.PpImageProcess_FreeSpace_60ms.DeFreeSpcae.gstSVFreespaces[20].Existence_Prob "" VALUE 0x380344 __FLOAT32_IEEE_S 0 NO_COMPU_METHOD 0 3.402823e+38 ECU_ADDRESS_EXTENSION 0x80 /end CHARACTERISTIC
/begin CHARACTERISTIC CtApImageProcess_FreeRunning.PpImageProcess_FreeSpace_60ms.DeFreeSpcae.gstSVFreespaces[20].Classification_Conf "" VALUE 0x380348 __FLOAT32_IEEE_S 0 NO_COMPU_METHOD 0 3.402823e+38 ECU_ADDRESS_EXTENSION 0x80 /end CHARACTERISTIC
/begin CHARACTERISTIC CtApImageProcess_FreeRunning.PpImageProcess_FreeSpace_60ms.DeFreeSpcae.gstSVFreespaces[20].Classification_Type "" VALUE 0x38034c __UBYTE_S 0 NO_COMPU_METHOD 0 255 ECU_ADDRESS_EXTENSION 0x80 /end CHARACTERISTIC
/begin CHARACTERISTIC CtApImageProcess_FreeRunning.PpImageProcess_FreeSpace_60ms.DeFreeSpcae.gstSVFreespaces[20].fPointX "" VALUE 0x380350 __FLOAT32_IEEE_S 0 NO_COMPU_METHOD 0 3.402823e+38 ECU_ADDRESS_EXTENSION 0x80 /end CHARACTERISTIC
/begin CHARACTERISTIC CtApImageProcess_FreeRunning.PpImageProcess_FreeSpace_60ms.DeFreeSpcae.gstSVFreespaces[20].fPointY "" VALUE 0x380354 __FLOAT32_IEEE_S 0 NO_COMPU_METHOD 0 3.402823e+38 ECU_ADDRESS_EXTENSION 0x80 /end CHARACTERISTIC
/begin CHARACTERISTIC CtApImageProcess_FreeRunning.PpImageProcess_FreeSpace_60ms.DeFreeSpcae.gstSVFreespaces[20].fPointZ "" VALUE 0x380358 __FLOAT32_IEEE_S 0 NO_COMPU_METHOD 0 3.402823e+38 ECU_ADDRESS_EXTENSION 0x80 /end CHARACTERISTIC
/begin CHARACTERISTIC CtApImageProcess_FreeRunning.PpImageProcess_FreeSpace_60ms.DeFreeSpcae.gstSVFreespaces[21].stHeader.Counter "" VALUE 0x38035c __UWORD_S 0 NO_COMPU_METHOD 0 65535 ECU_ADDRESS_EXTENSION 0x80 /end CHARACTERISTIC
/begin CHARACTERISTIC CtApImageProcess_FreeRunning.PpImageProcess_FreeSpace_60ms.DeFreeSpcae.gstSVFreespaces[21].stHeader.FrameID "" VALUE 0x38035e __UBYTE_S 0 NO_COMPU_METHOD 0 255 ECU_ADDRESS_EXTENSION 0x80 /end CHARACTERISTIC
/begin CHARACTERISTIC CtApImageProcess_FreeRunning.PpImageProcess_FreeSpace_60ms.DeFreeSpcae.gstSVFreespaces[21].stHeader.TimeStamp "2 uint32 array" VAL_BLK 0x380360 __ULONG_S 0 NO_COMPU_METHOD 0 4294967295 ECU_ADDRESS_EXTENSION 0x80 MATRIX_DIM 2 1 1 /end CHARACTERISTIC
/begin CHARACTERISTIC CtApImageProcess_FreeRunning.PpImageProcess_FreeSpace_60ms.DeFreeSpcae.gstSVFreespaces[21].Is_Valid "" VALUE 0x380368 __UBYTE_S 0 NO_COMPU_METHOD 0 255 ECU_ADDRESS_EXTENSION 0x80 /end CHARACTERISTIC
/begin CHARACTERISTIC CtApImageProcess_FreeRunning.PpImageProcess_FreeSpace_60ms.DeFreeSpcae.gstSVFreespaces[21].Existence_Prob "" VALUE 0x38036c __FLOAT32_IEEE_S 0 NO_COMPU_METHOD 0 3.402823e+38 ECU_ADDRESS_EXTENSION 0x80 /end CHARACTERISTIC
/begin CHARACTERISTIC CtApImageProcess_FreeRunning.PpImageProcess_FreeSpace_60ms.DeFreeSpcae.gstSVFreespaces[21].Classification_Conf "" VALUE 0x380370 __FLOAT32_IEEE_S 0 NO_COMPU_METHOD 0 3.402823e+38 ECU_ADDRESS_EXTENSION 0x80 /end CHARACTERISTIC
/begin CHARACTERISTIC CtApImageProcess_FreeRunning.PpImageProcess_FreeSpace_60ms.DeFreeSpcae.gstSVFreespaces[21].Classification_Type "" VALUE 0x380374 __UBYTE_S 0 NO_COMPU_METHOD 0 255 ECU_ADDRESS_EXTENSION 0x80 /end CHARACTERISTIC
/begin CHARACTERISTIC CtApImageProcess_FreeRunning.PpImageProcess_FreeSpace_60ms.DeFreeSpcae.gstSVFreespaces[21].fPointX "" VALUE 0x380378 __FLOAT32_IEEE_S 0 NO_COMPU_METHOD 0 3.402823e+38 ECU_ADDRESS_EXTENSION 0x80 /end CHARACTERISTIC
/begin CHARACTERISTIC CtApImageProcess_FreeRunning.PpImageProcess_FreeSpace_60ms.DeFreeSpcae.gstSVFreespaces[21].fPointY "" VALUE 0x38037c __FLOAT32_IEEE_S 0 NO_COMPU_METHOD 0 3.402823e+38 ECU_ADDRESS_EXTENSION 0x80 /end CHARACTERISTIC
/begin CHARACTERISTIC CtApImageProcess_FreeRunning.PpImageProcess_FreeSpace_60ms.DeFreeSpcae.gstSVFreespaces[21].fPointZ "" VALUE 0x380380 __FLOAT32_IEEE_S 0 NO_COMPU_METHOD 0 3.402823e+38 ECU_ADDRESS_EXTENSION 0x80 /end CHARACTERISTIC
/begin CHARACTERISTIC CtApImageProcess_FreeRunning.PpImageProcess_FreeSpace_60ms.DeFreeSpcae.gstSVFreespaces[22].stHeader.Counter "" VALUE 0x380384 __UWORD_S 0 NO_COMPU_METHOD 0 65535 ECU_ADDRESS_EXTENSION 0x80 /end CHARACTERISTIC
/begin CHARACTERISTIC CtApImageProcess_FreeRunning.PpImageProcess_FreeSpace_60ms.DeFreeSpcae.gstSVFreespaces[22].stHeader.FrameID "" VALUE 0x380386 __UBYTE_S 0 NO_COMPU_METHOD 0 255 ECU_ADDRESS_EXTENSION 0x80 /end CHARACTERISTIC
/begin CHARACTERISTIC CtApImageProcess_FreeRunning.PpImageProcess_FreeSpace_60ms.DeFreeSpcae.gstSVFreespaces[22].stHeader.TimeStamp "2 uint32 array" VAL_BLK 0x380388 __ULONG_S 0 NO_COMPU_METHOD 0 4294967295 ECU_ADDRESS_EXTENSION 0x80 MATRIX_DIM 2 1 1 /end CHARACTERISTIC
/begin CHARACTERISTIC CtApImageProcess_FreeRunning.PpImageProcess_FreeSpace_60ms.DeFreeSpcae.gstSVFreespaces[22].Is_Valid "" VALUE 0x380390 __UBYTE_S 0 NO_COMPU_METHOD 0 255 ECU_ADDRESS_EXTENSION 0x80 /end CHARACTERISTIC
/begin CHARACTERISTIC CtApImageProcess_FreeRunning.PpImageProcess_FreeSpace_60ms.DeFreeSpcae.gstSVFreespaces[22].Existence_Prob "" VALUE 0x380394 __FLOAT32_IEEE_S 0 NO_COMPU_METHOD 0 3.402823e+38 ECU_ADDRESS_EXTENSION 0x80 /end CHARACTERISTIC
/begin CHARACTERISTIC CtApImageProcess_FreeRunning.PpImageProcess_FreeSpace_60ms.DeFreeSpcae.gstSVFreespaces[22].Classification_Conf "" VALUE 0x380398 __FLOAT32_IEEE_S 0 NO_COMPU_METHOD 0 3.402823e+38 ECU_ADDRESS_EXTENSION 0x80 /end CHARACTERISTIC
/begin CHARACTERISTIC CtApImageProcess_FreeRunning.PpImageProcess_FreeSpace_60ms.DeFreeSpcae.gstSVFreespaces[22].Classification_Type "" VALUE 0x38039c __UBYTE_S 0 NO_COMPU_METHOD 0 255 ECU_ADDRESS_EXTENSION 0x80 /end CHARACTERISTIC
/begin CHARACTERISTIC CtApImageProcess_FreeRunning.PpImageProcess_FreeSpace_60ms.DeFreeSpcae.gstSVFreespaces[22].fPointX "" VALUE 0x3803a0 __FLOAT32_IEEE_S 0 NO_COMPU_METHOD 0 3.402823e+38 ECU_ADDRESS_EXTENSION 0x80 /end CHARACTERISTIC
/begin CHARACTERISTIC CtApImageProcess_FreeRunning.PpImageProcess_FreeSpace_60ms.DeFreeSpcae.gstSVFreespaces[22].fPointY "" VALUE 0x3803a4 __FLOAT32_IEEE_S 0 NO_COMPU_METHOD 0 3.402823e+38 ECU_ADDRESS_EXTENSION 0x80 /end CHARACTERISTIC
/begin CHARACTERISTIC CtApImageProcess_FreeRunning.PpImageProcess_FreeSpace_60ms.DeFreeSpcae.gstSVFreespaces[22].fPointZ "" VALUE 0x3803a8 __FLOAT32_IEEE_S 0 NO_COMPU_METHOD 0 3.402823e+38 ECU_ADDRESS_EXTENSION 0x80 /end CHARACTERISTIC
/begin CHARACTERISTIC CtApImageProcess_FreeRunning.PpImageProcess_FreeSpace_60ms.DeFreeSpcae.gstSVFreespaces[23].stHeader.Counter "" VALUE 0x3803ac __UWORD_S 0 NO_COMPU_METHOD 0 65535 ECU_ADDRESS_EXTENSION 0x80 /end CHARACTERISTIC
/begin CHARACTERISTIC CtApImageProcess_FreeRunning.PpImageProcess_FreeSpace_60ms.DeFreeSpcae.gstSVFreespaces[23].stHeader.FrameID "" VALUE 0x3803ae __UBYTE_S 0 NO_COMPU_METHOD 0 255 ECU_ADDRESS_EXTENSION 0x80 /end CHARACTERISTIC
/begin CHARACTERISTIC CtApImageProcess_FreeRunning.PpImageProcess_FreeSpace_60ms.DeFreeSpcae.gstSVFreespaces[23].stHeader.TimeStamp "2 uint32 array" VAL_BLK 0x3803b0 __ULONG_S 0 NO_COMPU_METHOD 0 4294967295 ECU_ADDRESS_EXTENSION 0x80 MATRIX_DIM 2 1 1 /end CHARACTERISTIC
/begin CHARACTERISTIC CtApImageProcess_FreeRunning.PpImageProcess_FreeSpace_60ms.DeFreeSpcae.gstSVFreespaces[23].Is_Valid "" VALUE 0x3803b8 __UBYTE_S 0 NO_COMPU_METHOD 0 255 ECU_ADDRESS_EXTENSION 0x80 /end CHARACTERISTIC
/begin CHARACTERISTIC CtApImageProcess_FreeRunning.PpImageProcess_FreeSpace_60ms.DeFreeSpcae.gstSVFreespaces[23].Existence_Prob "" VALUE 0x3803bc __FLOAT32_IEEE_S 0 NO_COMPU_METHOD 0 3.402823e+38 ECU_ADDRESS_EXTENSION 0x80 /end CHARACTERISTIC
/begin CHARACTERISTIC CtApImageProcess_FreeRunning.PpImageProcess_FreeSpace_60ms.DeFreeSpcae.gstSVFreespaces[23].Classification_Conf "" VALUE 0x3803c0 __FLOAT32_IEEE_S 0 NO_COMPU_METHOD 0 3.402823e+38 ECU_ADDRESS_EXTENSION 0x80 /end CHARACTERISTIC
/begin CHARACTERISTIC CtApImageProcess_FreeRunning.PpImageProcess_FreeSpace_60ms.DeFreeSpcae.gstSVFreespaces[23].Classification_Type "" VALUE 0x3803c4 __UBYTE_S 0 NO_COMPU_METHOD 0 255 ECU_ADDRESS_EXTENSION 0x80 /end CHARACTERISTIC
/begin CHARACTERISTIC CtApImageProcess_FreeRunning.PpImageProcess_FreeSpace_60ms.DeFreeSpcae.gstSVFreespaces[23].fPointX "" VALUE 0x3803c8 __FLOAT32_IEEE_S 0 NO_COMPU_METHOD 0 3.402823e+38 ECU_ADDRESS_EXTENSION 0x80 /end CHARACTERISTIC
/begin CHARACTERISTIC CtApImageProcess_FreeRunning.PpImageProcess_FreeSpace_60ms.DeFreeSpcae.gstSVFreespaces[23].fPointY "" VALUE 0x3803cc __FLOAT32_IEEE_S 0 NO_COMPU_METHOD 0 3.402823e+38 ECU_ADDRESS_EXTENSION 0x80 /end CHARACTERISTIC
/begin CHARACTERISTIC CtApImageProcess_FreeRunning.PpImageProcess_FreeSpace_60ms.DeFreeSpcae.gstSVFreespaces[23].fPointZ "" VALUE 0x3803d0 __FLOAT32_IEEE_S 0 NO_COMPU_METHOD 0 3.402823e+38 ECU_ADDRESS_EXTENSION 0x80 /end CHARACTERISTIC
/begin CHARACTERISTIC CtApImageProcess_FreeRunning.PpImageProcess_FreeSpace_60ms.DeFreeSpcae.gstSVFreespaces[24].stHeader.Counter "" VALUE 0x3803d4 __UWORD_S 0 NO_COMPU_METHOD 0 65535 ECU_ADDRESS_EXTENSION 0x80 /end CHARACTERISTIC
/begin CHARACTERISTIC CtApImageProcess_FreeRunning.PpImageProcess_FreeSpace_60ms.DeFreeSpcae.gstSVFreespaces[24].stHeader.FrameID "" VALUE 0x3803d6 __UBYTE_S 0 NO_COMPU_METHOD 0 255 ECU_ADDRESS_EXTENSION 0x80 /end CHARACTERISTIC
/begin CHARACTERISTIC CtApImageProcess_FreeRunning.PpImageProcess_FreeSpace_60ms.DeFreeSpcae.gstSVFreespaces[24].stHeader.TimeStamp "2 uint32 array" VAL_BLK 0x3803d8 __ULONG_S 0 NO_COMPU_METHOD 0 4294967295 ECU_ADDRESS_EXTENSION 0x80 MATRIX_DIM 2 1 1 /end CHARACTERISTIC
/begin CHARACTERISTIC CtApImageProcess_FreeRunning.PpImageProcess_FreeSpace_60ms.DeFreeSpcae.gstSVFreespaces[24].Is_Valid "" VALUE 0x3803e0 __UBYTE_S 0 NO_COMPU_METHOD 0 255 ECU_ADDRESS_EXTENSION 0x80 /end CHARACTERISTIC
/begin CHARACTERISTIC CtApImageProcess_FreeRunning.PpImageProcess_FreeSpace_60ms.DeFreeSpcae.gstSVFreespaces[24].Existence_Prob "" VALUE 0x3803e4 __FLOAT32_IEEE_S 0 NO_COMPU_METHOD 0 3.402823e+38 ECU_ADDRESS_EXTENSION 0x80 /end CHARACTERISTIC
/begin CHARACTERISTIC CtApImageProcess_FreeRunning.PpImageProcess_FreeSpace_60ms.DeFreeSpcae.gstSVFreespaces[24].Classification_Conf "" VALUE 0x3803e8 __FLOAT32_IEEE_S 0 NO_COMPU_METHOD 0 3.402823e+38 ECU_ADDRESS_EXTENSION 0x80 /end CHARACTERISTIC
/begin CHARACTERISTIC CtApImageProcess_FreeRunning.PpImageProcess_FreeSpace_60ms.DeFreeSpcae.gstSVFreespaces[24].Classification_Type "" VALUE 0x3803ec __UBYTE_S 0 NO_COMPU_METHOD 0 255 ECU_ADDRESS_EXTENSION 0x80 /end CHARACTERISTIC
/begin CHARACTERISTIC CtApImageProcess_FreeRunning.PpImageProcess_FreeSpace_60ms.DeFreeSpcae.gstSVFreespaces[24].fPointX "" VALUE 0x3803f0 __FLOAT32_IEEE_S 0 NO_COMPU_METHOD 0 3.402823e+38 ECU_ADDRESS_EXTENSION 0x80 /end CHARACTERISTIC
/begin CHARACTERISTIC CtApImageProcess_FreeRunning.PpImageProcess_FreeSpace_60ms.DeFreeSpcae.gstSVFreespaces[24].fPointY "" VALUE 0x3803f4 __FLOAT32_IEEE_S 0 NO_COMPU_METHOD 0 3.402823e+38 ECU_ADDRESS_EXTENSION 0x80 /end CHARACTERISTIC
/begin CHARACTERISTIC CtApImageProcess_FreeRunning.PpImageProcess_FreeSpace_60ms.DeFreeSpcae.gstSVFreespaces[24].fPointZ "" VALUE 0x3803f8 __FLOAT32_IEEE_S 0 NO_COMPU_METHOD 0 3.402823e+38 ECU_ADDRESS_EXTENSION 0x80 /end CHARACTERISTIC
/begin CHARACTERISTIC CtApImageProcess_FreeRunning.PpImageProcess_FreeSpace_60ms.DeFreeSpcae.gstSVFreespaces[25].stHeader.Counter "" VALUE 0x3803fc __UWORD_S 0 NO_COMPU_METHOD 0 65535 ECU_ADDRESS_EXTENSION 0x80 /end CHARACTERISTIC
/begin CHARACTERISTIC CtApImageProcess_FreeRunning.PpImageProcess_FreeSpace_60ms.DeFreeSpcae.gstSVFreespaces[25].stHeader.FrameID "" VALUE 0x3803fe __UBYTE_S 0 NO_COMPU_METHOD 0 255 ECU_ADDRESS_EXTENSION 0x80 /end CHARACTERISTIC
/begin CHARACTERISTIC CtApImageProcess_FreeRunning.PpImageProcess_FreeSpace_60ms.DeFreeSpcae.gstSVFreespaces[25].stHeader.TimeStamp "2 uint32 array" VAL_BLK 0x380400 __ULONG_S 0 NO_COMPU_METHOD 0 4294967295 ECU_ADDRESS_EXTENSION 0x80 MATRIX_DIM 2 1 1 /end CHARACTERISTIC
/begin CHARACTERISTIC CtApImageProcess_FreeRunning.PpImageProcess_FreeSpace_60ms.DeFreeSpcae.gstSVFreespaces[25].Is_Valid "" VALUE 0x380408 __UBYTE_S 0 NO_COMPU_METHOD 0 255 ECU_ADDRESS_EXTENSION 0x80 /end CHARACTERISTIC
/begin CHARACTERISTIC CtApImageProcess_FreeRunning.PpImageProcess_FreeSpace_60ms.DeFreeSpcae.gstSVFreespaces[25].Existence_Prob "" VALUE 0x38040c __FLOAT32_IEEE_S 0 NO_COMPU_METHOD 0 3.402823e+38 ECU_ADDRESS_EXTENSION 0x80 /end CHARACTERISTIC
/begin CHARACTERISTIC CtApImageProcess_FreeRunning.PpImageProcess_FreeSpace_60ms.DeFreeSpcae.gstSVFreespaces[25].Classification_Conf "" VALUE 0x380410 __FLOAT32_IEEE_S 0 NO_COMPU_METHOD 0 3.402823e+38 ECU_ADDRESS_EXTENSION 0x80 /end CHARACTERISTIC
/begin CHARACTERISTIC CtApImageProcess_FreeRunning.PpImageProcess_FreeSpace_60ms.DeFreeSpcae.gstSVFreespaces[25].Classification_Type "" VALUE 0x380414 __UBYTE_S 0 NO_COMPU_METHOD 0 255 ECU_ADDRESS_EXTENSION 0x80 /end CHARACTERISTIC
/begin CHARACTERISTIC CtApImageProcess_FreeRunning.PpImageProcess_FreeSpace_60ms.DeFreeSpcae.gstSVFreespaces[25].fPointX "" VALUE 0x380418 __FLOAT32_IEEE_S 0 NO_COMPU_METHOD 0 3.402823e+38 ECU_ADDRESS_EXTENSION 0x80 /end CHARACTERISTIC
/begin CHARACTERISTIC CtApImageProcess_FreeRunning.PpImageProcess_FreeSpace_60ms.DeFreeSpcae.gstSVFreespaces[25].fPointY "" VALUE 0x38041c __FLOAT32_IEEE_S 0 NO_COMPU_METHOD 0 3.402823e+38 ECU_ADDRESS_EXTENSION 0x80 /end CHARACTERISTIC
/begin CHARACTERISTIC CtApImageProcess_FreeRunning.PpImageProcess_FreeSpace_60ms.DeFreeSpcae.gstSVFreespaces[25].fPointZ "" VALUE 0x380420 __FLOAT32_IEEE_S 0 NO_COMPU_METHOD 0 3.402823e+38 ECU_ADDRESS_EXTENSION 0x80 /end CHARACTERISTIC
/begin CHARACTERISTIC CtApImageProcess_FreeRunning.PpImageProcess_FreeSpace_60ms.DeFreeSpcae.gstSVFreespaces[26].stHeader.Counter "" VALUE 0x380424 __UWORD_S 0 NO_COMPU_METHOD 0 65535 ECU_ADDRESS_EXTENSION 0x80 /end CHARACTERISTIC
/begin CHARACTERISTIC CtApImageProcess_FreeRunning.PpImageProcess_FreeSpace_60ms.DeFreeSpcae.gstSVFreespaces[26].stHeader.FrameID "" VALUE 0x380426 __UBYTE_S 0 NO_COMPU_METHOD 0 255 ECU_ADDRESS_EXTENSION 0x80 /end CHARACTERISTIC
/begin CHARACTERISTIC CtApImageProcess_FreeRunning.PpImageProcess_FreeSpace_60ms.DeFreeSpcae.gstSVFreespaces[26].stHeader.TimeStamp "2 uint32 array" VAL_BLK 0x380428 __ULONG_S 0 NO_COMPU_METHOD 0 4294967295 ECU_ADDRESS_EXTENSION 0x80 MATRIX_DIM 2 1 1 /end CHARACTERISTIC
/begin CHARACTERISTIC CtApImageProcess_FreeRunning.PpImageProcess_FreeSpace_60ms.DeFreeSpcae.gstSVFreespaces[26].Is_Valid "" VALUE 0x380430 __UBYTE_S 0 NO_COMPU_METHOD 0 255 ECU_ADDRESS_EXTENSION 0x80 /end CHARACTERISTIC
/begin CHARACTERISTIC CtApImageProcess_FreeRunning.PpImageProcess_FreeSpace_60ms.DeFreeSpcae.gstSVFreespaces[26].Existence_Prob "" VALUE 0x380434 __FLOAT32_IEEE_S 0 NO_COMPU_METHOD 0 3.402823e+38 ECU_ADDRESS_EXTENSION 0x80 /end CHARACTERISTIC
/begin CHARACTERISTIC CtApImageProcess_FreeRunning.PpImageProcess_FreeSpace_60ms.DeFreeSpcae.gstSVFreespaces[26].Classification_Conf "" VALUE 0x380438 __FLOAT32_IEEE_S 0 NO_COMPU_METHOD 0 3.402823e+38 ECU_ADDRESS_EXTENSION 0x80 /end CHARACTERISTIC
/begin CHARACTERISTIC CtApImageProcess_FreeRunning.PpImageProcess_FreeSpace_60ms.DeFreeSpcae.gstSVFreespaces[26].Classification_Type "" VALUE 0x38043c __UBYTE_S 0 NO_COMPU_METHOD 0 255 ECU_ADDRESS_EXTENSION 0x80 /end CHARACTERISTIC
/begin CHARACTERISTIC CtApImageProcess_FreeRunning.PpImageProcess_FreeSpace_60ms.DeFreeSpcae.gstSVFreespaces[26].fPointX "" VALUE 0x380440 __FLOAT32_IEEE_S 0 NO_COMPU_METHOD 0 3.402823e+38 ECU_ADDRESS_EXTENSION 0x80 /end CHARACTERISTIC
/begin CHARACTERISTIC CtApImageProcess_FreeRunning.PpImageProcess_FreeSpace_60ms.DeFreeSpcae.gstSVFreespaces[26].fPointY "" VALUE 0x380444 __FLOAT32_IEEE_S 0 NO_COMPU_METHOD 0 3.402823e+38 ECU_ADDRESS_EXTENSION 0x80 /end CHARACTERISTIC
/begin CHARACTERISTIC CtApImageProcess_FreeRunning.PpImageProcess_FreeSpace_60ms.DeFreeSpcae.gstSVFreespaces[26].fPointZ "" VALUE 0x380448 __FLOAT32_IEEE_S 0 NO_COMPU_METHOD 0 3.402823e+38 ECU_ADDRESS_EXTENSION 0x80 /end CHARACTERISTIC
/begin CHARACTERISTIC CtApImageProcess_FreeRunning.PpImageProcess_FreeSpace_60ms.DeFreeSpcae.gstSVFreespaces[27].stHeader.Counter "" VALUE 0x38044c __UWORD_S 0 NO_COMPU_METHOD 0 65535 ECU_ADDRESS_EXTENSION 0x80 /end CHARACTERISTIC
/begin CHARACTERISTIC CtApImageProcess_FreeRunning.PpImageProcess_FreeSpace_60ms.DeFreeSpcae.gstSVFreespaces[27].stHeader.FrameID "" VALUE 0x38044e __UBYTE_S 0 NO_COMPU_METHOD 0 255 ECU_ADDRESS_EXTENSION 0x80 /end CHARACTERISTIC
/begin CHARACTERISTIC CtApImageProcess_FreeRunning.PpImageProcess_FreeSpace_60ms.DeFreeSpcae.gstSVFreespaces[27].stHeader.TimeStamp "2 uint32 array" VAL_BLK 0x380450 __ULONG_S 0 NO_COMPU_METHOD 0 4294967295 ECU_ADDRESS_EXTENSION 0x80 MATRIX_DIM 2 1 1 /end CHARACTERISTIC
/begin CHARACTERISTIC CtApImageProcess_FreeRunning.PpImageProcess_FreeSpace_60ms.DeFreeSpcae.gstSVFreespaces[27].Is_Valid "" VALUE 0x380458 __UBYTE_S 0 NO_COMPU_METHOD 0 255 ECU_ADDRESS_EXTENSION 0x80 /end CHARACTERISTIC
/begin CHARACTERISTIC CtApImageProcess_FreeRunning.PpImageProcess_FreeSpace_60ms.DeFreeSpcae.gstSVFreespaces[27].Existence_Prob "" VALUE 0x38045c __FLOAT32_IEEE_S 0 NO_COMPU_METHOD 0 3.402823e+38 ECU_ADDRESS_EXTENSION 0x80 /end CHARACTERISTIC
/begin CHARACTERISTIC CtApImageProcess_FreeRunning.PpImageProcess_FreeSpace_60ms.DeFreeSpcae.gstSVFreespaces[27].Classification_Conf "" VALUE 0x380460 __FLOAT32_IEEE_S 0 NO_COMPU_METHOD 0 3.402823e+38 ECU_ADDRESS_EXTENSION 0x80 /end CHARACTERISTIC
/begin CHARACTERISTIC CtApImageProcess_FreeRunning.PpImageProcess_FreeSpace_60ms.DeFreeSpcae.gstSVFreespaces[27].Classification_Type "" VALUE 0x380464 __UBYTE_S 0 NO_COMPU_METHOD 0 255 ECU_ADDRESS_EXTENSION 0x80 /end CHARACTERISTIC
/begin CHARACTERISTIC CtApImageProcess_FreeRunning.PpImageProcess_FreeSpace_60ms.DeFreeSpcae.gstSVFreespaces[27].fPointX "" VALUE 0x380468 __FLOAT32_IEEE_S 0 NO_COMPU_METHOD 0 3.402823e+38 ECU_ADDRESS_EXTENSION 0x80 /end CHARACTERISTIC
/begin CHARACTERISTIC CtApImageProcess_FreeRunning.PpImageProcess_FreeSpace_60ms.DeFreeSpcae.gstSVFreespaces[27].fPointY "" VALUE 0x38046c __FLOAT32_IEEE_S 0 NO_COMPU_METHOD 0 3.402823e+38 ECU_ADDRESS_EXTENSION 0x80 /end CHARACTERISTIC
/begin CHARACTERISTIC CtApImageProcess_FreeRunning.PpImageProcess_FreeSpace_60ms.DeFreeSpcae.gstSVFreespaces[27].fPointZ "" VALUE 0x380470 __FLOAT32_IEEE_S 0 NO_COMPU_METHOD 0 3.402823e+38 ECU_ADDRESS_EXTENSION 0x80 /end CHARACTERISTIC
/begin CHARACTERISTIC CtApImageProcess_FreeRunning.PpImageProcess_FreeSpace_60ms.DeFreeSpcae.gstSVFreespaces[28].stHeader.Counter "" VALUE 0x380474 __UWORD_S 0 NO_COMPU_METHOD 0 65535 ECU_ADDRESS_EXTENSION 0x80 /end CHARACTERISTIC
/begin CHARACTERISTIC CtApImageProcess_FreeRunning.PpImageProcess_FreeSpace_60ms.DeFreeSpcae.gstSVFreespaces[28].stHeader.FrameID "" VALUE 0x380476 __UBYTE_S 0 NO_COMPU_METHOD 0 255 ECU_ADDRESS_EXTENSION 0x80 /end CHARACTERISTIC
/begin CHARACTERISTIC CtApImageProcess_FreeRunning.PpImageProcess_FreeSpace_60ms.DeFreeSpcae.gstSVFreespaces[28].stHeader.TimeStamp "2 uint32 array" VAL_BLK 0x380478 __ULONG_S 0 NO_COMPU_METHOD 0 4294967295 ECU_ADDRESS_EXTENSION 0x80 MATRIX_DIM 2 1 1 /end CHARACTERISTIC
/begin CHARACTERISTIC CtApImageProcess_FreeRunning.PpImageProcess_FreeSpace_60ms.DeFreeSpcae.gstSVFreespaces[28].Is_Valid "" VALUE 0x380480 __UBYTE_S 0 NO_COMPU_METHOD 0 255 ECU_ADDRESS_EXTENSION 0x80 /end CHARACTERISTIC
/begin CHARACTERISTIC CtApImageProcess_FreeRunning.PpImageProcess_FreeSpace_60ms.DeFreeSpcae.gstSVFreespaces[28].Existence_Prob "" VALUE 0x380484 __FLOAT32_IEEE_S 0 NO_COMPU_METHOD 0 3.402823e+38 ECU_ADDRESS_EXTENSION 0x80 /end CHARACTERISTIC
/begin CHARACTERISTIC CtApImageProcess_FreeRunning.PpImageProcess_FreeSpace_60ms.DeFreeSpcae.gstSVFreespaces[28].Classification_Conf "" VALUE 0x380488 __FLOAT32_IEEE_S 0 NO_COMPU_METHOD 0 3.402823e+38 ECU_ADDRESS_EXTENSION 0x80 /end CHARACTERISTIC
/begin CHARACTERISTIC CtApImageProcess_FreeRunning.PpImageProcess_FreeSpace_60ms.DeFreeSpcae.gstSVFreespaces[28].Classification_Type "" VALUE 0x38048c __UBYTE_S 0 NO_COMPU_METHOD 0 255 ECU_ADDRESS_EXTENSION 0x80 /end CHARACTERISTIC
/begin CHARACTERISTIC CtApImageProcess_FreeRunning.PpImageProcess_FreeSpace_60ms.DeFreeSpcae.gstSVFreespaces[28].fPointX "" VALUE 0x380490 __FLOAT32_IEEE_S 0 NO_COMPU_METHOD 0 3.402823e+38 ECU_ADDRESS_EXTENSION 0x80 /end CHARACTERISTIC
/begin CHARACTERISTIC CtApImageProcess_FreeRunning.PpImageProcess_FreeSpace_60ms.DeFreeSpcae.gstSVFreespaces[28].fPointY "" VALUE 0x380494 __FLOAT32_IEEE_S 0 NO_COMPU_METHOD 0 3.402823e+38 ECU_ADDRESS_EXTENSION 0x80 /end CHARACTERISTIC
/begin CHARACTERISTIC CtApImageProcess_FreeRunning.PpImageProcess_FreeSpace_60ms.DeFreeSpcae.gstSVFreespaces[28].fPointZ "" VALUE 0x380498 __FLOAT32_IEEE_S 0 NO_COMPU_METHOD 0 3.402823e+38 ECU_ADDRESS_EXTENSION 0x80 /end CHARACTERISTIC
/begin CHARACTERISTIC CtApImageProcess_FreeRunning.PpImageProcess_FreeSpace_60ms.DeFreeSpcae.gstSVFreespaces[29].stHeader.Counter "" VALUE 0x38049c __UWORD_S 0 NO_COMPU_METHOD 0 65535 ECU_ADDRESS_EXTENSION 0x80 /end CHARACTERISTIC
/begin CHARACTERISTIC CtApImageProcess_FreeRunning.PpImageProcess_FreeSpace_60ms.DeFreeSpcae.gstSVFreespaces[29].stHeader.FrameID "" VALUE 0x38049e __UBYTE_S 0 NO_COMPU_METHOD 0 255 ECU_ADDRESS_EXTENSION 0x80 /end CHARACTERISTIC
/begin CHARACTERISTIC CtApImageProcess_FreeRunning.PpImageProcess_FreeSpace_60ms.DeFreeSpcae.gstSVFreespaces[29].stHeader.TimeStamp "2 uint32 array" VAL_BLK 0x3804a0 __ULONG_S 0 NO_COMPU_METHOD 0 4294967295 ECU_ADDRESS_EXTENSION 0x80 MATRIX_DIM 2 1 1 /end CHARACTERISTIC
/begin CHARACTERISTIC CtApImageProcess_FreeRunning.PpImageProcess_FreeSpace_60ms.DeFreeSpcae.gstSVFreespaces[29].Is_Valid "" VALUE 0x3804a8 __UBYTE_S 0 NO_COMPU_METHOD 0 255 ECU_ADDRESS_EXTENSION 0x80 /end CHARACTERISTIC
/begin CHARACTERISTIC CtApImageProcess_FreeRunning.PpImageProcess_FreeSpace_60ms.DeFreeSpcae.gstSVFreespaces[29].Existence_Prob "" VALUE 0x3804ac __FLOAT32_IEEE_S 0 NO_COMPU_METHOD 0 3.402823e+38 ECU_ADDRESS_EXTENSION 0x80 /end CHARACTERISTIC
/begin CHARACTERISTIC CtApImageProcess_FreeRunning.PpImageProcess_FreeSpace_60ms.DeFreeSpcae.gstSVFreespaces[29].Classification_Conf "" VALUE 0x3804b0 __FLOAT32_IEEE_S 0 NO_COMPU_METHOD 0 3.402823e+38 ECU_ADDRESS_EXTENSION 0x80 /end CHARACTERISTIC
/begin CHARACTERISTIC CtApImageProcess_FreeRunning.PpImageProcess_FreeSpace_60ms.DeFreeSpcae.gstSVFreespaces[29].Classification_Type "" VALUE 0x3804b4 __UBYTE_S 0 NO_COMPU_METHOD 0 255 ECU_ADDRESS_EXTENSION 0x80 /end CHARACTERISTIC
/begin CHARACTERISTIC CtApImageProcess_FreeRunning.PpImageProcess_FreeSpace_60ms.DeFreeSpcae.gstSVFreespaces[29].fPointX "" VALUE 0x3804b8 __FLOAT32_IEEE_S 0 NO_COMPU_METHOD 0 3.402823e+38 ECU_ADDRESS_EXTENSION 0x80 /end CHARACTERISTIC
/begin CHARACTERISTIC CtApImageProcess_FreeRunning.PpImageProcess_FreeSpace_60ms.DeFreeSpcae.gstSVFreespaces[29].fPointY "" VALUE 0x3804bc __FLOAT32_IEEE_S 0 NO_COMPU_METHOD 0 3.402823e+38 ECU_ADDRESS_EXTENSION 0x80 /end CHARACTERISTIC
/begin CHARACTERISTIC CtApImageProcess_FreeRunning.PpImageProcess_FreeSpace_60ms.DeFreeSpcae.gstSVFreespaces[29].fPointZ "" VALUE 0x3804c0 __FLOAT32_IEEE_S 0 NO_COMPU_METHOD 0 3.402823e+38 ECU_ADDRESS_EXTENSION 0x80 /end CHARACTERISTIC
/begin CHARACTERISTIC CtApImageProcess_FreeRunning.PpImageProcess_FreeSpace_60ms.DeFreeSpcae.gstSVFreespaces[30].stHeader.Counter "" VALUE 0x3804c4 __UWORD_S 0 NO_COMPU_METHOD 0 65535 ECU_ADDRESS_EXTENSION 0x80 /end CHARACTERISTIC
/begin CHARACTERISTIC CtApImageProcess_FreeRunning.PpImageProcess_FreeSpace_60ms.DeFreeSpcae.gstSVFreespaces[30].stHeader.FrameID "" VALUE 0x3804c6 __UBYTE_S 0 NO_COMPU_METHOD 0 255 ECU_ADDRESS_EXTENSION 0x80 /end CHARACTERISTIC
/begin CHARACTERISTIC CtApImageProcess_FreeRunning.PpImageProcess_FreeSpace_60ms.DeFreeSpcae.gstSVFreespaces[30].stHeader.TimeStamp "2 uint32 array" VAL_BLK 0x3804c8 __ULONG_S 0 NO_COMPU_METHOD 0 4294967295 ECU_ADDRESS_EXTENSION 0x80 MATRIX_DIM 2 1 1 /end CHARACTERISTIC
/begin CHARACTERISTIC CtApImageProcess_FreeRunning.PpImageProcess_FreeSpace_60ms.DeFreeSpcae.gstSVFreespaces[30].Is_Valid "" VALUE 0x3804d0 __UBYTE_S 0 NO_COMPU_METHOD 0 255 ECU_ADDRESS_EXTENSION 0x80 /end CHARACTERISTIC
/begin CHARACTERISTIC CtApImageProcess_FreeRunning.PpImageProcess_FreeSpace_60ms.DeFreeSpcae.gstSVFreespaces[30].Existence_Prob "" VALUE 0x3804d4 __FLOAT32_IEEE_S 0 NO_COMPU_METHOD 0 3.402823e+38 ECU_ADDRESS_EXTENSION 0x80 /end CHARACTERISTIC
/begin CHARACTERISTIC CtApImageProcess_FreeRunning.PpImageProcess_FreeSpace_60ms.DeFreeSpcae.gstSVFreespaces[30].Classification_Conf "" VALUE 0x3804d8 __FLOAT32_IEEE_S 0 NO_COMPU_METHOD 0 3.402823e+38 ECU_ADDRESS_EXTENSION 0x80 /end CHARACTERISTIC
/begin CHARACTERISTIC CtApImageProcess_FreeRunning.PpImageProcess_FreeSpace_60ms.DeFreeSpcae.gstSVFreespaces[30].Classification_Type "" VALUE 0x3804dc __UBYTE_S 0 NO_COMPU_METHOD 0 255 ECU_ADDRESS_EXTENSION 0x80 /end CHARACTERISTIC
/begin CHARACTERISTIC CtApImageProcess_FreeRunning.PpImageProcess_FreeSpace_60ms.DeFreeSpcae.gstSVFreespaces[30].fPointX "" VALUE 0x3804e0 __FLOAT32_IEEE_S 0 NO_COMPU_METHOD 0 3.402823e+38 ECU_ADDRESS_EXTENSION 0x80 /end CHARACTERISTIC
/begin CHARACTERISTIC CtApImageProcess_FreeRunning.PpImageProcess_FreeSpace_60ms.DeFreeSpcae.gstSVFreespaces[30].fPointY "" VALUE 0x3804e4 __FLOAT32_IEEE_S 0 NO_COMPU_METHOD 0 3.402823e+38 ECU_ADDRESS_EXTENSION 0x80 /end CHARACTERISTIC
/begin CHARACTERISTIC CtApImageProcess_FreeRunning.PpImageProcess_FreeSpace_60ms.DeFreeSpcae.gstSVFreespaces[30].fPointZ "" VALUE 0x3804e8 __FLOAT32_IEEE_S 0 NO_COMPU_METHOD 0 3.402823e+38 ECU_ADDRESS_EXTENSION 0x80 /end CHARACTERISTIC
/begin CHARACTERISTIC CtApImageProcess_FreeRunning.PpImageProcess_FreeSpace_60ms.DeFreeSpcae.gstSVFreespaces[31].stHeader.Counter "" VALUE 0x3804ec __UWORD_S 0 NO_COMPU_METHOD 0 65535 ECU_ADDRESS_EXTENSION 0x80 /end CHARACTERISTIC
/begin COMPU_METHOD CtApImageProcess_FreeRunning.PpBdImageProcessWrite.BdSV_Normal.DeStatus.Dt_ENUM_PdDatablockStatus.CONVERSION "" TAB_VERB "%10.10" "" COMPU_TAB_REF CtApImageProcess_FreeRunning.PpBdImageProcessWrite.BdSV_Normal.DeStatus.Dt_ENUM_PdDatablockStatus /end COMPU_METHOD
/begin COMPU_VTAB CtApImageProcess_FreeRunning.PpBdImageProcessWrite.BdSV_Normal.DeStatus.Dt_ENUM_PdDatablockStatus "Conversion table for CtApImageProcess_FreeRunning.PpBdImageProcessWrite.BdSV_Normal.DeStatus.Dt_ENUM_PdDatablockStatus.CONVERSION COMPU_METHOD" TAB_VERB 5 0 "DATABLOCK_INIT" 1 "DATABLOCK_OK" 2 "DATABLOCK_NOT_OK" 3 "DATABLOCK_WRONGCRC" 4 "DATABLOCK_ERASED" /end COMPU_VTAB
/begin GROUP CtApImageProcess_FreeRunning_xcp_kvs_group "MotinWise KVS characteristic group" ROOT
 /begin REF_CHARACTERISTIC CtApImageProcess_FreeRunning.PpBdImageProcessWrite.BdSV_Normal.DeStatus CtApImageProcess_FreeRunning.PpBdImageProcessWrite.BdSV_Normal.DeVersion.DeExpectedVersion.DeMajor CtApImageProcess_FreeRunning.PpBdImageProcessWrite.BdSV_Normal.DeVersion.DeExpectedVersion.DeMinor CtApImageProcess_FreeRunning.PpBdImageProcessWrite.BdSV_Normal.DeVersion.DeVersion.DeMajor CtApImageProcess_FreeRunning.PpBdImageProcessWrite.BdSV_Normal.DeVersion.DeVersion.DeMinor CtApImageProcess_FreeRunning.PpBdImageProcessWrite.BdSV_Normal.DeData CtApImageProcess_FreeRunning.PpDiagImageProcess_FreeRunningWrite.DeMeasuredValue_ImageProcess_FreeRunning.SvCamCalFail_0xb030.Right_camera_calibration_fail CtApImageProcess_FreeRunning.PpDiagImageProcess_FreeRunningWrite.DeMeasuredValue_ImageProcess_FreeRunning.SvCamCalFail_0xb030.Reserved CtApImageProcess_FreeRunning.PpDiagImageProcess_FreeRunningWrite.DeMeasuredValue_ImageProcess_FreeRunning.SvCamCalFail_0xb030.Rear_camera_calibration_fail CtApImageProcess_FreeRunning.PpDiagImageProcess_FreeRunningWrite.DeMeasuredValue_ImageProcess_FreeRunning.SvCamCalFail_0xb030.Front_camera_calibration_fail CtApImageProcess_FreeRunning.PpDiagImageProcess_FreeRunningWrite.DeMeasuredValue_ImageProcess_FreeRunning.SvCamCalFail_0xb030.Left_camera_calibration_fail CtApImageProcess_FreeRunning.PpDiagImageProcess_FreeRunningWrite.DeMeasuredValue_ImageProcess_FreeRunning.SvCamDatafail_0xb036.Reserved CtApImageProcess_FreeRunning.PpDiagImageProcess_FreeRunningWrite.DeMeasuredValue_ImageProcess_FreeRunning.SvCamDatafail_0xb036.Front_camera_Hue_value CtApImageProcess_FreeRunning.PpDiagImageProcess_FreeRunningWrite.DeMeasuredValue_ImageProcess_FreeRunning.SvCamDatafail_0xb036.Rear_camera_Hue_value CtApImageProcess_FreeRunning.PpDiagImageProcess_FreeRunningWrite.DeMeasuredValue_ImageProcess_FreeRunning.SvCamDatafail_0xb036.Rear_camera_loss_signal CtApImageProcess_FreeRunning.PpDiagImageProcess_FreeRunningWrite.DeMeasuredValue_ImageProcess_FreeRunning.SvCamDatafail_0xb036.Left_camera_loss_signal CtApImageProcess_FreeRunning.PpDiagImageProcess_FreeRunningWrite.DeMeasuredValue_ImageProcess_FreeRunning.SvCamDatafail_0xb036.Right_camera_loss_signal CtApImageProcess_FreeRunning.PpDiagImageProcess_FreeRunningWrite.DeMeasuredValue_ImageProcess_FreeRunning.SvCamDatafail_0xb036.Left_camera_Hue_value CtApImageProcess_FreeRunning.PpDiagImageProcess_FreeRunningWrite.DeMeasuredValue_ImageProcess_FreeRunning.SvCamDatafail_0xb036.Front_camera_loss_signal CtApImageProcess_FreeRunning.PpDiagImageProcess_FreeRunningWrite.DeMeasuredValue_ImageProcess_FreeRunning.SvCamDatafail_0xb036.Right_camera_Hue_value CtApImageProcess_FreeRunning.PpDiagImageProcess_FreeRunningWrite.DeMeasuredValue_ImageProcess_FreeRunning.SvCamTemperature_0xb031.Front_camera_temperatureRange CtApImageProcess_FreeRunning.PpDiagImageProcess_FreeRunningWrite.DeMeasuredValue_ImageProcess_FreeRunning.SvCamTemperature_0xb031.Right_camera_temperatureRange CtApImageProcess_FreeRunning.PpDiagImageProcess_FreeRunningWrite.DeMeasuredValue_ImageProcess_FreeRunning.SvCamTemperature_0xb031.Left_camera_temperatureRange CtApImageProcess_FreeRunning.PpDiagImageProcess_FreeRunningWrite.DeMeasuredValue_ImageProcess_FreeRunning.SvCamTemperature_0xb031.Reserved CtApImageProcess_FreeRunning.PpDiagImageProcess_FreeRunningWrite.DeMeasuredValue_ImageProcess_FreeRunning.SvCamTemperature_0xb031.Rear_camera_temperatureRange CtApImageProcess_FreeRunning.PpDiagImageProcess_FreeRunningWrite.DeMeasuredValue_ImageProcess_FreeRunning.RearviewMirrorStatu_0xb032.Left_rearview_mirror_is_not_folding CtApImageProcess_FreeRunning.PpDiagImageProcess_FreeRunningWrite.DeMeasuredValue_ImageProcess_FreeRunning.RearviewMirrorStatu_0xb032.Reserved CtApImageProcess_FreeRunning.PpDiagImageProcess_FreeRunningWrite.DeMeasuredValue_ImageProcess_FreeRunning.RearviewMirrorStatu_0xb032.Right_rearview_mirror_is_not_folding CtApImageProcess_FreeRunning.PpDiagImageProcess_FreeRunningWrite.DeMeasuredValue_ImageProcess_FreeRunning.FrontCamFailsafe_0xb033.Low_Illumination_Scene CtApImageProcess_FreeRunning.PpDiagImageProcess_FreeRunningWrite.DeMeasuredValue_ImageProcess_FreeRunning.FrontCamFailsafe_0xb033.Reserved CtApImageProcess_FreeRunning.PpDiagImageProcess_FreeRunningWrite.DeMeasuredValue_ImageProcess_FreeRunning.FrontCamFailsafe_0xb033.CAM_LOW_FPS CtApImageProcess_FreeRunning.PpDiagImageProcess_FreeRunningWrite.DeMeasuredValue_ImageProcess_FreeRunning.FrontCamFailsafe_0xb033.Image_freeze CtApImageProcess_FreeRunning.PpDiagImageProcess_FreeRunningWrite.DeMeasuredValue_ImageProcess_FreeRunning.FrontCamFailsafe_0xb033.WET_CAMLENS CtApImageProcess_FreeRunning.PpDiagImageProcess_FreeRunningWrite.DeMeasuredValue_ImageProcess_FreeRunning.FrontCamFailsafe_0xb033.ABCOLOR_CAM CtApImageProcess_FreeRunning.PpDiagImageProcess_FreeRunningWrite.DeMeasuredValue_ImageProcess_FreeRunning.FrontCamFailsafe_0xb033.CAM_BLOCKED CtApImageProcess_FreeRunning.PpDiagImageProcess_FreeRunningWrite.DeMeasuredValue_ImageProcess_FreeRunning.FrontCamFailsafe_0xb033.DIRTY_CAMLENS CtApImageProcess_FreeRunning.PpDiagImageProcess_FreeRunningWrite.DeMeasuredValue_ImageProcess_FreeRunning.FrontCamFailsafe_0xb033.Direct_sunlight CtApImageProcess_FreeRunning.PpDiagImageProcess_FreeRunningWrite.DeMeasuredValue_ImageProcess_FreeRunning.FrontCamFailsafe_0xb033.BLUR_IMG CtApImageProcess_FreeRunning.PpDiagImageProcess_FreeRunningWrite.DeMeasuredValue_ImageProcess_FreeRunning.FrontCamFailsafe_0xb033.GROUND_REFLECT CtApImageProcess_FreeRunning.PpDiagImageProcess_FreeRunningWrite.DeMeasuredValue_ImageProcess_FreeRunning.LeftCamFailsafe_0xb034.Low_Illumination_Scene CtApImageProcess_FreeRunning.PpDiagImageProcess_FreeRunningWrite.DeMeasuredValue_ImageProcess_FreeRunning.LeftCamFailsafe_0xb034.Reserved CtApImageProcess_FreeRunning.PpDiagImageProcess_FreeRunningWrite.DeMeasuredValue_ImageProcess_FreeRunning.LeftCamFailsafe_0xb034.CAM_LOW_FPS CtApImageProcess_FreeRunning.PpDiagImageProcess_FreeRunningWrite.DeMeasuredValue_ImageProcess_FreeRunning.LeftCamFailsafe_0xb034.Image_freeze CtApImageProcess_FreeRunning.PpDiagImageProcess_FreeRunningWrite.DeMeasuredValue_ImageProcess_FreeRunning.LeftCamFailsafe_0xb034.WET_CAMLENS CtApImageProcess_FreeRunning.PpDiagImageProcess_FreeRunningWrite.DeMeasuredValue_ImageProcess_FreeRunning.LeftCamFailsafe_0xb034.ABCOLOR_CAM CtApImageProcess_FreeRunning.PpDiagImageProcess_FreeRunningWrite.DeMeasuredValue_ImageProcess_FreeRunning.LeftCamFailsafe_0xb034.CAM_BLOCKED CtApImageProcess_FreeRunning.PpDiagImageProcess_FreeRunningWrite.DeMeasuredValue_ImageProcess_FreeRunning.LeftCamFailsafe_0xb034.DIRTY_CAMLENS CtApImageProcess_FreeRunning.PpDiagImageProcess_FreeRunningWrite.DeMeasuredValue_ImageProcess_FreeRunning.LeftCamFailsafe_0xb034.Direct_sunlight CtApImageProcess_FreeRunning.PpDiagImageProcess_FreeRunningWrite.DeMeasuredValue_ImageProcess_FreeRunning.LeftCamFailsafe_0xb034.BLUR_IMG CtApImageProcess_FreeRunning.PpDiagImageProcess_FreeRunningWrite.DeMeasuredValue_ImageProcess_FreeRunning.LeftCamFailsafe_0xb034.GROUND_REFLECT CtApImageProcess_FreeRunning.PpDiagImageProcess_FreeRunningWrite.DeMeasuredValue_ImageProcess_FreeRunning.RightCamFailsafe_0xb035.Low_Illumination_Scene CtApImageProcess_FreeRunning.PpDiagImageProcess_FreeRunningWrite.DeMeasuredValue_ImageProcess_FreeRunning.RightCamFailsafe_0xb035.Reserved CtApImageProcess_FreeRunning.PpDiagImageProcess_FreeRunningWrite.DeMeasuredValue_ImageProcess_FreeRunning.RightCamFailsafe_0xb035.CAM_LOW_FPS CtApImageProcess_FreeRunning.PpDiagImageProcess_FreeRunningWrite.DeMeasuredValue_ImageProcess_FreeRunning.RightCamFailsafe_0xb035.Image_freeze CtApImageProcess_FreeRunning.PpDiagImageProcess_FreeRunningWrite.DeMeasuredValue_ImageProcess_FreeRunning.RightCamFailsafe_0xb035.WET_CAMLENS CtApImageProcess_FreeRunning.PpDiagImageProcess_FreeRunningWrite.DeMeasuredValue_ImageProcess_FreeRunning.RightCamFailsafe_0xb035.ABCOLOR_CAM CtApImageProcess_FreeRunning.PpDiagImageProcess_FreeRunningWrite.DeMeasuredValue_ImageProcess_FreeRunning.RightCamFailsafe_0xb035.CAM_BLOCKED CtApImageProcess_FreeRunning.PpDiagImageProcess_FreeRunningWrite.DeMeasuredValue_ImageProcess_FreeRunning.RightCamFailsafe_0xb035.DIRTY_CAMLENS CtApImageProcess_FreeRunning.PpDiagImageProcess_FreeRunningWrite.DeMeasuredValue_ImageProcess_FreeRunning.RightCamFailsafe_0xb035.Direct_sunlight CtApImageProcess_FreeRunning.PpDiagImageProcess_FreeRunningWrite.DeMeasuredValue_ImageProcess_FreeRunning.RightCamFailsafe_0xb035.BLUR_IMG CtApImageProcess_FreeRunning.PpDiagImageProcess_FreeRunningWrite.DeMeasuredValue_ImageProcess_FreeRunning.RightCamFailsafe_0xb035.GROUND_REFLECT CtApImageProcess_FreeRunning.PpDiagImageProcess_FreeRunningWrite.DeMeasuredValue_ImageProcess_FreeRunning.RearCamFailsafe_0xb0cf.Low_Illumination_Scene CtApImageProcess_FreeRunning.PpDiagImageProcess_FreeRunningWrite.DeMeasuredValue_ImageProcess_FreeRunning.RearCamFailsafe_0xb0cf.Reserved CtApImageProcess_FreeRunning.PpDiagImageProcess_FreeRunningWrite.DeMeasuredValue_ImageProcess_FreeRunning.RearCamFailsafe_0xb0cf.CAM_LOW_FPS CtApImageProcess_FreeRunning.PpDiagImageProcess_FreeRunningWrite.DeMeasuredValue_ImageProcess_FreeRunning.RearCamFailsafe_0xb0cf.Image_freeze CtApImageProcess_FreeRunning.PpDiagImageProcess_FreeRunningWrite.DeMeasuredValue_ImageProcess_FreeRunning.RearCamFailsafe_0xb0cf.WET_CAMLENS CtApImageProcess_FreeRunning.PpDiagImageProcess_FreeRunningWrite.DeMeasuredValue_ImageProcess_FreeRunning.RearCamFailsafe_0xb0cf.ABCOLOR_CAM CtApImageProcess_FreeRunning.PpDiagImageProcess_FreeRunningWrite.DeMeasuredValue_ImageProcess_FreeRunning.RearCamFailsafe_0xb0cf.CAM_BLOCKED CtApImageProcess_FreeRunning.PpDiagImageProcess_FreeRunningWrite.DeMeasuredValue_ImageProcess_FreeRunning.RearCamFailsafe_0xb0cf.DIRTY_CAMLENS CtApImageProcess_FreeRunning.PpDiagImageProcess_FreeRunningWrite.DeMeasuredValue_ImageProcess_FreeRunning.RearCamFailsafe_0xb0cf.Direct_sunlight CtApImageProcess_FreeRunning.PpDiagImageProcess_FreeRunningWrite.DeMeasuredValue_ImageProcess_FreeRunning.RearCamFailsafe_0xb0cf.BLUR_IMG CtApImageProcess_FreeRunning.PpDiagImageProcess_FreeRunningWrite.DeMeasuredValue_ImageProcess_FreeRunning.RearCamFailsafe_0xb0cf.GROUND_REFLECT CtApImageProcess_FreeRunning.PpDiagImageProcess_FreeRunningWrite.DeMeasuredValue_ImageProcess_FreeRunning.InputRteMsgErr_0xb0d0.CH_CAN_Speed_ERR CtApImageProcess_FreeRunning.PpDiagImageProcess_FreeRunningWrite.DeMeasuredValue_ImageProcess_FreeRunning.InputRteMsgErr_0xb0d0.Reserved CtApImageProcess_FreeRunning.PpDiagImageProcess_FreeRunningWrite.DeMeasuredValue_ImageProcess_FreeRunning.InputRteMsgErr_0xb0d0.CH_CAN_Yawrate_ERR CtApImageProcess_FreeRunning.PpDiagImageProcess_FreeRunningWrite.DeMeasuredValue_ImageProcess_FreeRunning.FunctionERR_0xb0d1.Freespace_fusion_error CtApImageProcess_FreeRunning.PpDiagImageProcess_FreeRunningWrite.DeMeasuredValue_ImageProcess_FreeRunning.FunctionERR_0xb0d1.Freespace_other_error CtApImageProcess_FreeRunning.PpDiagImageProcess_FreeRunningWrite.DeMeasuredValue_ImageProcess_FreeRunning.FunctionERR_0xb0d1.PLD_detection_error CtApImageProcess_FreeRunning.PpDiagImageProcess_FreeRunningWrite.DeMeasuredValue_ImageProcess_FreeRunning.FunctionERR_0xb0d1.AVM_fusion_error CtApImageProcess_FreeRunning.PpDiagImageProcess_FreeRunningWrite.DeMeasuredValue_ImageProcess_FreeRunning.FunctionERR_0xb0d1.AVM_other_error CtApImageProcess_FreeRunning.PpDiagImageProcess_FreeRunningWrite.DeMeasuredValue_ImageProcess_FreeRunning.FunctionERR_0xb0d1.Freespace_detection_error CtApImageProcess_FreeRunning.PpDiagImageProcess_FreeRunningWrite.DeMeasuredValue_ImageProcess_FreeRunning.FunctionERR_0xb0d1.AVM_model_run_error CtApImageProcess_FreeRunning.PpDiagImageProcess_FreeRunningWrite.DeMeasuredValue_ImageProcess_FreeRunning.FunctionERR_0xb0d1.PLD_fusion_error CtApImageProcess_FreeRunning.PpDiagImageProcess_FreeRunningWrite.DeMeasuredValue_ImageProcess_FreeRunning.FunctionERR_0xb0d1.PLD_stitching_error CtApImageProcess_FreeRunning.PpDiagImageProcess_FreeRunningWrite.DeMeasuredValue_ImageProcess_FreeRunning.FunctionERR_0xb0d1.AVM_calibration_file_error CtApImageProcess_FreeRunning.PpDiagImageProcess_FreeRunningWrite.DeMeasuredValue_ImageProcess_FreeRunning.FunctionERR_0xb0d1.Freespace_model_run_error CtApImageProcess_FreeRunning.PpDiagImageProcess_FreeRunningWrite.DeMeasuredValue_ImageProcess_FreeRunning.FunctionERR_0xb0d1.Freespace_stitching_error CtApImageProcess_FreeRunning.PpDiagImageProcess_FreeRunningWrite.DeMeasuredValue_ImageProcess_FreeRunning.FunctionERR_0xb0d1.AVM_car_color_profile_error CtApImageProcess_FreeRunning.PpDiagImageProcess_FreeRunningWrite.DeMeasuredValue_ImageProcess_FreeRunning.FunctionERR_0xb0d1.OD_fusion_error CtApImageProcess_FreeRunning.PpDiagImageProcess_FreeRunningWrite.DeMeasuredValue_ImageProcess_FreeRunning.FunctionERR_0xb0d1.AVM_car_model_error CtApImageProcess_FreeRunning.PpDiagImageProcess_FreeRunningWrite.DeMeasuredValue_ImageProcess_FreeRunning.FunctionERR_0xb0d1.AVM_stitching_error CtApImageProcess_FreeRunning.PpDiagImageProcess_FreeRunningWrite.DeMeasuredValue_ImageProcess_FreeRunning.FunctionERR_0xb0d1.Reserved CtApImageProcess_FreeRunning.PpDiagImageProcess_FreeRunningWrite.DeMeasuredValue_ImageProcess_FreeRunning.FunctionERR_0xb0d1.OD_other_error CtApImageProcess_FreeRunning.PpDiagImageProcess_FreeRunningWrite.DeMeasuredValue_ImageProcess_FreeRunning.FunctionERR_0xb0d1.OD_detection_error CtApImageProcess_FreeRunning.PpDiagImageProcess_FreeRunningWrite.DeMeasuredValue_ImageProcess_FreeRunning.FunctionERR_0xb0d1.AVM_bowl_model_error CtApImageProcess_FreeRunning.PpDiagImageProcess_FreeRunningWrite.DeMeasuredValue_ImageProcess_FreeRunning.FunctionERR_0xb0d1.PLD_model_run_error CtApImageProcess_FreeRunning.PpDiagImageProcess_FreeRunningWrite.DeMeasuredValue_ImageProcess_FreeRunning.FunctionERR_0xb0d1.AVM_mapping_file_error CtApImageProcess_FreeRunning.PpDiagImageProcess_FreeRunningWrite.DeMeasuredValue_ImageProcess_FreeRunning.FunctionERR_0xb0d1.OD_model_run_error CtApImageProcess_FreeRunning.PpDiagImageProcess_FreeRunningWrite.DeMeasuredValue_ImageProcess_FreeRunning.FunctionERR_0xb0d1.AVM_perspective_file_error CtApImageProcess_FreeRunning.PpDiagImageProcess_FreeRunningWrite.DeMeasuredValue_ImageProcess_FreeRunning.FunctionERR_0xb0d1.OD_stitching_error CtApImageProcess_FreeRunning.PpDiagImageProcess_FreeRunningWrite.DeMeasuredValue_ImageProcess_FreeRunning.FunctionERR_0xb0d1.PLD_other_error CtApImageProcess_FreeRunning.PpDiagImageProcess_FreeRunningWrite.DeMeasuredValue_ImageProcess_FreeRunning.SurroundView_System_ERR_0xb0d2.AVM_memory_leak CtApImageProcess_FreeRunning.PpDiagImageProcess_FreeRunningWrite.DeMeasuredValue_ImageProcess_FreeRunning.SurroundView_System_ERR_0xb0d2.AVM_process_error CtApImageProcess_FreeRunning.PpDiagImageProcess_FreeRunningWrite.DeMeasuredValue_ImageProcess_FreeRunning.SurroundView_System_ERR_0xb0d2.AVM_visit_uncreated_data CtApImageProcess_FreeRunning.PpDiagImageProcess_FreeRunningWrite.DeMeasuredValue_ImageProcess_FreeRunning.SurroundView_System_ERR_0xb0d2.OD_dispatch_monitor_faild CtApImageProcess_FreeRunning.PpDiagImageProcess_FreeRunningWrite.DeMeasuredValue_ImageProcess_FreeRunning.SurroundView_System_ERR_0xb0d2.AVM_heartbeat_monitor_faild CtApImageProcess_FreeRunning.PpDiagImageProcess_FreeRunningWrite.DeMeasuredValue_ImageProcess_FreeRunning.SurroundView_System_ERR_0xb0d2.camera_service_visit_uncreated_data CtApImageProcess_FreeRunning.PpDiagImageProcess_FreeRunningWrite.DeMeasuredValue_ImageProcess_FreeRunning.SurroundView_System_ERR_0xb0d2.AVM_visit_released_data CtApImageProcess_FreeRunning.PpDiagImageProcess_FreeRunningWrite.DeMeasuredValue_ImageProcess_FreeRunning.SurroundView_System_ERR_0xb0d2.Freeapce_process_error CtApImageProcess_FreeRunning.PpDiagImageProcess_FreeRunningWrite.DeMeasuredValue_ImageProcess_FreeRunning.SurroundView_System_ERR_0xb0d2.PLD_memory_leak CtApImageProcess_FreeRunning.PpDiagImageProcess_FreeRunningWrite.DeMeasuredValue_ImageProcess_FreeRunning.SurroundView_System_ERR_0xb0d2.OD_memory_leak CtApImageProcess_FreeRunning.PpDiagImageProcess_FreeRunningWrite.DeMeasuredValue_ImageProcess_FreeRunning.SurroundView_System_ERR_0xb0d2.PLD_data_visit_timeout CtApImageProcess_FreeRunning.PpDiagImageProcess_FreeRunningWrite.DeMeasuredValue_ImageProcess_FreeRunning.SurroundView_System_ERR_0xb0d2.OD_abnormal_break CtApImageProcess_FreeRunning.PpDiagImageProcess_FreeRunningWrite.DeMeasuredValue_ImageProcess_FreeRunning.SurroundView_System_ERR_0xb0d2.Abnormal_recovery_faild CtApImageProcess_FreeRunning.PpDiagImageProcess_FreeRunningWrite.DeMeasuredValue_ImageProcess_FreeRunning.SurroundView_System_ERR_0xb0d2.Shared_data_read_and_write_monitor_wrong CtApImageProcess_FreeRunning.PpDiagImageProcess_FreeRunningWrite.DeMeasuredValue_ImageProcess_FreeRunning.SurroundView_System_ERR_0xb0d2.FS_data_read_write_conflict CtApImageProcess_FreeRunning.PpDiagImageProcess_FreeRunningWrite.DeMeasuredValue_ImageProcess_FreeRunning.SurroundView_System_ERR_0xb0d2.PLD_process_error CtApImageProcess_FreeRunning.PpDiagImageProcess_FreeRunningWrite.DeMeasuredValue_ImageProcess_FreeRunning.SurroundView_System_ERR_0xb0d2.FS_visit_released_data CtApImageProcess_FreeRunning.PpDiagImageProcess_FreeRunningWrite.DeMeasuredValue_ImageProcess_FreeRunning.SurroundView_System_ERR_0xb0d2.OD_data_read_write_conflict CtApImageProcess_FreeRunning.PpDiagImageProcess_FreeRunningWrite.DeMeasuredValue_ImageProcess_FreeRunning.SurroundView_System_ERR_0xb0d2.FS_data_write_fail CtApImageProcess_FreeRunning.PpDiagImageProcess_FreeRunningWrite.DeMeasuredValue_ImageProcess_FreeRunning.SurroundView_System_ERR_0xb0d2.camera_service_process_timeout CtApImageProcess_FreeRunning.PpDiagImageProcess_FreeRunningWrite.DeMeasuredValue_ImageProcess_FreeRunning.SurroundView_System_ERR_0xb0d2.OD_process_error CtApImageProcess_FreeRunning.PpDiagImageProcess_FreeRunningWrite.DeMeasuredValue_ImageProcess_FreeRunning.SurroundView_System_ERR_0xb0d2.FS_process_timeout CtApImageProcess_FreeRunning.PpDiagImageProcess_FreeRunningWrite.DeMeasuredValue_ImageProcess_FreeRunning.SurroundView_System_ERR_0xb0d2.OD_data_write_fail CtApImageProcess_FreeRunning.PpDiagImageProcess_FreeRunningWrite.DeMeasuredValue_ImageProcess_FreeRunning.SurroundView_System_ERR_0xb0d2.camera_service_data_visit_timeout CtApImageProcess_FreeRunning.PpDiagImageProcess_FreeRunningWrite.DeMeasuredValue_ImageProcess_FreeRunning.SurroundView_System_ERR_0xb0d2.OD_visit_released_data CtApImageProcess_FreeRunning.PpDiagImageProcess_FreeRunningWrite.DeMeasuredValue_ImageProcess_FreeRunning.SurroundView_System_ERR_0xb0d2.camera_service_data_read_fail CtApImageProcess_FreeRunning.PpDiagImageProcess_FreeRunningWrite.DeMeasuredValue_ImageProcess_FreeRunning.SurroundView_System_ERR_0xb0d2.CamSer_heartbeat_monitor_faild CtApImageProcess_FreeRunning.PpDiagImageProcess_FreeRunningWrite.DeMeasuredValue_ImageProcess_FreeRunning.SurroundView_System_ERR_0xb0d2.PLD_visit_uncreated_data CtApImageProcess_FreeRunning.PpDiagImageProcess_FreeRunningWrite.DeMeasuredValue_ImageProcess_FreeRunning.SurroundView_System_ERR_0xb0d2.AVM_memory_application_fail CtApImageProcess_FreeRunning.PpDiagImageProcess_FreeRunningWrite.DeMeasuredValue_ImageProcess_FreeRunning.SurroundView_System_ERR_0xb0d2.FS_abnormal_break CtApImageProcess_FreeRunning.PpDiagImageProcess_FreeRunningWrite.DeMeasuredValue_ImageProcess_FreeRunning.SurroundView_System_ERR_0xb0d2.AVM_process_timeout CtApImageProcess_FreeRunning.PpDiagImageProcess_FreeRunningWrite.DeMeasuredValue_ImageProcess_FreeRunning.SurroundView_System_ERR_0xb0d2.OD_data_visit_timeout CtApImageProcess_FreeRunning.PpDiagImageProcess_FreeRunningWrite.DeMeasuredValue_ImageProcess_FreeRunning.SurroundView_System_ERR_0xb0d2.Freespace_dispatch_monitor_faild CtApImageProcess_FreeRunning.PpDiagImageProcess_FreeRunningWrite.DeMeasuredValue_ImageProcess_FreeRunning.SurroundView_System_ERR_0xb0d2.PLD_data_write_fail CtApImageProcess_FreeRunning.PpDiagImageProcess_FreeRunningWrite.DeMeasuredValue_ImageProcess_FreeRunning.SurroundView_System_ERR_0xb0d2.AVM_abnormal_break CtApImageProcess_FreeRunning.PpDiagImageProcess_FreeRunningWrite.DeMeasuredValue_ImageProcess_FreeRunning.SurroundView_System_ERR_0xb0d2.OD_heartbeat_monitor_faild CtApImageProcess_FreeRunning.PpDiagImageProcess_FreeRunningWrite.DeMeasuredValue_ImageProcess_FreeRunning.SurroundView_System_ERR_0xb0d2.Shared_data_lifecycle_monitor_wrong CtApImageProcess_FreeRunning.PpDiagImageProcess_FreeRunningWrite.DeMeasuredValue_ImageProcess_FreeRunning.SurroundView_System_ERR_0xb0d2.FS_memory_leak CtApImageProcess_FreeRunning.PpDiagImageProcess_FreeRunningWrite.DeMeasuredValue_ImageProcess_FreeRunning.SurroundView_System_ERR_0xb0d2.AVM_data_read_write_conflict CtApImageProcess_FreeRunning.PpDiagImageProcess_FreeRunningWrite.DeMeasuredValue_ImageProcess_FreeRunning.SurroundView_System_ERR_0xb0d2.FS_data_read_fail CtApImageProcess_FreeRunning.PpDiagImageProcess_FreeRunningWrite.DeMeasuredValue_ImageProcess_FreeRunning.SurroundView_System_ERR_0xb0d2.CamSer_process_error CtApImageProcess_FreeRunning.PpDiagImageProcess_FreeRunningWrite.DeMeasuredValue_ImageProcess_FreeRunning.SurroundView_System_ERR_0xb0d2.Freespace_heartbeat_monitor_faild CtApImageProcess_FreeRunning.PpDiagImageProcess_FreeRunningWrite.DeMeasuredValue_ImageProcess_FreeRunning.SurroundView_System_ERR_0xb0d2.PLD_data_read_write_conflict CtApImageProcess_FreeRunning.PpDiagImageProcess_FreeRunningWrite.DeMeasuredValue_ImageProcess_FreeRunning.SurroundView_System_ERR_0xb0d2.OD_memory_application_fail CtApImageProcess_FreeRunning.PpDiagImageProcess_FreeRunningWrite.DeMeasuredValue_ImageProcess_FreeRunning.SurroundView_System_ERR_0xb0d2.AVM_dispatch_monitor_faild CtApImageProcess_FreeRunning.PpDiagImageProcess_FreeRunningWrite.DeMeasuredValue_ImageProcess_FreeRunning.SurroundView_System_ERR_0xb0d2.AVM_data_write_fail CtApImageProcess_FreeRunning.PpDiagImageProcess_FreeRunningWrite.DeMeasuredValue_ImageProcess_FreeRunning.SurroundView_System_ERR_0xb0d2.camera_service_visit_released_data CtApImageProcess_FreeRunning.PpDiagImageProcess_FreeRunningWrite.DeMeasuredValue_ImageProcess_FreeRunning.SurroundView_System_ERR_0xb0d2.PLD_data_read_fail CtApImageProcess_FreeRunning.PpDiagImageProcess_FreeRunningWrite.DeMeasuredValue_ImageProcess_FreeRunning.SurroundView_System_ERR_0xb0d2.PLD_abnormal_break CtApImageProcess_FreeRunning.PpDiagImageProcess_FreeRunningWrite.DeMeasuredValue_ImageProcess_FreeRunning.SurroundView_System_ERR_0xb0d2.OD_data_read_fail CtApImageProcess_FreeRunning.PpDiagImageProcess_FreeRunningWrite.DeMeasuredValue_ImageProcess_FreeRunning.SurroundView_System_ERR_0xb0d2.camera_service_abnormal_break CtApImageProcess_FreeRunning.PpDiagImageProcess_FreeRunningWrite.DeMeasuredValue_ImageProcess_FreeRunning.SurroundView_System_ERR_0xb0d2.PLD_visit_released_data CtApImageProcess_FreeRunning.PpDiagImageProcess_FreeRunningWrite.DeMeasuredValue_ImageProcess_FreeRunning.SurroundView_System_ERR_0xb0d2.FS_memory_application_fail CtApImageProcess_FreeRunning.PpDiagImageProcess_FreeRunningWrite.DeMeasuredValue_ImageProcess_FreeRunning.SurroundView_System_ERR_0xb0d2.Reserved CtApImageProcess_FreeRunning.PpDiagImageProcess_FreeRunningWrite.DeMeasuredValue_ImageProcess_FreeRunning.SurroundView_System_ERR_0xb0d2.PLD_memory_application_fail CtApImageProcess_FreeRunning.PpDiagImageProcess_FreeRunningWrite.DeMeasuredValue_ImageProcess_FreeRunning.SurroundView_System_ERR_0xb0d2.PLD_process_timeout CtApImageProcess_FreeRunning.PpDiagImageProcess_FreeRunningWrite.DeMeasuredValue_ImageProcess_FreeRunning.SurroundView_System_ERR_0xb0d2.CamSer_dispatch_monitor_faild CtApImageProcess_FreeRunning.PpDiagImageProcess_FreeRunningWrite.DeMeasuredValue_ImageProcess_FreeRunning.SurroundView_System_ERR_0xb0d2.OD_process_timeout CtApImageProcess_FreeRunning.PpDiagImageProcess_FreeRunningWrite.DeMeasuredValue_ImageProcess_FreeRunning.SurroundView_System_ERR_0xb0d2.camera_service_memory_application_fail CtApImageProcess_FreeRunning.PpDiagImageProcess_FreeRunningWrite.DeMeasuredValue_ImageProcess_FreeRunning.SurroundView_System_ERR_0xb0d2.OD_visit_uncreated_data CtApImageProcess_FreeRunning.PpDiagImageProcess_FreeRunningWrite.DeMeasuredValue_ImageProcess_FreeRunning.SurroundView_System_ERR_0xb0d2.FS_data_visit_timeout CtApImageProcess_FreeRunning.PpDiagImageProcess_FreeRunningWrite.DeMeasuredValue_ImageProcess_FreeRunning.SurroundView_System_ERR_0xb0d2.camera_service_data_read_write_conflict CtApImageProcess_FreeRunning.PpDiagImageProcess_FreeRunningWrite.DeMeasuredValue_ImageProcess_FreeRunning.SurroundView_System_ERR_0xb0d2.PLD_dispatch_monitor_faild CtApImageProcess_FreeRunning.PpDiagImageProcess_FreeRunningWrite.DeMeasuredValue_ImageProcess_FreeRunning.SurroundView_System_ERR_0xb0d2.camera_service_data_write_fail CtApImageProcess_FreeRunning.PpDiagImageProcess_FreeRunningWrite.DeMeasuredValue_ImageProcess_FreeRunning.SurroundView_System_ERR_0xb0d2.PLD_heartbeat_monitor_faild CtApImageProcess_FreeRunning.PpDiagImageProcess_FreeRunningWrite.DeMeasuredValue_ImageProcess_FreeRunning.SurroundView_System_ERR_0xb0d2.AVM_data_visit_timeout CtApImageProcess_FreeRunning.PpDiagImageProcess_FreeRunningWrite.DeMeasuredValue_ImageProcess_FreeRunning.SurroundView_System_ERR_0xb0d2.FS_visit_uncreated_data CtApImageProcess_FreeRunning.PpDiagImageProcess_FreeRunningWrite.DeMeasuredValue_ImageProcess_FreeRunning.SurroundView_System_ERR_0xb0d2.AVM_data_read_fail CtApImageProcess_FreeRunning.PpDiagImageProcess_FreeRunningWrite.DeMeasuredValue_ImageProcess_FreeRunning.SurroundView_System_ERR_0xb0d2.camera_service_memory_leak CtApImageProcess_FreeRunning.PpImageProcess_FaultCondition_60ms.DeBKP.FaultCondition_BKP CtApImageProcess_FreeRunning.PpImageProcess_FaultCondition_60ms.DeFailureCondition.stHeader.Counter CtApImageProcess_FreeRunning.PpImageProcess_FaultCondition_60ms.DeFailureCondition.stHeader.FrameID CtApImageProcess_FreeRunning.PpImageProcess_FaultCondition_60ms.DeFailureCondition.stHeader.TimeStamp CtApImageProcess_FreeRunning.PpImageProcess_FaultCondition_60ms.DeFailureCondition.nFailureConditionCode CtApImageProcess_FreeRunning.PpImageProcess_FaultCondition_60ms.DeFailureCondition.nReserved CtApImageProcess_FreeRunning.PpImageProcess_FaultCondition_60ms.DeFaultCondition.stHeader.Counter CtApImageProcess_FreeRunning.PpImageProcess_FaultCondition_60ms.DeFaultCondition.stHeader.FrameID CtApImageProcess_FreeRunning.PpImageProcess_FaultCondition_60ms.DeFaultCondition.stHeader.TimeStamp CtApImageProcess_FreeRunning.PpImageProcess_FaultCondition_60ms.DeFaultCondition.nFaultConditionCode CtApImageProcess_FreeRunning.PpImageProcess_FaultCondition_60ms.DeFaultCondition.nReserved CtApImageProcess_FreeRunning.PpImageProcess_FaultCondition_60ms.DeTriggerCondition.stHeader.Counter CtApImageProcess_FreeRunning.PpImageProcess_FaultCondition_60ms.DeTriggerCondition.stHeader.FrameID CtApImageProcess_FreeRunning.PpImageProcess_FaultCondition_60ms.DeTriggerCondition.stHeader.TimeStamp CtApImageProcess_FreeRunning.PpImageProcess_FaultCondition_60ms.DeTriggerCondition.nTriggerConditionCode CtApImageProcess_FreeRunning.PpImageProcess_FaultCondition_60ms.DeTriggerCondition.nReserved CtApImageProcess_FreeRunning.PpImageProcess_FreeRunning2EyeQCom_100ms.DeImageProcess2EyeQ.RSD_Sensor_Message_Reserved CtApImageProcess_FreeRunning.PpImageProcess_FreeRunning2EyeQCom_100ms.DeImageProcess2EyeQ.RSD_EthernetCom_Received_Sync_ID CtApImageProcess_FreeRunning.PpImageProcess_FreeRunning2EyeQCom_100ms.DeImageProcess2EyeQ.RSDS_Zero_Byte CtApImageProcess_FreeRunning.PpImageProcess_FreeRunning2EyeQCom_100ms.DeImageProcess2EyeQ.RSDS_Version CtApImageProcess_FreeRunning.PpImageProcess_FreeRunning2EyeQCom_100ms.DeImageProcess2EyeQ.RSDS_Cyclic_Counter CtApImageProcess_FreeRunning.PpImageProcess_FreeRunning2EyeQCom_100ms.DeImageProcess2EyeQ.RSDS_Buffer_0 CtApImageProcess_FreeRunning.PpImageProcess_FreeRunning2EyeQCom_100ms.DeImageProcess2EyeQ.RSDS_Message_ID CtApImageProcess_FreeRunning.PpImageProcess_FreeRunning2EyeQCom_100ms.DeImageProcess2EyeQ.RSDS_Type CtApImageProcess_FreeRunning.PpImageProcess_FreeRunning2EyeQCom_100ms.DeImageProcess2EyeQ.RSDS_B_Received CtApImageProcess_FreeRunning.PpImageProcess_FreeRunning2EyeQCom_100ms.DeImageProcess2EyeQ.RSDS_P_Count CtApImageProcess_FreeRunning.PpImageProcess_FreeRunning2EyeQCom_100ms.DeImageProcess2EyeQ.RSDS_CRC CtApImageProcess_FreeRunning.PpImageProcess_FreeRunning2EyeQCom_100ms.DeImageProcess2EyeQ.RSDS_Message_Type CtApImageProcess_FreeRunning.PpImageProcess_FreeRunning2EyeQCom_100ms.DeImageProcess2EyeQ.RSDS_Size CtApImageProcess_FreeRunning.PpImageProcess_FreeRunning2EyeQCom_100ms.DeImageProcess2EyeQ.RSDS_Buffer_1 CtApImageProcess_FreeRunning.PpImageProcess_FreeRunning2EyeQCom_100ms.DeImageProcess2EyeQ.RSDS_Reserved_1 CtApImageProcess_FreeRunning.PpImageProcess_FreeSpace_60ms.DeBKP CtApImageProcess_FreeRunning.PpImageProcess_FreeSpace_60ms.DeFreeSpcae.stHeader.Counter CtApImageProcess_FreeRunning.PpImageProcess_FreeSpace_60ms.DeFreeSpcae.stHeader.FrameID CtApImageProcess_FreeRunning.PpImageProcess_FreeSpace_60ms.DeFreeSpcae.stHeader.TimeStamp CtApImageProcess_FreeRunning.PpImageProcess_FreeSpace_60ms.DeFreeSpcae.nImageTimeStamp CtApImageProcess_FreeRunning.PpImageProcess_FreeSpace_60ms.DeFreeSpcae.gstSVFreespaces[0].stHeader.Counter CtApImageProcess_FreeRunning.PpImageProcess_FreeSpace_60ms.DeFreeSpcae.gstSVFreespaces[0].stHeader.FrameID CtApImageProcess_FreeRunning.PpImageProcess_FreeSpace_60ms.DeFreeSpcae.gstSVFreespaces[0].stHeader.TimeStamp CtApImageProcess_FreeRunning.PpImageProcess_FreeSpace_60ms.DeFreeSpcae.gstSVFreespaces[0].Is_Valid CtApImageProcess_FreeRunning.PpImageProcess_FreeSpace_60ms.DeFreeSpcae.gstSVFreespaces[0].Existence_Prob CtApImageProcess_FreeRunning.PpImageProcess_FreeSpace_60ms.DeFreeSpcae.gstSVFreespaces[0].Classification_Conf CtApImageProcess_FreeRunning.PpImageProcess_FreeSpace_60ms.DeFreeSpcae.gstSVFreespaces[0].Classification_Type CtApImageProcess_FreeRunning.PpImageProcess_FreeSpace_60ms.DeFreeSpcae.gstSVFreespaces[0].fPointX CtApImageProcess_FreeRunning.PpImageProcess_FreeSpace_60ms.DeFreeSpcae.gstSVFreespaces[0].fPointY CtApImageProcess_FreeRunning.PpImageProcess_FreeSpace_60ms.DeFreeSpcae.gstSVFreespaces[0].fPointZ CtApImageProcess_FreeRunning.PpImageProcess_FreeSpace_60ms.DeFreeSpcae.gstSVFreespaces[1].stHeader.Counter CtApImageProcess_FreeRunning.PpImageProcess_FreeSpace_60ms.DeFreeSpcae.gstSVFreespaces[1].stHeader.FrameID CtApImageProcess_FreeRunning.PpImageProcess_FreeSpace_60ms.DeFreeSpcae.gstSVFreespaces[1].stHeader.TimeStamp CtApImageProcess_FreeRunning.PpImageProcess_FreeSpace_60ms.DeFreeSpcae.gstSVFreespaces[1].Is_Valid CtApImageProcess_FreeRunning.PpImageProcess_FreeSpace_60ms.DeFreeSpcae.gstSVFreespaces[1].Existence_Prob CtApImageProcess_FreeRunning.PpImageProcess_FreeSpace_60ms.DeFreeSpcae.gstSVFreespaces[1].Classification_Conf CtApImageProcess_FreeRunning.PpImageProcess_FreeSpace_60ms.DeFreeSpcae.gstSVFreespaces[1].Classification_Type CtApImageProcess_FreeRunning.PpImageProcess_FreeSpace_60ms.DeFreeSpcae.gstSVFreespaces[1].fPointX CtApImageProcess_FreeRunning.PpImageProcess_FreeSpace_60ms.DeFreeSpcae.gstSVFreespaces[1].fPointY CtApImageProcess_FreeRunning.PpImageProcess_FreeSpace_60ms.DeFreeSpcae.gstSVFreespaces[1].fPointZ CtApImageProcess_FreeRunning.PpImageProcess_FreeSpace_60ms.DeFreeSpcae.gstSVFreespaces[2].stHeader.Counter CtApImageProcess_FreeRunning.PpImageProcess_FreeSpace_60ms.DeFreeSpcae.gstSVFreespaces[2].stHeader.FrameID CtApImageProcess_FreeRunning.PpImageProcess_FreeSpace_60ms.DeFreeSpcae.gstSVFreespaces[2].stHeader.TimeStamp CtApImageProcess_FreeRunning.PpImageProcess_FreeSpace_60ms.DeFreeSpcae.gstSVFreespaces[2].Is_Valid CtApImageProcess_FreeRunning.PpImageProcess_FreeSpace_60ms.DeFreeSpcae.gstSVFreespaces[2].Existence_Prob CtApImageProcess_FreeRunning.PpImageProcess_FreeSpace_60ms.DeFreeSpcae.gstSVFreespaces[2].Classification_Conf CtApImageProcess_FreeRunning.PpImageProcess_FreeSpace_60ms.DeFreeSpcae.gstSVFreespaces[2].Classification_Type CtApImageProcess_FreeRunning.PpImageProcess_FreeSpace_60ms.DeFreeSpcae.gstSVFreespaces[2].fPointX CtApImageProcess_FreeRunning.PpImageProcess_FreeSpace_60ms.DeFreeSpcae.gstSVFreespaces[2].fPointY CtApImageProcess_FreeRunning.PpImageProcess_FreeSpace_60ms.DeFreeSpcae.gstSVFreespaces[2].fPointZ CtApImageProcess_FreeRunning.PpImageProcess_FreeSpace_60ms.DeFreeSpcae.gstSVFreespaces[3].stHeader.Counter CtApImageProcess_FreeRunning.PpImageProcess_FreeSpace_60ms.DeFreeSpcae.gstSVFreespaces[3].stHeader.FrameID CtApImageProcess_FreeRunning.PpImageProcess_FreeSpace_60ms.DeFreeSpcae.gstSVFreespaces[3].stHeader.TimeStamp CtApImageProcess_FreeRunning.PpImageProcess_FreeSpace_60ms.DeFreeSpcae.gstSVFreespaces[3].Is_Valid CtApImageProcess_FreeRunning.PpImageProcess_FreeSpace_60ms.DeFreeSpcae.gstSVFreespaces[3].Existence_Prob CtApImageProcess_FreeRunning.PpImageProcess_FreeSpace_60ms.DeFreeSpcae.gstSVFreespaces[3].Classification_Conf CtApImageProcess_FreeRunning.PpImageProcess_FreeSpace_60ms.DeFreeSpcae.gstSVFreespaces[3].Classification_Type CtApImageProcess_FreeRunning.PpImageProcess_FreeSpace_60ms.DeFreeSpcae.gstSVFreespaces[3].fPointX CtApImageProcess_FreeRunning.PpImageProcess_FreeSpace_60ms.DeFreeSpcae.gstSVFreespaces[3].fPointY CtApImageProcess_FreeRunning.PpImageProcess_FreeSpace_60ms.DeFreeSpcae.gstSVFreespaces[3].fPointZ CtApImageProcess_FreeRunning.PpImageProcess_FreeSpace_60ms.DeFreeSpcae.gstSVFreespaces[4].stHeader.Counter CtApImageProcess_FreeRunning.PpImageProcess_FreeSpace_60ms.DeFreeSpcae.gstSVFreespaces[4].stHeader.FrameID CtApImageProcess_FreeRunning.PpImageProcess_FreeSpace_60ms.DeFreeSpcae.gstSVFreespaces[4].stHeader.TimeStamp CtApImageProcess_FreeRunning.PpImageProcess_FreeSpace_60ms.DeFreeSpcae.gstSVFreespaces[4].Is_Valid CtApImageProcess_FreeRunning.PpImageProcess_FreeSpace_60ms.DeFreeSpcae.gstSVFreespaces[4].Existence_Prob CtApImageProcess_FreeRunning.PpImageProcess_FreeSpace_60ms.DeFreeSpcae.gstSVFreespaces[4].Classification_Conf CtApImageProcess_FreeRunning.PpImageProcess_FreeSpace_60ms.DeFreeSpcae.gstSVFreespaces[4].Classification_Type CtApImageProcess_FreeRunning.PpImageProcess_FreeSpace_60ms.DeFreeSpcae.gstSVFreespaces[4].fPointX CtApImageProcess_FreeRunning.PpImageProcess_FreeSpace_60ms.DeFreeSpcae.gstSVFreespaces[4].fPointY CtApImageProcess_FreeRunning.PpImageProcess_FreeSpace_60ms.DeFreeSpcae.gstSVFreespaces[4].fPointZ CtApImageProcess_FreeRunning.PpImageProcess_FreeSpace_60ms.DeFreeSpcae.gstSVFreespaces[5].stHeader.Counter CtApImageProcess_FreeRunning.PpImageProcess_FreeSpace_60ms.DeFreeSpcae.gstSVFreespaces[5].stHeader.FrameID CtApImageProcess_FreeRunning.PpImageProcess_FreeSpace_60ms.DeFreeSpcae.gstSVFreespaces[5].stHeader.TimeStamp CtApImageProcess_FreeRunning.PpImageProcess_FreeSpace_60ms.DeFreeSpcae.gstSVFreespaces[5].Is_Valid CtApImageProcess_FreeRunning.PpImageProcess_FreeSpace_60ms.DeFreeSpcae.gstSVFreespaces[5].Existence_Prob CtApImageProcess_FreeRunning.PpImageProcess_FreeSpace_60ms.DeFreeSpcae.gstSVFreespaces[5].Classification_Conf CtApImageProcess_FreeRunning.PpImageProcess_FreeSpace_60ms.DeFreeSpcae.gstSVFreespaces[5].Classification_Type CtApImageProcess_FreeRunning.PpImageProcess_FreeSpace_60ms.DeFreeSpcae.gstSVFreespaces[5].fPointX CtApImageProcess_FreeRunning.PpImageProcess_FreeSpace_60ms.DeFreeSpcae.gstSVFreespaces[5].fPointY CtApImageProcess_FreeRunning.PpImageProcess_FreeSpace_60ms.DeFreeSpcae.gstSVFreespaces[5].fPointZ CtApImageProcess_FreeRunning.PpImageProcess_FreeSpace_60ms.DeFreeSpcae.gstSVFreespaces[6].stHeader.Counter CtApImageProcess_FreeRunning.PpImageProcess_FreeSpace_60ms.DeFreeSpcae.gstSVFreespaces[6].stHeader.FrameID CtApImageProcess_FreeRunning.PpImageProcess_FreeSpace_60ms.DeFreeSpcae.gstSVFreespaces[6].stHeader.TimeStamp CtApImageProcess_FreeRunning.PpImageProcess_FreeSpace_60ms.DeFreeSpcae.gstSVFreespaces[6].Is_Valid CtApImageProcess_FreeRunning.PpImageProcess_FreeSpace_60ms.DeFreeSpcae.gstSVFreespaces[6].Existence_Prob CtApImageProcess_FreeRunning.PpImageProcess_FreeSpace_60ms.DeFreeSpcae.gstSVFreespaces[6].Classification_Conf CtApImageProcess_FreeRunning.PpImageProcess_FreeSpace_60ms.DeFreeSpcae.gstSVFreespaces[6].Classification_Type CtApImageProcess_FreeRunning.PpImageProcess_FreeSpace_60ms.DeFreeSpcae.gstSVFreespaces[6].fPointX CtApImageProcess_FreeRunning.PpImageProcess_FreeSpace_60ms.DeFreeSpcae.gstSVFreespaces[6].fPointY CtApImageProcess_FreeRunning.PpImageProcess_FreeSpace_60ms.DeFreeSpcae.gstSVFreespaces[6].fPointZ CtApImageProcess_FreeRunning.PpImageProcess_FreeSpace_60ms.DeFreeSpcae.gstSVFreespaces[7].stHeader.Counter CtApImageProcess_FreeRunning.PpImageProcess_FreeSpace_60ms.DeFreeSpcae.gstSVFreespaces[7].stHeader.FrameID CtApImageProcess_FreeRunning.PpImageProcess_FreeSpace_60ms.DeFreeSpcae.gstSVFreespaces[7].stHeader.TimeStamp CtApImageProcess_FreeRunning.PpImageProcess_FreeSpace_60ms.DeFreeSpcae.gstSVFreespaces[7].Is_Valid CtApImageProcess_FreeRunning.PpImageProcess_FreeSpace_60ms.DeFreeSpcae.gstSVFreespaces[7].Existence_Prob CtApImageProcess_FreeRunning.PpImageProcess_FreeSpace_60ms.DeFreeSpcae.gstSVFreespaces[7].Classification_Conf CtApImageProcess_FreeRunning.PpImageProcess_FreeSpace_60ms.DeFreeSpcae.gstSVFreespaces[7].Classification_Type CtApImageProcess_FreeRunning.PpImageProcess_FreeSpace_60ms.DeFreeSpcae.gstSVFreespaces[7].fPointX CtApImageProcess_FreeRunning.PpImageProcess_FreeSpace_60ms.DeFreeSpcae.gstSVFreespaces[7].fPointY CtApImageProcess_FreeRunning.PpImageProcess_FreeSpace_60ms.DeFreeSpcae.gstSVFreespaces[7].fPointZ CtApImageProcess_FreeRunning.PpImageProcess_FreeSpace_60ms.DeFreeSpcae.gstSVFreespaces[8].stHeader.Counter CtApImageProcess_FreeRunning.PpImageProcess_FreeSpace_60ms.DeFreeSpcae.gstSVFreespaces[8].stHeader.FrameID CtApImageProcess_FreeRunning.PpImageProcess_FreeSpace_60ms.DeFreeSpcae.gstSVFreespaces[8].stHeader.TimeStamp CtApImageProcess_FreeRunning.PpImageProcess_FreeSpace_60ms.DeFreeSpcae.gstSVFreespaces[8].Is_Valid CtApImageProcess_FreeRunning.PpImageProcess_FreeSpace_60ms.DeFreeSpcae.gstSVFreespaces[8].Existence_Prob CtApImageProcess_FreeRunning.PpImageProcess_FreeSpace_60ms.DeFreeSpcae.gstSVFreespaces[8].Classification_Conf CtApImageProcess_FreeRunning.PpImageProcess_FreeSpace_60ms.DeFreeSpcae.gstSVFreespaces[8].Classification_Type CtApImageProcess_FreeRunning.PpImageProcess_FreeSpace_60ms.DeFreeSpcae.gstSVFreespaces[8].fPointX CtApImageProcess_FreeRunning.PpImageProcess_FreeSpace_60ms.DeFreeSpcae.gstSVFreespaces[8].fPointY CtApImageProcess_FreeRunning.PpImageProcess_FreeSpace_60ms.DeFreeSpcae.gstSVFreespaces[8].fPointZ CtApImageProcess_FreeRunning.PpImageProcess_FreeSpace_60ms.DeFreeSpcae.gstSVFreespaces[9].stHeader.Counter CtApImageProcess_FreeRunning.PpImageProcess_FreeSpace_60ms.DeFreeSpcae.gstSVFreespaces[9].stHeader.FrameID CtApImageProcess_FreeRunning.PpImageProcess_FreeSpace_60ms.DeFreeSpcae.gstSVFreespaces[9].stHeader.TimeStamp CtApImageProcess_FreeRunning.PpImageProcess_FreeSpace_60ms.DeFreeSpcae.gstSVFreespaces[9].Is_Valid CtApImageProcess_FreeRunning.PpImageProcess_FreeSpace_60ms.DeFreeSpcae.gstSVFreespaces[9].Existence_Prob CtApImageProcess_FreeRunning.PpImageProcess_FreeSpace_60ms.DeFreeSpcae.gstSVFreespaces[9].Classification_Conf CtApImageProcess_FreeRunning.PpImageProcess_FreeSpace_60ms.DeFreeSpcae.gstSVFreespaces[9].Classification_Type CtApImageProcess_FreeRunning.PpImageProcess_FreeSpace_60ms.DeFreeSpcae.gstSVFreespaces[9].fPointX CtApImageProcess_FreeRunning.PpImageProcess_FreeSpace_60ms.DeFreeSpcae.gstSVFreespaces[9].fPointY CtApImageProcess_FreeRunning.PpImageProcess_FreeSpace_60ms.DeFreeSpcae.gstSVFreespaces[9].fPointZ CtApImageProcess_FreeRunning.PpImageProcess_FreeSpace_60ms.DeFreeSpcae.gstSVFreespaces[10].stHeader.Counter CtApImageProcess_FreeRunning.PpImageProcess_FreeSpace_60ms.DeFreeSpcae.gstSVFreespaces[10].stHeader.FrameID CtApImageProcess_FreeRunning.PpImageProcess_FreeSpace_60ms.DeFreeSpcae.gstSVFreespaces[10].stHeader.TimeStamp CtApImageProcess_FreeRunning.PpImageProcess_FreeSpace_60ms.DeFreeSpcae.gstSVFreespaces[10].Is_Valid CtApImageProcess_FreeRunning.PpImageProcess_FreeSpace_60ms.DeFreeSpcae.gstSVFreespaces[10].Existence_Prob CtApImageProcess_FreeRunning.PpImageProcess_FreeSpace_60ms.DeFreeSpcae.gstSVFreespaces[10].Classification_Conf CtApImageProcess_FreeRunning.PpImageProcess_FreeSpace_60ms.DeFreeSpcae.gstSVFreespaces[10].Classification_Type CtApImageProcess_FreeRunning.PpImageProcess_FreeSpace_60ms.DeFreeSpcae.gstSVFreespaces[10].fPointX CtApImageProcess_FreeRunning.PpImageProcess_FreeSpace_60ms.DeFreeSpcae.gstSVFreespaces[10].fPointY CtApImageProcess_FreeRunning.PpImageProcess_FreeSpace_60ms.DeFreeSpcae.gstSVFreespaces[10].fPointZ CtApImageProcess_FreeRunning.PpImageProcess_FreeSpace_60ms.DeFreeSpcae.gstSVFreespaces[11].stHeader.Counter CtApImageProcess_FreeRunning.PpImageProcess_FreeSpace_60ms.DeFreeSpcae.gstSVFreespaces[11].stHeader.FrameID CtApImageProcess_FreeRunning.PpImageProcess_FreeSpace_60ms.DeFreeSpcae.gstSVFreespaces[11].stHeader.TimeStamp CtApImageProcess_FreeRunning.PpImageProcess_FreeSpace_60ms.DeFreeSpcae.gstSVFreespaces[11].Is_Valid CtApImageProcess_FreeRunning.PpImageProcess_FreeSpace_60ms.DeFreeSpcae.gstSVFreespaces[11].Existence_Prob CtApImageProcess_FreeRunning.PpImageProcess_FreeSpace_60ms.DeFreeSpcae.gstSVFreespaces[11].Classification_Conf CtApImageProcess_FreeRunning.PpImageProcess_FreeSpace_60ms.DeFreeSpcae.gstSVFreespaces[11].Classification_Type CtApImageProcess_FreeRunning.PpImageProcess_FreeSpace_60ms.DeFreeSpcae.gstSVFreespaces[11].fPointX CtApImageProcess_FreeRunning.PpImageProcess_FreeSpace_60ms.DeFreeSpcae.gstSVFreespaces[11].fPointY CtApImageProcess_FreeRunning.PpImageProcess_FreeSpace_60ms.DeFreeSpcae.gstSVFreespaces[11].fPointZ CtApImageProcess_FreeRunning.PpImageProcess_FreeSpace_60ms.DeFreeSpcae.gstSVFreespaces[12].stHeader.Counter CtApImageProcess_FreeRunning.PpImageProcess_FreeSpace_60ms.DeFreeSpcae.gstSVFreespaces[12].stHeader.FrameID CtApImageProcess_FreeRunning.PpImageProcess_FreeSpace_60ms.DeFreeSpcae.gstSVFreespaces[12].stHeader.TimeStamp CtApImageProcess_FreeRunning.PpImageProcess_FreeSpace_60ms.DeFreeSpcae.gstSVFreespaces[12].Is_Valid CtApImageProcess_FreeRunning.PpImageProcess_FreeSpace_60ms.DeFreeSpcae.gstSVFreespaces[12].Existence_Prob CtApImageProcess_FreeRunning.PpImageProcess_FreeSpace_60ms.DeFreeSpcae.gstSVFreespaces[12].Classification_Conf CtApImageProcess_FreeRunning.PpImageProcess_FreeSpace_60ms.DeFreeSpcae.gstSVFreespaces[12].Classification_Type CtApImageProcess_FreeRunning.PpImageProcess_FreeSpace_60ms.DeFreeSpcae.gstSVFreespaces[12].fPointX CtApImageProcess_FreeRunning.PpImageProcess_FreeSpace_60ms.DeFreeSpcae.gstSVFreespaces[12].fPointY CtApImageProcess_FreeRunning.PpImageProcess_FreeSpace_60ms.DeFreeSpcae.gstSVFreespaces[12].fPointZ CtApImageProcess_FreeRunning.PpImageProcess_FreeSpace_60ms.DeFreeSpcae.gstSVFreespaces[13].stHeader.Counter CtApImageProcess_FreeRunning.PpImageProcess_FreeSpace_60ms.DeFreeSpcae.gstSVFreespaces[13].stHeader.FrameID CtApImageProcess_FreeRunning.PpImageProcess_FreeSpace_60ms.DeFreeSpcae.gstSVFreespaces[13].stHeader.TimeStamp CtApImageProcess_FreeRunning.PpImageProcess_FreeSpace_60ms.DeFreeSpcae.gstSVFreespaces[13].Is_Valid CtApImageProcess_FreeRunning.PpImageProcess_FreeSpace_60ms.DeFreeSpcae.gstSVFreespaces[13].Existence_Prob CtApImageProcess_FreeRunning.PpImageProcess_FreeSpace_60ms.DeFreeSpcae.gstSVFreespaces[13].Classification_Conf CtApImageProcess_FreeRunning.PpImageProcess_FreeSpace_60ms.DeFreeSpcae.gstSVFreespaces[13].Classification_Type CtApImageProcess_FreeRunning.PpImageProcess_FreeSpace_60ms.DeFreeSpcae.gstSVFreespaces[13].fPointX CtApImageProcess_FreeRunning.PpImageProcess_FreeSpace_60ms.DeFreeSpcae.gstSVFreespaces[13].fPointY CtApImageProcess_FreeRunning.PpImageProcess_FreeSpace_60ms.DeFreeSpcae.gstSVFreespaces[13].fPointZ CtApImageProcess_FreeRunning.PpImageProcess_FreeSpace_60ms.DeFreeSpcae.gstSVFreespaces[14].stHeader.Counter CtApImageProcess_FreeRunning.PpImageProcess_FreeSpace_60ms.DeFreeSpcae.gstSVFreespaces[14].stHeader.FrameID CtApImageProcess_FreeRunning.PpImageProcess_FreeSpace_60ms.DeFreeSpcae.gstSVFreespaces[14].stHeader.TimeStamp CtApImageProcess_FreeRunning.PpImageProcess_FreeSpace_60ms.DeFreeSpcae.gstSVFreespaces[14].Is_Valid CtApImageProcess_FreeRunning.PpImageProcess_FreeSpace_60ms.DeFreeSpcae.gstSVFreespaces[14].Existence_Prob CtApImageProcess_FreeRunning.PpImageProcess_FreeSpace_60ms.DeFreeSpcae.gstSVFreespaces[14].Classification_Conf CtApImageProcess_FreeRunning.PpImageProcess_FreeSpace_60ms.DeFreeSpcae.gstSVFreespaces[14].Classification_Type CtApImageProcess_FreeRunning.PpImageProcess_FreeSpace_60ms.DeFreeSpcae.gstSVFreespaces[14].fPointX CtApImageProcess_FreeRunning.PpImageProcess_FreeSpace_60ms.DeFreeSpcae.gstSVFreespaces[14].fPointY CtApImageProcess_FreeRunning.PpImageProcess_FreeSpace_60ms.DeFreeSpcae.gstSVFreespaces[14].fPointZ CtApImageProcess_FreeRunning.PpImageProcess_FreeSpace_60ms.DeFreeSpcae.gstSVFreespaces[15].stHeader.Counter CtApImageProcess_FreeRunning.PpImageProcess_FreeSpace_60ms.DeFreeSpcae.gstSVFreespaces[15].stHeader.FrameID CtApImageProcess_FreeRunning.PpImageProcess_FreeSpace_60ms.DeFreeSpcae.gstSVFreespaces[15].stHeader.TimeStamp CtApImageProcess_FreeRunning.PpImageProcess_FreeSpace_60ms.DeFreeSpcae.gstSVFreespaces[15].Is_Valid CtApImageProcess_FreeRunning.PpImageProcess_FreeSpace_60ms.DeFreeSpcae.gstSVFreespaces[15].Existence_Prob CtApImageProcess_FreeRunning.PpImageProcess_FreeSpace_60ms.DeFreeSpcae.gstSVFreespaces[15].Classification_Conf CtApImageProcess_FreeRunning.PpImageProcess_FreeSpace_60ms.DeFreeSpcae.gstSVFreespaces[15].Classification_Type CtApImageProcess_FreeRunning.PpImageProcess_FreeSpace_60ms.DeFreeSpcae.gstSVFreespaces[15].fPointX CtApImageProcess_FreeRunning.PpImageProcess_FreeSpace_60ms.DeFreeSpcae.gstSVFreespaces[15].fPointY CtApImageProcess_FreeRunning.PpImageProcess_FreeSpace_60ms.DeFreeSpcae.gstSVFreespaces[15].fPointZ CtApImageProcess_FreeRunning.PpImageProcess_FreeSpace_60ms.DeFreeSpcae.gstSVFreespaces[16].stHeader.Counter CtApImageProcess_FreeRunning.PpImageProcess_FreeSpace_60ms.DeFreeSpcae.gstSVFreespaces[16].stHeader.FrameID CtApImageProcess_FreeRunning.PpImageProcess_FreeSpace_60ms.DeFreeSpcae.gstSVFreespaces[16].stHeader.TimeStamp CtApImageProcess_FreeRunning.PpImageProcess_FreeSpace_60ms.DeFreeSpcae.gstSVFreespaces[16].Is_Valid CtApImageProcess_FreeRunning.PpImageProcess_FreeSpace_60ms.DeFreeSpcae.gstSVFreespaces[16].Existence_Prob CtApImageProcess_FreeRunning.PpImageProcess_FreeSpace_60ms.DeFreeSpcae.gstSVFreespaces[16].Classification_Conf CtApImageProcess_FreeRunning.PpImageProcess_FreeSpace_60ms.DeFreeSpcae.gstSVFreespaces[16].Classification_Type CtApImageProcess_FreeRunning.PpImageProcess_FreeSpace_60ms.DeFreeSpcae.gstSVFreespaces[16].fPointX CtApImageProcess_FreeRunning.PpImageProcess_FreeSpace_60ms.DeFreeSpcae.gstSVFreespaces[16].fPointY CtApImageProcess_FreeRunning.PpImageProcess_FreeSpace_60ms.DeFreeSpcae.gstSVFreespaces[16].fPointZ CtApImageProcess_FreeRunning.PpImageProcess_FreeSpace_60ms.DeFreeSpcae.gstSVFreespaces[17].stHeader.Counter CtApImageProcess_FreeRunning.PpImageProcess_FreeSpace_60ms.DeFreeSpcae.gstSVFreespaces[17].stHeader.FrameID CtApImageProcess_FreeRunning.PpImageProcess_FreeSpace_60ms.DeFreeSpcae.gstSVFreespaces[17].stHeader.TimeStamp CtApImageProcess_FreeRunning.PpImageProcess_FreeSpace_60ms.DeFreeSpcae.gstSVFreespaces[17].Is_Valid CtApImageProcess_FreeRunning.PpImageProcess_FreeSpace_60ms.DeFreeSpcae.gstSVFreespaces[17].Existence_Prob CtApImageProcess_FreeRunning.PpImageProcess_FreeSpace_60ms.DeFreeSpcae.gstSVFreespaces[17].Classification_Conf CtApImageProcess_FreeRunning.PpImageProcess_FreeSpace_60ms.DeFreeSpcae.gstSVFreespaces[17].Classification_Type CtApImageProcess_FreeRunning.PpImageProcess_FreeSpace_60ms.DeFreeSpcae.gstSVFreespaces[17].fPointX CtApImageProcess_FreeRunning.PpImageProcess_FreeSpace_60ms.DeFreeSpcae.gstSVFreespaces[17].fPointY CtApImageProcess_FreeRunning.PpImageProcess_FreeSpace_60ms.DeFreeSpcae.gstSVFreespaces[17].fPointZ CtApImageProcess_FreeRunning.PpImageProcess_FreeSpace_60ms.DeFreeSpcae.gstSVFreespaces[18].stHeader.Counter CtApImageProcess_FreeRunning.PpImageProcess_FreeSpace_60ms.DeFreeSpcae.gstSVFreespaces[18].stHeader.FrameID CtApImageProcess_FreeRunning.PpImageProcess_FreeSpace_60ms.DeFreeSpcae.gstSVFreespaces[18].stHeader.TimeStamp CtApImageProcess_FreeRunning.PpImageProcess_FreeSpace_60ms.DeFreeSpcae.gstSVFreespaces[18].Is_Valid CtApImageProcess_FreeRunning.PpImageProcess_FreeSpace_60ms.DeFreeSpcae.gstSVFreespaces[18].Existence_Prob CtApImageProcess_FreeRunning.PpImageProcess_FreeSpace_60ms.DeFreeSpcae.gstSVFreespaces[18].Classification_Conf CtApImageProcess_FreeRunning.PpImageProcess_FreeSpace_60ms.DeFreeSpcae.gstSVFreespaces[18].Classification_Type CtApImageProcess_FreeRunning.PpImageProcess_FreeSpace_60ms.DeFreeSpcae.gstSVFreespaces[18].fPointX CtApImageProcess_FreeRunning.PpImageProcess_FreeSpace_60ms.DeFreeSpcae.gstSVFreespaces[18].fPointY CtApImageProcess_FreeRunning.PpImageProcess_FreeSpace_60ms.DeFreeSpcae.gstSVFreespaces[18].fPointZ CtApImageProcess_FreeRunning.PpImageProcess_FreeSpace_60ms.DeFreeSpcae.gstSVFreespaces[19].stHeader.Counter CtApImageProcess_FreeRunning.PpImageProcess_FreeSpace_60ms.DeFreeSpcae.gstSVFreespaces[19].stHeader.FrameID CtApImageProcess_FreeRunning.PpImageProcess_FreeSpace_60ms.DeFreeSpcae.gstSVFreespaces[19].stHeader.TimeStamp CtApImageProcess_FreeRunning.PpImageProcess_FreeSpace_60ms.DeFreeSpcae.gstSVFreespaces[19].Is_Valid CtApImageProcess_FreeRunning.PpImageProcess_FreeSpace_60ms.DeFreeSpcae.gstSVFreespaces[19].Existence_Prob CtApImageProcess_FreeRunning.PpImageProcess_FreeSpace_60ms.DeFreeSpcae.gstSVFreespaces[19].Classification_Conf CtApImageProcess_FreeRunning.PpImageProcess_FreeSpace_60ms.DeFreeSpcae.gstSVFreespaces[19].Classification_Type CtApImageProcess_FreeRunning.PpImageProcess_FreeSpace_60ms.DeFreeSpcae.gstSVFreespaces[19].fPointX CtApImageProcess_FreeRunning.PpImageProcess_FreeSpace_60ms.DeFreeSpcae.gstSVFreespaces[19].fPointY CtApImageProcess_FreeRunning.PpImageProcess_FreeSpace_60ms.DeFreeSpcae.gstSVFreespaces[19].fPointZ CtApImageProcess_FreeRunning.PpImageProcess_FreeSpace_60ms.DeFreeSpcae.gstSVFreespaces[20].stHeader.Counter CtApImageProcess_FreeRunning.PpImageProcess_FreeSpace_60ms.DeFreeSpcae.gstSVFreespaces[20].stHeader.FrameID CtApImageProcess_FreeRunning.PpImageProcess_FreeSpace_60ms.DeFreeSpcae.gstSVFreespaces[20].stHeader.TimeStamp CtApImageProcess_FreeRunning.PpImageProcess_FreeSpace_60ms.DeFreeSpcae.gstSVFreespaces[20].Is_Valid CtApImageProcess_FreeRunning.PpImageProcess_FreeSpace_60ms.DeFreeSpcae.gstSVFreespaces[20].Existence_Prob CtApImageProcess_FreeRunning.PpImageProcess_FreeSpace_60ms.DeFreeSpcae.gstSVFreespaces[20].Classification_Conf CtApImageProcess_FreeRunning.PpImageProcess_FreeSpace_60ms.DeFreeSpcae.gstSVFreespaces[20].Classification_Type CtApImageProcess_FreeRunning.PpImageProcess_FreeSpace_60ms.DeFreeSpcae.gstSVFreespaces[20].fPointX CtApImageProcess_FreeRunning.PpImageProcess_FreeSpace_60ms.DeFreeSpcae.gstSVFreespaces[20].fPointY CtApImageProcess_FreeRunning.PpImageProcess_FreeSpace_60ms.DeFreeSpcae.gstSVFreespaces[20].fPointZ CtApImageProcess_FreeRunning.PpImageProcess_FreeSpace_60ms.DeFreeSpcae.gstSVFreespaces[21].stHeader.Counter CtApImageProcess_FreeRunning.PpImageProcess_FreeSpace_60ms.DeFreeSpcae.gstSVFreespaces[21].stHeader.FrameID CtApImageProcess_FreeRunning.PpImageProcess_FreeSpace_60ms.DeFreeSpcae.gstSVFreespaces[21].stHeader.TimeStamp CtApImageProcess_FreeRunning.PpImageProcess_FreeSpace_60ms.DeFreeSpcae.gstSVFreespaces[21].Is_Valid CtApImageProcess_FreeRunning.PpImageProcess_FreeSpace_60ms.DeFreeSpcae.gstSVFreespaces[21].Existence_Prob CtApImageProcess_FreeRunning.PpImageProcess_FreeSpace_60ms.DeFreeSpcae.gstSVFreespaces[21].Classification_Conf CtApImageProcess_FreeRunning.PpImageProcess_FreeSpace_60ms.DeFreeSpcae.gstSVFreespaces[21].Classification_Type CtApImageProcess_FreeRunning.PpImageProcess_FreeSpace_60ms.DeFreeSpcae.gstSVFreespaces[21].fPointX CtApImageProcess_FreeRunning.PpImageProcess_FreeSpace_60ms.DeFreeSpcae.gstSVFreespaces[21].fPointY CtApImageProcess_FreeRunning.PpImageProcess_FreeSpace_60ms.DeFreeSpcae.gstSVFreespaces[21].fPointZ CtApImageProcess_FreeRunning.PpImageProcess_FreeSpace_60ms.DeFreeSpcae.gstSVFreespaces[22].stHeader.Counter CtApImageProcess_FreeRunning.PpImageProcess_FreeSpace_60ms.DeFreeSpcae.gstSVFreespaces[22].stHeader.FrameID CtApImageProcess_FreeRunning.PpImageProcess_FreeSpace_60ms.DeFreeSpcae.gstSVFreespaces[22].stHeader.TimeStamp CtApImageProcess_FreeRunning.PpImageProcess_FreeSpace_60ms.DeFreeSpcae.gstSVFreespaces[22].Is_Valid CtApImageProcess_FreeRunning.PpImageProcess_FreeSpace_60ms.DeFreeSpcae.gstSVFreespaces[22].Existence_Prob CtApImageProcess_FreeRunning.PpImageProcess_FreeSpace_60ms.DeFreeSpcae.gstSVFreespaces[22].Classification_Conf CtApImageProcess_FreeRunning.PpImageProcess_FreeSpace_60ms.DeFreeSpcae.gstSVFreespaces[22].Classification_Type CtApImageProcess_FreeRunning.PpImageProcess_FreeSpace_60ms.DeFreeSpcae.gstSVFreespaces[22].fPointX CtApImageProcess_FreeRunning.PpImageProcess_FreeSpace_60ms.DeFreeSpcae.gstSVFreespaces[22].fPointY CtApImageProcess_FreeRunning.PpImageProcess_FreeSpace_60ms.DeFreeSpcae.gstSVFreespaces[22].fPointZ CtApImageProcess_FreeRunning.PpImageProcess_FreeSpace_60ms.DeFreeSpcae.gstSVFreespaces[23].stHeader.Counter CtApImageProcess_FreeRunning.PpImageProcess_FreeSpace_60ms.DeFreeSpcae.gstSVFreespaces[23].stHeader.FrameID CtApImageProcess_FreeRunning.PpImageProcess_FreeSpace_60ms.DeFreeSpcae.gstSVFreespaces[23].stHeader.TimeStamp CtApImageProcess_FreeRunning.PpImageProcess_FreeSpace_60ms.DeFreeSpcae.gstSVFreespaces[23].Is_Valid CtApImageProcess_FreeRunning.PpImageProcess_FreeSpace_60ms.DeFreeSpcae.gstSVFreespaces[23].Existence_Prob CtApImageProcess_FreeRunning.PpImageProcess_FreeSpace_60ms.DeFreeSpcae.gstSVFreespaces[23].Classification_Conf CtApImageProcess_FreeRunning.PpImageProcess_FreeSpace_60ms.DeFreeSpcae.gstSVFreespaces[23].Classification_Type CtApImageProcess_FreeRunning.PpImageProcess_FreeSpace_60ms.DeFreeSpcae.gstSVFreespaces[23].fPointX CtApImageProcess_FreeRunning.PpImageProcess_FreeSpace_60ms.DeFreeSpcae.gstSVFreespaces[23].fPointY CtApImageProcess_FreeRunning.PpImageProcess_FreeSpace_60ms.DeFreeSpcae.gstSVFreespaces[23].fPointZ CtApImageProcess_FreeRunning.PpImageProcess_FreeSpace_60ms.DeFreeSpcae.gstSVFreespaces[24].stHeader.Counter CtApImageProcess_FreeRunning.PpImageProcess_FreeSpace_60ms.DeFreeSpcae.gstSVFreespaces[24].stHeader.FrameID CtApImageProcess_FreeRunning.PpImageProcess_FreeSpace_60ms.DeFreeSpcae.gstSVFreespaces[24].stHeader.TimeStamp CtApImageProcess_FreeRunning.PpImageProcess_FreeSpace_60ms.DeFreeSpcae.gstSVFreespaces[24].Is_Valid CtApImageProcess_FreeRunning.PpImageProcess_FreeSpace_60ms.DeFreeSpcae.gstSVFreespaces[24].Existence_Prob CtApImageProcess_FreeRunning.PpImageProcess_FreeSpace_60ms.DeFreeSpcae.gstSVFreespaces[24].Classification_Conf CtApImageProcess_FreeRunning.PpImageProcess_FreeSpace_60ms.DeFreeSpcae.gstSVFreespaces[24].Classification_Type CtApImageProcess_FreeRunning.PpImageProcess_FreeSpace_60ms.DeFreeSpcae.gstSVFreespaces[24].fPointX CtApImageProcess_FreeRunning.PpImageProcess_FreeSpace_60ms.DeFreeSpcae.gstSVFreespaces[24].fPointY CtApImageProcess_FreeRunning.PpImageProcess_FreeSpace_60ms.DeFreeSpcae.gstSVFreespaces[24].fPointZ CtApImageProcess_FreeRunning.PpImageProcess_FreeSpace_60ms.DeFreeSpcae.gstSVFreespaces[25].stHeader.Counter CtApImageProcess_FreeRunning.PpImageProcess_FreeSpace_60ms.DeFreeSpcae.gstSVFreespaces[25].stHeader.FrameID CtApImageProcess_FreeRunning.PpImageProcess_FreeSpace_60ms.DeFreeSpcae.gstSVFreespaces[25].stHeader.TimeStamp CtApImageProcess_FreeRunning.PpImageProcess_FreeSpace_60ms.DeFreeSpcae.gstSVFreespaces[25].Is_Valid CtApImageProcess_FreeRunning.PpImageProcess_FreeSpace_60ms.DeFreeSpcae.gstSVFreespaces[25].Existence_Prob CtApImageProcess_FreeRunning.PpImageProcess_FreeSpace_60ms.DeFreeSpcae.gstSVFreespaces[25].Classification_Conf CtApImageProcess_FreeRunning.PpImageProcess_FreeSpace_60ms.DeFreeSpcae.gstSVFreespaces[25].Classification_Type CtApImageProcess_FreeRunning.PpImageProcess_FreeSpace_60ms.DeFreeSpcae.gstSVFreespaces[25].fPointX CtApImageProcess_FreeRunning.PpImageProcess_FreeSpace_60ms.DeFreeSpcae.gstSVFreespaces[25].fPointY CtApImageProcess_FreeRunning.PpImageProcess_FreeSpace_60ms.DeFreeSpcae.gstSVFreespaces[25].fPointZ CtApImageProcess_FreeRunning.PpImageProcess_FreeSpace_60ms.DeFreeSpcae.gstSVFreespaces[26].stHeader.Counter CtApImageProcess_FreeRunning.PpImageProcess_FreeSpace_60ms.DeFreeSpcae.gstSVFreespaces[26].stHeader.FrameID CtApImageProcess_FreeRunning.PpImageProcess_FreeSpace_60ms.DeFreeSpcae.gstSVFreespaces[26].stHeader.TimeStamp CtApImageProcess_FreeRunning.PpImageProcess_FreeSpace_60ms.DeFreeSpcae.gstSVFreespaces[26].Is_Valid CtApImageProcess_FreeRunning.PpImageProcess_FreeSpace_60ms.DeFreeSpcae.gstSVFreespaces[26].Existence_Prob CtApImageProcess_FreeRunning.PpImageProcess_FreeSpace_60ms.DeFreeSpcae.gstSVFreespaces[26].Classification_Conf CtApImageProcess_FreeRunning.PpImageProcess_FreeSpace_60ms.DeFreeSpcae.gstSVFreespaces[26].Classification_Type CtApImageProcess_FreeRunning.PpImageProcess_FreeSpace_60ms.DeFreeSpcae.gstSVFreespaces[26].fPointX CtApImageProcess_FreeRunning.PpImageProcess_FreeSpace_60ms.DeFreeSpcae.gstSVFreespaces[26].fPointY CtApImageProcess_FreeRunning.PpImageProcess_FreeSpace_60ms.DeFreeSpcae.gstSVFreespaces[26].fPointZ CtApImageProcess_FreeRunning.PpImageProcess_FreeSpace_60ms.DeFreeSpcae.gstSVFreespaces[27].stHeader.Counter CtApImageProcess_FreeRunning.PpImageProcess_FreeSpace_60ms.DeFreeSpcae.gstSVFreespaces[27].stHeader.FrameID CtApImageProcess_FreeRunning.PpImageProcess_FreeSpace_60ms.DeFreeSpcae.gstSVFreespaces[27].stHeader.TimeStamp CtApImageProcess_FreeRunning.PpImageProcess_FreeSpace_60ms.DeFreeSpcae.gstSVFreespaces[27].Is_Valid CtApImageProcess_FreeRunning.PpImageProcess_FreeSpace_60ms.DeFreeSpcae.gstSVFreespaces[27].Existence_Prob CtApImageProcess_FreeRunning.PpImageProcess_FreeSpace_60ms.DeFreeSpcae.gstSVFreespaces[27].Classification_Conf CtApImageProcess_FreeRunning.PpImageProcess_FreeSpace_60ms.DeFreeSpcae.gstSVFreespaces[27].Classification_Type CtApImageProcess_FreeRunning.PpImageProcess_FreeSpace_60ms.DeFreeSpcae.gstSVFreespaces[27].fPointX CtApImageProcess_FreeRunning.PpImageProcess_FreeSpace_60ms.DeFreeSpcae.gstSVFreespaces[27].fPointY CtApImageProcess_FreeRunning.PpImageProcess_FreeSpace_60ms.DeFreeSpcae.gstSVFreespaces[27].fPointZ CtApImageProcess_FreeRunning.PpImageProcess_FreeSpace_60ms.DeFreeSpcae.gstSVFreespaces[28].stHeader.Counter CtApImageProcess_FreeRunning.PpImageProcess_FreeSpace_60ms.DeFreeSpcae.gstSVFreespaces[28].stHeader.FrameID CtApImageProcess_FreeRunning.PpImageProcess_FreeSpace_60ms.DeFreeSpcae.gstSVFreespaces[28].stHeader.TimeStamp CtApImageProcess_FreeRunning.PpImageProcess_FreeSpace_60ms.DeFreeSpcae.gstSVFreespaces[28].Is_Valid CtApImageProcess_FreeRunning.PpImageProcess_FreeSpace_60ms.DeFreeSpcae.gstSVFreespaces[28].Existence_Prob CtApImageProcess_FreeRunning.PpImageProcess_FreeSpace_60ms.DeFreeSpcae.gstSVFreespaces[28].Classification_Conf CtApImageProcess_FreeRunning.PpImageProcess_FreeSpace_60ms.DeFreeSpcae.gstSVFreespaces[28].Classification_Type CtApImageProcess_FreeRunning.PpImageProcess_FreeSpace_60ms.DeFreeSpcae.gstSVFreespaces[28].fPointX CtApImageProcess_FreeRunning.PpImageProcess_FreeSpace_60ms.DeFreeSpcae.gstSVFreespaces[28].fPointY CtApImageProcess_FreeRunning.PpImageProcess_FreeSpace_60ms.DeFreeSpcae.gstSVFreespaces[28].fPointZ CtApImageProcess_FreeRunning.PpImageProcess_FreeSpace_60ms.DeFreeSpcae.gstSVFreespaces[29].stHeader.Counter CtApImageProcess_FreeRunning.PpImageProcess_FreeSpace_60ms.DeFreeSpcae.gstSVFreespaces[29].stHeader.FrameID CtApImageProcess_FreeRunning.PpImageProcess_FreeSpace_60ms.DeFreeSpcae.gstSVFreespaces[29].stHeader.TimeStamp CtApImageProcess_FreeRunning.PpImageProcess_FreeSpace_60ms.DeFreeSpcae.gstSVFreespaces[29].Is_Valid CtApImageProcess_FreeRunning.PpImageProcess_FreeSpace_60ms.DeFreeSpcae.gstSVFreespaces[29].Existence_Prob CtApImageProcess_FreeRunning.PpImageProcess_FreeSpace_60ms.DeFreeSpcae.gstSVFreespaces[29].Classification_Conf CtApImageProcess_FreeRunning.PpImageProcess_FreeSpace_60ms.DeFreeSpcae.gstSVFreespaces[29].Classification_Type CtApImageProcess_FreeRunning.PpImageProcess_FreeSpace_60ms.DeFreeSpcae.gstSVFreespaces[29].fPointX CtApImageProcess_FreeRunning.PpImageProcess_FreeSpace_60ms.DeFreeSpcae.gstSVFreespaces[29].fPointY CtApImageProcess_FreeRunning.PpImageProcess_FreeSpace_60ms.DeFreeSpcae.gstSVFreespaces[29].fPointZ CtApImageProcess_FreeRunning.PpImageProcess_FreeSpace_60ms.DeFreeSpcae.gstSVFreespaces[30].stHeader.Counter CtApImageProcess_FreeRunning.PpImageProcess_FreeSpace_60ms.DeFreeSpcae.gstSVFreespaces[30].stHeader.FrameID CtApImageProcess_FreeRunning.PpImageProcess_FreeSpace_60ms.DeFreeSpcae.gstSVFreespaces[30].stHeader.TimeStamp CtApImageProcess_FreeRunning.PpImageProcess_FreeSpace_60ms.DeFreeSpcae.gstSVFreespaces[30].Is_Valid CtApImageProcess_FreeRunning.PpImageProcess_FreeSpace_60ms.DeFreeSpcae.gstSVFreespaces[30].Existence_Prob CtApImageProcess_FreeRunning.PpImageProcess_FreeSpace_60ms.DeFreeSpcae.gstSVFreespaces[30].Classification_Conf CtApImageProcess_FreeRunning.PpImageProcess_FreeSpace_60ms.DeFreeSpcae.gstSVFreespaces[30].Classification_Type CtApImageProcess_FreeRunning.PpImageProcess_FreeSpace_60ms.DeFreeSpcae.gstSVFreespaces[30].fPointX CtApImageProcess_FreeRunning.PpImageProcess_FreeSpace_60ms.DeFreeSpcae.gstSVFreespaces[30].fPointY CtApImageProcess_FreeRunning.PpImageProcess_FreeSpace_60ms.DeFreeSpcae.gstSVFreespaces[30].fPointZ CtApImageProcess_FreeRunning.PpImageProcess_FreeSpace_60ms.DeFreeSpcae.gstSVFreespaces[31].stHeader.Counter /end REF_CHARACTERISTIC
/end GROUP
/begin RECORD_LAYOUT __UBYTE_S FNC_VALUES 1 UBYTE COLUMN_DIR DIRECT /end RECORD_LAYOUT
/begin RECORD_LAYOUT __UWORD_S FNC_VALUES 1 UWORD COLUMN_DIR DIRECT /end RECORD_LAYOUT
/begin RECORD_LAYOUT __ULONG_S FNC_VALUES 1 ULONG COLUMN_DIR DIRECT /end RECORD_LAYOUT
/begin RECORD_LAYOUT __SBYTE_S FNC_VALUES 1 SBYTE COLUMN_DIR DIRECT /end RECORD_LAYOUT
/begin RECORD_LAYOUT __FLOAT32_IEEE_S FNC_VALUES 1 FLOAT32_IEEE COLUMN_DIR DIRECT /end RECORD_LAYOUT
/end MODULE
/end PROJECT
