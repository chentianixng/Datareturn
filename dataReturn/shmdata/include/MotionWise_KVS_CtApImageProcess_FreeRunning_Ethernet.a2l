ASAP2_VERSION 1 61
/begin PROJECT MotionWise_PerformanceHost00_XCPonEthernet ""
/begin MODULE CPP ""
/begin MOD_COMMON "" BYTE_ORDER MSB_LAST ALIGNMENT_BYTE 1 ALIGNMENT_WORD 2 ALIGNMENT_LONG 4 ALIGNMENT_INT64 1 ALIGNMENT_FLOAT32_IEEE 4 ALIGNMENT_FLOAT64_IEEE 8 /end MOD_COMMON
/begin CHARACTERISTIC CtApImageProcess_FreeRunning.PpImageProcess_ParkingLot_20ms.DeSVParkingSlot.gstSpaceLeft[1].fLineWith "" VALUE 0x3d04c0 __FLOAT32_IEEE_S 0 NO_COMPU_METHOD 0 3.402823e+38 ECU_ADDRESS_EXTENSION 0x80 /end CHARACTERISTIC
/begin CHARACTERISTIC CtApImageProcess_FreeRunning.PpImageProcess_ParkingLot_20ms.DeSVParkingSlot.gstSpaceLeft[1].fSita "" VALUE 0x3d04c4 __FLOAT32_IEEE_S 0 NO_COMPU_METHOD 0 3.402823e+38 ECU_ADDRESS_EXTENSION 0x80 /end CHARACTERISTIC
/begin CHARACTERISTIC CtApImageProcess_FreeRunning.PpImageProcess_ParkingLot_20ms.DeSVParkingSlot.gstSpaceLeft[1].fIdentifierNum "2 uint32 array" VAL_BLK 0x3d04c8 __ULONG_S 0 NO_COMPU_METHOD 0 4294967295 ECU_ADDRESS_EXTENSION 0x80 MATRIX_DIM 2 1 1 /end CHARACTERISTIC
/begin CHARACTERISTIC CtApImageProcess_FreeRunning.PpImageProcess_ParkingLot_20ms.DeSVParkingSlot.gstSpaceLeft[1].fReserved "12 uint8 array" VAL_BLK 0x3d04d0 __UBYTE_S 0 NO_COMPU_METHOD 0 255 ECU_ADDRESS_EXTENSION 0x80 MATRIX_DIM 12 1 1 /end CHARACTERISTIC
/begin CHARACTERISTIC CtApImageProcess_FreeRunning.PpImageProcess_ParkingLot_20ms.DeSVParkingSlot.gstSpaceLeft[2].nValid "" VALUE 0x3d04dc __UBYTE_S 0 NO_COMPU_METHOD 0 255 ECU_ADDRESS_EXTENSION 0x80 /end CHARACTERISTIC
/begin CHARACTERISTIC CtApImageProcess_FreeRunning.PpImageProcess_ParkingLot_20ms.DeSVParkingSlot.gstSpaceLeft[2].gfPos[0] "2 float32 array" VAL_BLK 0x3d04e0 __FLOAT32_IEEE_S 0 NO_COMPU_METHOD 0 3.402823e+38 ECU_ADDRESS_EXTENSION 0x80 MATRIX_DIM 2 1 1 /end CHARACTERISTIC
/begin CHARACTERISTIC CtApImageProcess_FreeRunning.PpImageProcess_ParkingLot_20ms.DeSVParkingSlot.gstSpaceLeft[2].gfPos[1] "2 float32 array" VAL_BLK 0x3d04e8 __FLOAT32_IEEE_S 0 NO_COMPU_METHOD 0 3.402823e+38 ECU_ADDRESS_EXTENSION 0x80 MATRIX_DIM 2 1 1 /end CHARACTERISTIC
/begin CHARACTERISTIC CtApImageProcess_FreeRunning.PpImageProcess_ParkingLot_20ms.DeSVParkingSlot.gstSpaceLeft[2].gfPos[2] "2 float32 array" VAL_BLK 0x3d04f0 __FLOAT32_IEEE_S 0 NO_COMPU_METHOD 0 3.402823e+38 ECU_ADDRESS_EXTENSION 0x80 MATRIX_DIM 2 1 1 /end CHARACTERISTIC
/begin CHARACTERISTIC CtApImageProcess_FreeRunning.PpImageProcess_ParkingLot_20ms.DeSVParkingSlot.gstSpaceLeft[2].gfPos[3] "2 float32 array" VAL_BLK 0x3d04f8 __FLOAT32_IEEE_S 0 NO_COMPU_METHOD 0 3.402823e+38 ECU_ADDRESS_EXTENSION 0x80 MATRIX_DIM 2 1 1 /end CHARACTERISTIC
/begin CHARACTERISTIC CtApImageProcess_FreeRunning.PpImageProcess_ParkingLot_20ms.DeSVParkingSlot.gstSpaceLeft[2].nQuality "" VALUE 0x3d0500 __UBYTE_S 0 NO_COMPU_METHOD 0 255 ECU_ADDRESS_EXTENSION 0x80 /end CHARACTERISTIC
/begin CHARACTERISTIC CtApImageProcess_FreeRunning.PpImageProcess_ParkingLot_20ms.DeSVParkingSlot.gstSpaceLeft[2].nType "" VALUE 0x3d0501 __UBYTE_S 0 NO_COMPU_METHOD 0 255 ECU_ADDRESS_EXTENSION 0x80 /end CHARACTERISTIC
/begin CHARACTERISTIC CtApImageProcess_FreeRunning.PpImageProcess_ParkingLot_20ms.DeSVParkingSlot.gstSpaceLeft[2].nParkingGarageID "" VALUE 0x3d0502 __UBYTE_S 0 NO_COMPU_METHOD 0 255 ECU_ADDRESS_EXTENSION 0x80 /end CHARACTERISTIC
/begin CHARACTERISTIC CtApImageProcess_FreeRunning.PpImageProcess_ParkingLot_20ms.DeSVParkingSlot.gstSpaceLeft[2].fLineWith "" VALUE 0x3d0504 __FLOAT32_IEEE_S 0 NO_COMPU_METHOD 0 3.402823e+38 ECU_ADDRESS_EXTENSION 0x80 /end CHARACTERISTIC
/begin CHARACTERISTIC CtApImageProcess_FreeRunning.PpImageProcess_ParkingLot_20ms.DeSVParkingSlot.gstSpaceLeft[2].fSita "" VALUE 0x3d0508 __FLOAT32_IEEE_S 0 NO_COMPU_METHOD 0 3.402823e+38 ECU_ADDRESS_EXTENSION 0x80 /end CHARACTERISTIC
/begin CHARACTERISTIC CtApImageProcess_FreeRunning.PpImageProcess_ParkingLot_20ms.DeSVParkingSlot.gstSpaceLeft[2].fIdentifierNum "2 uint32 array" VAL_BLK 0x3d050c __ULONG_S 0 NO_COMPU_METHOD 0 4294967295 ECU_ADDRESS_EXTENSION 0x80 MATRIX_DIM 2 1 1 /end CHARACTERISTIC
/begin CHARACTERISTIC CtApImageProcess_FreeRunning.PpImageProcess_ParkingLot_20ms.DeSVParkingSlot.gstSpaceLeft[2].fReserved "12 uint8 array" VAL_BLK 0x3d0514 __UBYTE_S 0 NO_COMPU_METHOD 0 255 ECU_ADDRESS_EXTENSION 0x80 MATRIX_DIM 12 1 1 /end CHARACTERISTIC
/begin CHARACTERISTIC CtApImageProcess_FreeRunning.PpImageProcess_ParkingLot_20ms.DeSVParkingSlot.gstSpaceLeft[3].nValid "" VALUE 0x3d0520 __UBYTE_S 0 NO_COMPU_METHOD 0 255 ECU_ADDRESS_EXTENSION 0x80 /end CHARACTERISTIC
/begin CHARACTERISTIC CtApImageProcess_FreeRunning.PpImageProcess_ParkingLot_20ms.DeSVParkingSlot.gstSpaceLeft[3].gfPos[0] "2 float32 array" VAL_BLK 0x3d0524 __FLOAT32_IEEE_S 0 NO_COMPU_METHOD 0 3.402823e+38 ECU_ADDRESS_EXTENSION 0x80 MATRIX_DIM 2 1 1 /end CHARACTERISTIC
/begin CHARACTERISTIC CtApImageProcess_FreeRunning.PpImageProcess_ParkingLot_20ms.DeSVParkingSlot.gstSpaceLeft[3].gfPos[1] "2 float32 array" VAL_BLK 0x3d052c __FLOAT32_IEEE_S 0 NO_COMPU_METHOD 0 3.402823e+38 ECU_ADDRESS_EXTENSION 0x80 MATRIX_DIM 2 1 1 /end CHARACTERISTIC
/begin CHARACTERISTIC CtApImageProcess_FreeRunning.PpImageProcess_ParkingLot_20ms.DeSVParkingSlot.gstSpaceLeft[3].gfPos[2] "2 float32 array" VAL_BLK 0x3d0534 __FLOAT32_IEEE_S 0 NO_COMPU_METHOD 0 3.402823e+38 ECU_ADDRESS_EXTENSION 0x80 MATRIX_DIM 2 1 1 /end CHARACTERISTIC
/begin CHARACTERISTIC CtApImageProcess_FreeRunning.PpImageProcess_ParkingLot_20ms.DeSVParkingSlot.gstSpaceLeft[3].gfPos[3] "2 float32 array" VAL_BLK 0x3d053c __FLOAT32_IEEE_S 0 NO_COMPU_METHOD 0 3.402823e+38 ECU_ADDRESS_EXTENSION 0x80 MATRIX_DIM 2 1 1 /end CHARACTERISTIC
/begin CHARACTERISTIC CtApImageProcess_FreeRunning.PpImageProcess_ParkingLot_20ms.DeSVParkingSlot.gstSpaceLeft[3].nQuality "" VALUE 0x3d0544 __UBYTE_S 0 NO_COMPU_METHOD 0 255 ECU_ADDRESS_EXTENSION 0x80 /end CHARACTERISTIC
/begin CHARACTERISTIC CtApImageProcess_FreeRunning.PpImageProcess_ParkingLot_20ms.DeSVParkingSlot.gstSpaceLeft[3].nType "" VALUE 0x3d0545 __UBYTE_S 0 NO_COMPU_METHOD 0 255 ECU_ADDRESS_EXTENSION 0x80 /end CHARACTERISTIC
/begin CHARACTERISTIC CtApImageProcess_FreeRunning.PpImageProcess_ParkingLot_20ms.DeSVParkingSlot.gstSpaceLeft[3].nParkingGarageID "" VALUE 0x3d0546 __UBYTE_S 0 NO_COMPU_METHOD 0 255 ECU_ADDRESS_EXTENSION 0x80 /end CHARACTERISTIC
/begin CHARACTERISTIC CtApImageProcess_FreeRunning.PpImageProcess_ParkingLot_20ms.DeSVParkingSlot.gstSpaceLeft[3].fLineWith "" VALUE 0x3d0548 __FLOAT32_IEEE_S 0 NO_COMPU_METHOD 0 3.402823e+38 ECU_ADDRESS_EXTENSION 0x80 /end CHARACTERISTIC
/begin CHARACTERISTIC CtApImageProcess_FreeRunning.PpImageProcess_ParkingLot_20ms.DeSVParkingSlot.gstSpaceLeft[3].fSita "" VALUE 0x3d054c __FLOAT32_IEEE_S 0 NO_COMPU_METHOD 0 3.402823e+38 ECU_ADDRESS_EXTENSION 0x80 /end CHARACTERISTIC
/begin CHARACTERISTIC CtApImageProcess_FreeRunning.PpImageProcess_ParkingLot_20ms.DeSVParkingSlot.gstSpaceLeft[3].fIdentifierNum "2 uint32 array" VAL_BLK 0x3d0550 __ULONG_S 0 NO_COMPU_METHOD 0 4294967295 ECU_ADDRESS_EXTENSION 0x80 MATRIX_DIM 2 1 1 /end CHARACTERISTIC
/begin CHARACTERISTIC CtApImageProcess_FreeRunning.PpImageProcess_ParkingLot_20ms.DeSVParkingSlot.gstSpaceLeft[3].fReserved "12 uint8 array" VAL_BLK 0x3d0558 __UBYTE_S 0 NO_COMPU_METHOD 0 255 ECU_ADDRESS_EXTENSION 0x80 MATRIX_DIM 12 1 1 /end CHARACTERISTIC
/begin CHARACTERISTIC CtApImageProcess_FreeRunning.PpImageProcess_ParkingLot_20ms.DeSVParkingSlot.gstSpaceLeft[4].nValid "" VALUE 0x3d0564 __UBYTE_S 0 NO_COMPU_METHOD 0 255 ECU_ADDRESS_EXTENSION 0x80 /end CHARACTERISTIC
/begin CHARACTERISTIC CtApImageProcess_FreeRunning.PpImageProcess_ParkingLot_20ms.DeSVParkingSlot.gstSpaceLeft[4].gfPos[0] "2 float32 array" VAL_BLK 0x3d0568 __FLOAT32_IEEE_S 0 NO_COMPU_METHOD 0 3.402823e+38 ECU_ADDRESS_EXTENSION 0x80 MATRIX_DIM 2 1 1 /end CHARACTERISTIC
/begin CHARACTERISTIC CtApImageProcess_FreeRunning.PpImageProcess_ParkingLot_20ms.DeSVParkingSlot.gstSpaceLeft[4].gfPos[1] "2 float32 array" VAL_BLK 0x3d0570 __FLOAT32_IEEE_S 0 NO_COMPU_METHOD 0 3.402823e+38 ECU_ADDRESS_EXTENSION 0x80 MATRIX_DIM 2 1 1 /end CHARACTERISTIC
/begin CHARACTERISTIC CtApImageProcess_FreeRunning.PpImageProcess_ParkingLot_20ms.DeSVParkingSlot.gstSpaceLeft[4].gfPos[2] "2 float32 array" VAL_BLK 0x3d0578 __FLOAT32_IEEE_S 0 NO_COMPU_METHOD 0 3.402823e+38 ECU_ADDRESS_EXTENSION 0x80 MATRIX_DIM 2 1 1 /end CHARACTERISTIC
/begin CHARACTERISTIC CtApImageProcess_FreeRunning.PpImageProcess_ParkingLot_20ms.DeSVParkingSlot.gstSpaceLeft[4].gfPos[3] "2 float32 array" VAL_BLK 0x3d0580 __FLOAT32_IEEE_S 0 NO_COMPU_METHOD 0 3.402823e+38 ECU_ADDRESS_EXTENSION 0x80 MATRIX_DIM 2 1 1 /end CHARACTERISTIC
/begin CHARACTERISTIC CtApImageProcess_FreeRunning.PpImageProcess_ParkingLot_20ms.DeSVParkingSlot.gstSpaceLeft[4].nQuality "" VALUE 0x3d0588 __UBYTE_S 0 NO_COMPU_METHOD 0 255 ECU_ADDRESS_EXTENSION 0x80 /end CHARACTERISTIC
/begin CHARACTERISTIC CtApImageProcess_FreeRunning.PpImageProcess_ParkingLot_20ms.DeSVParkingSlot.gstSpaceLeft[4].nType "" VALUE 0x3d0589 __UBYTE_S 0 NO_COMPU_METHOD 0 255 ECU_ADDRESS_EXTENSION 0x80 /end CHARACTERISTIC
/begin CHARACTERISTIC CtApImageProcess_FreeRunning.PpImageProcess_ParkingLot_20ms.DeSVParkingSlot.gstSpaceLeft[4].nParkingGarageID "" VALUE 0x3d058a __UBYTE_S 0 NO_COMPU_METHOD 0 255 ECU_ADDRESS_EXTENSION 0x80 /end CHARACTERISTIC
/begin CHARACTERISTIC CtApImageProcess_FreeRunning.PpImageProcess_ParkingLot_20ms.DeSVParkingSlot.gstSpaceLeft[4].fLineWith "" VALUE 0x3d058c __FLOAT32_IEEE_S 0 NO_COMPU_METHOD 0 3.402823e+38 ECU_ADDRESS_EXTENSION 0x80 /end CHARACTERISTIC
/begin CHARACTERISTIC CtApImageProcess_FreeRunning.PpImageProcess_ParkingLot_20ms.DeSVParkingSlot.gstSpaceLeft[4].fSita "" VALUE 0x3d0590 __FLOAT32_IEEE_S 0 NO_COMPU_METHOD 0 3.402823e+38 ECU_ADDRESS_EXTENSION 0x80 /end CHARACTERISTIC
/begin CHARACTERISTIC CtApImageProcess_FreeRunning.PpImageProcess_ParkingLot_20ms.DeSVParkingSlot.gstSpaceLeft[4].fIdentifierNum "2 uint32 array" VAL_BLK 0x3d0594 __ULONG_S 0 NO_COMPU_METHOD 0 4294967295 ECU_ADDRESS_EXTENSION 0x80 MATRIX_DIM 2 1 1 /end CHARACTERISTIC
/begin CHARACTERISTIC CtApImageProcess_FreeRunning.PpImageProcess_ParkingLot_20ms.DeSVParkingSlot.gstSpaceLeft[4].fReserved "12 uint8 array" VAL_BLK 0x3d059c __UBYTE_S 0 NO_COMPU_METHOD 0 255 ECU_ADDRESS_EXTENSION 0x80 MATRIX_DIM 12 1 1 /end CHARACTERISTIC
/begin CHARACTERISTIC CtApImageProcess_FreeRunning.PpImageProcess_ParkingLot_20ms.DeSVParkingSlot.gstSpaceLeft[5].nValid "" VALUE 0x3d05a8 __UBYTE_S 0 NO_COMPU_METHOD 0 255 ECU_ADDRESS_EXTENSION 0x80 /end CHARACTERISTIC
/begin CHARACTERISTIC CtApImageProcess_FreeRunning.PpImageProcess_ParkingLot_20ms.DeSVParkingSlot.gstSpaceLeft[5].gfPos[0] "2 float32 array" VAL_BLK 0x3d05ac __FLOAT32_IEEE_S 0 NO_COMPU_METHOD 0 3.402823e+38 ECU_ADDRESS_EXTENSION 0x80 MATRIX_DIM 2 1 1 /end CHARACTERISTIC
/begin CHARACTERISTIC CtApImageProcess_FreeRunning.PpImageProcess_ParkingLot_20ms.DeSVParkingSlot.gstSpaceLeft[5].gfPos[1] "2 float32 array" VAL_BLK 0x3d05b4 __FLOAT32_IEEE_S 0 NO_COMPU_METHOD 0 3.402823e+38 ECU_ADDRESS_EXTENSION 0x80 MATRIX_DIM 2 1 1 /end CHARACTERISTIC
/begin CHARACTERISTIC CtApImageProcess_FreeRunning.PpImageProcess_ParkingLot_20ms.DeSVParkingSlot.gstSpaceLeft[5].gfPos[2] "2 float32 array" VAL_BLK 0x3d05bc __FLOAT32_IEEE_S 0 NO_COMPU_METHOD 0 3.402823e+38 ECU_ADDRESS_EXTENSION 0x80 MATRIX_DIM 2 1 1 /end CHARACTERISTIC
/begin CHARACTERISTIC CtApImageProcess_FreeRunning.PpImageProcess_ParkingLot_20ms.DeSVParkingSlot.gstSpaceLeft[5].gfPos[3] "2 float32 array" VAL_BLK 0x3d05c4 __FLOAT32_IEEE_S 0 NO_COMPU_METHOD 0 3.402823e+38 ECU_ADDRESS_EXTENSION 0x80 MATRIX_DIM 2 1 1 /end CHARACTERISTIC
/begin CHARACTERISTIC CtApImageProcess_FreeRunning.PpImageProcess_ParkingLot_20ms.DeSVParkingSlot.gstSpaceLeft[5].nQuality "" VALUE 0x3d05cc __UBYTE_S 0 NO_COMPU_METHOD 0 255 ECU_ADDRESS_EXTENSION 0x80 /end CHARACTERISTIC
/begin CHARACTERISTIC CtApImageProcess_FreeRunning.PpImageProcess_ParkingLot_20ms.DeSVParkingSlot.gstSpaceLeft[5].nType "" VALUE 0x3d05cd __UBYTE_S 0 NO_COMPU_METHOD 0 255 ECU_ADDRESS_EXTENSION 0x80 /end CHARACTERISTIC
/begin CHARACTERISTIC CtApImageProcess_FreeRunning.PpImageProcess_ParkingLot_20ms.DeSVParkingSlot.gstSpaceLeft[5].nParkingGarageID "" VALUE 0x3d05ce __UBYTE_S 0 NO_COMPU_METHOD 0 255 ECU_ADDRESS_EXTENSION 0x80 /end CHARACTERISTIC
/begin CHARACTERISTIC CtApImageProcess_FreeRunning.PpImageProcess_ParkingLot_20ms.DeSVParkingSlot.gstSpaceLeft[5].fLineWith "" VALUE 0x3d05d0 __FLOAT32_IEEE_S 0 NO_COMPU_METHOD 0 3.402823e+38 ECU_ADDRESS_EXTENSION 0x80 /end CHARACTERISTIC
/begin CHARACTERISTIC CtApImageProcess_FreeRunning.PpImageProcess_ParkingLot_20ms.DeSVParkingSlot.gstSpaceLeft[5].fSita "" VALUE 0x3d05d4 __FLOAT32_IEEE_S 0 NO_COMPU_METHOD 0 3.402823e+38 ECU_ADDRESS_EXTENSION 0x80 /end CHARACTERISTIC
/begin CHARACTERISTIC CtApImageProcess_FreeRunning.PpImageProcess_ParkingLot_20ms.DeSVParkingSlot.gstSpaceLeft[5].fIdentifierNum "2 uint32 array" VAL_BLK 0x3d05d8 __ULONG_S 0 NO_COMPU_METHOD 0 4294967295 ECU_ADDRESS_EXTENSION 0x80 MATRIX_DIM 2 1 1 /end CHARACTERISTIC
/begin CHARACTERISTIC CtApImageProcess_FreeRunning.PpImageProcess_ParkingLot_20ms.DeSVParkingSlot.gstSpaceLeft[5].fReserved "12 uint8 array" VAL_BLK 0x3d05e0 __UBYTE_S 0 NO_COMPU_METHOD 0 255 ECU_ADDRESS_EXTENSION 0x80 MATRIX_DIM 12 1 1 /end CHARACTERISTIC
/begin CHARACTERISTIC CtApImageProcess_FreeRunning.PpImageProcess_ParkingLot_20ms.DeSVParkingSlot.gstSpaceLeft[6].nValid "" VALUE 0x3d05ec __UBYTE_S 0 NO_COMPU_METHOD 0 255 ECU_ADDRESS_EXTENSION 0x80 /end CHARACTERISTIC
/begin CHARACTERISTIC CtApImageProcess_FreeRunning.PpImageProcess_ParkingLot_20ms.DeSVParkingSlot.gstSpaceLeft[6].gfPos[0] "2 float32 array" VAL_BLK 0x3d05f0 __FLOAT32_IEEE_S 0 NO_COMPU_METHOD 0 3.402823e+38 ECU_ADDRESS_EXTENSION 0x80 MATRIX_DIM 2 1 1 /end CHARACTERISTIC
/begin CHARACTERISTIC CtApImageProcess_FreeRunning.PpImageProcess_ParkingLot_20ms.DeSVParkingSlot.gstSpaceLeft[6].gfPos[1] "2 float32 array" VAL_BLK 0x3d05f8 __FLOAT32_IEEE_S 0 NO_COMPU_METHOD 0 3.402823e+38 ECU_ADDRESS_EXTENSION 0x80 MATRIX_DIM 2 1 1 /end CHARACTERISTIC
/begin CHARACTERISTIC CtApImageProcess_FreeRunning.PpImageProcess_ParkingLot_20ms.DeSVParkingSlot.gstSpaceLeft[6].gfPos[2] "2 float32 array" VAL_BLK 0x3d0600 __FLOAT32_IEEE_S 0 NO_COMPU_METHOD 0 3.402823e+38 ECU_ADDRESS_EXTENSION 0x80 MATRIX_DIM 2 1 1 /end CHARACTERISTIC
/begin CHARACTERISTIC CtApImageProcess_FreeRunning.PpImageProcess_ParkingLot_20ms.DeSVParkingSlot.gstSpaceLeft[6].gfPos[3] "2 float32 array" VAL_BLK 0x3d0608 __FLOAT32_IEEE_S 0 NO_COMPU_METHOD 0 3.402823e+38 ECU_ADDRESS_EXTENSION 0x80 MATRIX_DIM 2 1 1 /end CHARACTERISTIC
/begin CHARACTERISTIC CtApImageProcess_FreeRunning.PpImageProcess_ParkingLot_20ms.DeSVParkingSlot.gstSpaceLeft[6].nQuality "" VALUE 0x3d0610 __UBYTE_S 0 NO_COMPU_METHOD 0 255 ECU_ADDRESS_EXTENSION 0x80 /end CHARACTERISTIC
/begin CHARACTERISTIC CtApImageProcess_FreeRunning.PpImageProcess_ParkingLot_20ms.DeSVParkingSlot.gstSpaceLeft[6].nType "" VALUE 0x3d0611 __UBYTE_S 0 NO_COMPU_METHOD 0 255 ECU_ADDRESS_EXTENSION 0x80 /end CHARACTERISTIC
/begin CHARACTERISTIC CtApImageProcess_FreeRunning.PpImageProcess_ParkingLot_20ms.DeSVParkingSlot.gstSpaceLeft[6].nParkingGarageID "" VALUE 0x3d0612 __UBYTE_S 0 NO_COMPU_METHOD 0 255 ECU_ADDRESS_EXTENSION 0x80 /end CHARACTERISTIC
/begin CHARACTERISTIC CtApImageProcess_FreeRunning.PpImageProcess_ParkingLot_20ms.DeSVParkingSlot.gstSpaceLeft[6].fLineWith "" VALUE 0x3d0614 __FLOAT32_IEEE_S 0 NO_COMPU_METHOD 0 3.402823e+38 ECU_ADDRESS_EXTENSION 0x80 /end CHARACTERISTIC
/begin CHARACTERISTIC CtApImageProcess_FreeRunning.PpImageProcess_ParkingLot_20ms.DeSVParkingSlot.gstSpaceLeft[6].fSita "" VALUE 0x3d0618 __FLOAT32_IEEE_S 0 NO_COMPU_METHOD 0 3.402823e+38 ECU_ADDRESS_EXTENSION 0x80 /end CHARACTERISTIC
/begin CHARACTERISTIC CtApImageProcess_FreeRunning.PpImageProcess_ParkingLot_20ms.DeSVParkingSlot.gstSpaceLeft[6].fIdentifierNum "2 uint32 array" VAL_BLK 0x3d061c __ULONG_S 0 NO_COMPU_METHOD 0 4294967295 ECU_ADDRESS_EXTENSION 0x80 MATRIX_DIM 2 1 1 /end CHARACTERISTIC
/begin CHARACTERISTIC CtApImageProcess_FreeRunning.PpImageProcess_ParkingLot_20ms.DeSVParkingSlot.gstSpaceLeft[6].fReserved "12 uint8 array" VAL_BLK 0x3d0624 __UBYTE_S 0 NO_COMPU_METHOD 0 255 ECU_ADDRESS_EXTENSION 0x80 MATRIX_DIM 12 1 1 /end CHARACTERISTIC
/begin CHARACTERISTIC CtApImageProcess_FreeRunning.PpImageProcess_ParkingLot_20ms.DeSVParkingSlot.gstSpaceLeft[7].nValid "" VALUE 0x3d0630 __UBYTE_S 0 NO_COMPU_METHOD 0 255 ECU_ADDRESS_EXTENSION 0x80 /end CHARACTERISTIC
/begin CHARACTERISTIC CtApImageProcess_FreeRunning.PpImageProcess_ParkingLot_20ms.DeSVParkingSlot.gstSpaceLeft[7].gfPos[0] "2 float32 array" VAL_BLK 0x3d0634 __FLOAT32_IEEE_S 0 NO_COMPU_METHOD 0 3.402823e+38 ECU_ADDRESS_EXTENSION 0x80 MATRIX_DIM 2 1 1 /end CHARACTERISTIC
/begin CHARACTERISTIC CtApImageProcess_FreeRunning.PpImageProcess_ParkingLot_20ms.DeSVParkingSlot.gstSpaceLeft[7].gfPos[1] "2 float32 array" VAL_BLK 0x3d063c __FLOAT32_IEEE_S 0 NO_COMPU_METHOD 0 3.402823e+38 ECU_ADDRESS_EXTENSION 0x80 MATRIX_DIM 2 1 1 /end CHARACTERISTIC
/begin CHARACTERISTIC CtApImageProcess_FreeRunning.PpImageProcess_ParkingLot_20ms.DeSVParkingSlot.gstSpaceLeft[7].gfPos[2] "2 float32 array" VAL_BLK 0x3d0644 __FLOAT32_IEEE_S 0 NO_COMPU_METHOD 0 3.402823e+38 ECU_ADDRESS_EXTENSION 0x80 MATRIX_DIM 2 1 1 /end CHARACTERISTIC
/begin CHARACTERISTIC CtApImageProcess_FreeRunning.PpImageProcess_ParkingLot_20ms.DeSVParkingSlot.gstSpaceLeft[7].gfPos[3] "2 float32 array" VAL_BLK 0x3d064c __FLOAT32_IEEE_S 0 NO_COMPU_METHOD 0 3.402823e+38 ECU_ADDRESS_EXTENSION 0x80 MATRIX_DIM 2 1 1 /end CHARACTERISTIC
/begin CHARACTERISTIC CtApImageProcess_FreeRunning.PpImageProcess_ParkingLot_20ms.DeSVParkingSlot.gstSpaceLeft[7].nQuality "" VALUE 0x3d0654 __UBYTE_S 0 NO_COMPU_METHOD 0 255 ECU_ADDRESS_EXTENSION 0x80 /end CHARACTERISTIC
/begin CHARACTERISTIC CtApImageProcess_FreeRunning.PpImageProcess_ParkingLot_20ms.DeSVParkingSlot.gstSpaceLeft[7].nType "" VALUE 0x3d0655 __UBYTE_S 0 NO_COMPU_METHOD 0 255 ECU_ADDRESS_EXTENSION 0x80 /end CHARACTERISTIC
/begin CHARACTERISTIC CtApImageProcess_FreeRunning.PpImageProcess_ParkingLot_20ms.DeSVParkingSlot.gstSpaceLeft[7].nParkingGarageID "" VALUE 0x3d0656 __UBYTE_S 0 NO_COMPU_METHOD 0 255 ECU_ADDRESS_EXTENSION 0x80 /end CHARACTERISTIC
/begin CHARACTERISTIC CtApImageProcess_FreeRunning.PpImageProcess_ParkingLot_20ms.DeSVParkingSlot.gstSpaceLeft[7].fLineWith "" VALUE 0x3d0658 __FLOAT32_IEEE_S 0 NO_COMPU_METHOD 0 3.402823e+38 ECU_ADDRESS_EXTENSION 0x80 /end CHARACTERISTIC
/begin CHARACTERISTIC CtApImageProcess_FreeRunning.PpImageProcess_ParkingLot_20ms.DeSVParkingSlot.gstSpaceLeft[7].fSita "" VALUE 0x3d065c __FLOAT32_IEEE_S 0 NO_COMPU_METHOD 0 3.402823e+38 ECU_ADDRESS_EXTENSION 0x80 /end CHARACTERISTIC
/begin CHARACTERISTIC CtApImageProcess_FreeRunning.PpImageProcess_ParkingLot_20ms.DeSVParkingSlot.gstSpaceLeft[7].fIdentifierNum "2 uint32 array" VAL_BLK 0x3d0660 __ULONG_S 0 NO_COMPU_METHOD 0 4294967295 ECU_ADDRESS_EXTENSION 0x80 MATRIX_DIM 2 1 1 /end CHARACTERISTIC
/begin CHARACTERISTIC CtApImageProcess_FreeRunning.PpImageProcess_ParkingLot_20ms.DeSVParkingSlot.gstSpaceLeft[7].fReserved "12 uint8 array" VAL_BLK 0x3d0668 __UBYTE_S 0 NO_COMPU_METHOD 0 255 ECU_ADDRESS_EXTENSION 0x80 MATRIX_DIM 12 1 1 /end CHARACTERISTIC
/begin CHARACTERISTIC CtApImageProcess_FreeRunning.PpImageProcess_ParkingLot_20ms.DeSVParkingSlot.gstSpaceRear[0].nValid "" VALUE 0x3d0674 __UBYTE_S 0 NO_COMPU_METHOD 0 255 ECU_ADDRESS_EXTENSION 0x80 /end CHARACTERISTIC
/begin CHARACTERISTIC CtApImageProcess_FreeRunning.PpImageProcess_ParkingLot_20ms.DeSVParkingSlot.gstSpaceRear[0].gfPos[0] "2 float32 array" VAL_BLK 0x3d0678 __FLOAT32_IEEE_S 0 NO_COMPU_METHOD 0 3.402823e+38 ECU_ADDRESS_EXTENSION 0x80 MATRIX_DIM 2 1 1 /end CHARACTERISTIC
/begin CHARACTERISTIC CtApImageProcess_FreeRunning.PpImageProcess_ParkingLot_20ms.DeSVParkingSlot.gstSpaceRear[0].gfPos[1] "2 float32 array" VAL_BLK 0x3d0680 __FLOAT32_IEEE_S 0 NO_COMPU_METHOD 0 3.402823e+38 ECU_ADDRESS_EXTENSION 0x80 MATRIX_DIM 2 1 1 /end CHARACTERISTIC
/begin CHARACTERISTIC CtApImageProcess_FreeRunning.PpImageProcess_ParkingLot_20ms.DeSVParkingSlot.gstSpaceRear[0].gfPos[2] "2 float32 array" VAL_BLK 0x3d0688 __FLOAT32_IEEE_S 0 NO_COMPU_METHOD 0 3.402823e+38 ECU_ADDRESS_EXTENSION 0x80 MATRIX_DIM 2 1 1 /end CHARACTERISTIC
/begin CHARACTERISTIC CtApImageProcess_FreeRunning.PpImageProcess_ParkingLot_20ms.DeSVParkingSlot.gstSpaceRear[0].gfPos[3] "2 float32 array" VAL_BLK 0x3d0690 __FLOAT32_IEEE_S 0 NO_COMPU_METHOD 0 3.402823e+38 ECU_ADDRESS_EXTENSION 0x80 MATRIX_DIM 2 1 1 /end CHARACTERISTIC
/begin CHARACTERISTIC CtApImageProcess_FreeRunning.PpImageProcess_ParkingLot_20ms.DeSVParkingSlot.gstSpaceRear[0].nQuality "" VALUE 0x3d0698 __UBYTE_S 0 NO_COMPU_METHOD 0 255 ECU_ADDRESS_EXTENSION 0x80 /end CHARACTERISTIC
/begin CHARACTERISTIC CtApImageProcess_FreeRunning.PpImageProcess_ParkingLot_20ms.DeSVParkingSlot.gstSpaceRear[0].nType "" VALUE 0x3d0699 __UBYTE_S 0 NO_COMPU_METHOD 0 255 ECU_ADDRESS_EXTENSION 0x80 /end CHARACTERISTIC
/begin CHARACTERISTIC CtApImageProcess_FreeRunning.PpImageProcess_ParkingLot_20ms.DeSVParkingSlot.gstSpaceRear[0].nParkingGarageID "" VALUE 0x3d069a __UBYTE_S 0 NO_COMPU_METHOD 0 255 ECU_ADDRESS_EXTENSION 0x80 /end CHARACTERISTIC
/begin CHARACTERISTIC CtApImageProcess_FreeRunning.PpImageProcess_ParkingLot_20ms.DeSVParkingSlot.gstSpaceRear[0].fLineWith "" VALUE 0x3d069c __FLOAT32_IEEE_S 0 NO_COMPU_METHOD 0 3.402823e+38 ECU_ADDRESS_EXTENSION 0x80 /end CHARACTERISTIC
/begin CHARACTERISTIC CtApImageProcess_FreeRunning.PpImageProcess_ParkingLot_20ms.DeSVParkingSlot.gstSpaceRear[0].fSita "" VALUE 0x3d06a0 __FLOAT32_IEEE_S 0 NO_COMPU_METHOD 0 3.402823e+38 ECU_ADDRESS_EXTENSION 0x80 /end CHARACTERISTIC
/begin CHARACTERISTIC CtApImageProcess_FreeRunning.PpImageProcess_ParkingLot_20ms.DeSVParkingSlot.gstSpaceRear[0].fIdentifierNum "2 uint32 array" VAL_BLK 0x3d06a4 __ULONG_S 0 NO_COMPU_METHOD 0 4294967295 ECU_ADDRESS_EXTENSION 0x80 MATRIX_DIM 2 1 1 /end CHARACTERISTIC
/begin CHARACTERISTIC CtApImageProcess_FreeRunning.PpImageProcess_ParkingLot_20ms.DeSVParkingSlot.gstSpaceRear[0].fReserved "12 uint8 array" VAL_BLK 0x3d06ac __UBYTE_S 0 NO_COMPU_METHOD 0 255 ECU_ADDRESS_EXTENSION 0x80 MATRIX_DIM 12 1 1 /end CHARACTERISTIC
/begin CHARACTERISTIC CtApImageProcess_FreeRunning.PpImageProcess_ParkingLot_20ms.DeSVParkingSlot.gstSpaceRear[1].nValid "" VALUE 0x3d06b8 __UBYTE_S 0 NO_COMPU_METHOD 0 255 ECU_ADDRESS_EXTENSION 0x80 /end CHARACTERISTIC
/begin CHARACTERISTIC CtApImageProcess_FreeRunning.PpImageProcess_ParkingLot_20ms.DeSVParkingSlot.gstSpaceRear[1].gfPos[0] "2 float32 array" VAL_BLK 0x3d06bc __FLOAT32_IEEE_S 0 NO_COMPU_METHOD 0 3.402823e+38 ECU_ADDRESS_EXTENSION 0x80 MATRIX_DIM 2 1 1 /end CHARACTERISTIC
/begin CHARACTERISTIC CtApImageProcess_FreeRunning.PpImageProcess_ParkingLot_20ms.DeSVParkingSlot.gstSpaceRear[1].gfPos[1] "2 float32 array" VAL_BLK 0x3d06c4 __FLOAT32_IEEE_S 0 NO_COMPU_METHOD 0 3.402823e+38 ECU_ADDRESS_EXTENSION 0x80 MATRIX_DIM 2 1 1 /end CHARACTERISTIC
/begin CHARACTERISTIC CtApImageProcess_FreeRunning.PpImageProcess_ParkingLot_20ms.DeSVParkingSlot.gstSpaceRear[1].gfPos[2] "2 float32 array" VAL_BLK 0x3d06cc __FLOAT32_IEEE_S 0 NO_COMPU_METHOD 0 3.402823e+38 ECU_ADDRESS_EXTENSION 0x80 MATRIX_DIM 2 1 1 /end CHARACTERISTIC
/begin CHARACTERISTIC CtApImageProcess_FreeRunning.PpImageProcess_ParkingLot_20ms.DeSVParkingSlot.gstSpaceRear[1].gfPos[3] "2 float32 array" VAL_BLK 0x3d06d4 __FLOAT32_IEEE_S 0 NO_COMPU_METHOD 0 3.402823e+38 ECU_ADDRESS_EXTENSION 0x80 MATRIX_DIM 2 1 1 /end CHARACTERISTIC
/begin CHARACTERISTIC CtApImageProcess_FreeRunning.PpImageProcess_ParkingLot_20ms.DeSVParkingSlot.gstSpaceRear[1].nQuality "" VALUE 0x3d06dc __UBYTE_S 0 NO_COMPU_METHOD 0 255 ECU_ADDRESS_EXTENSION 0x80 /end CHARACTERISTIC
/begin CHARACTERISTIC CtApImageProcess_FreeRunning.PpImageProcess_ParkingLot_20ms.DeSVParkingSlot.gstSpaceRear[1].nType "" VALUE 0x3d06dd __UBYTE_S 0 NO_COMPU_METHOD 0 255 ECU_ADDRESS_EXTENSION 0x80 /end CHARACTERISTIC
/begin CHARACTERISTIC CtApImageProcess_FreeRunning.PpImageProcess_ParkingLot_20ms.DeSVParkingSlot.gstSpaceRear[1].nParkingGarageID "" VALUE 0x3d06de __UBYTE_S 0 NO_COMPU_METHOD 0 255 ECU_ADDRESS_EXTENSION 0x80 /end CHARACTERISTIC
/begin CHARACTERISTIC CtApImageProcess_FreeRunning.PpImageProcess_ParkingLot_20ms.DeSVParkingSlot.gstSpaceRear[1].fLineWith "" VALUE 0x3d06e0 __FLOAT32_IEEE_S 0 NO_COMPU_METHOD 0 3.402823e+38 ECU_ADDRESS_EXTENSION 0x80 /end CHARACTERISTIC
/begin CHARACTERISTIC CtApImageProcess_FreeRunning.PpImageProcess_ParkingLot_20ms.DeSVParkingSlot.gstSpaceRear[1].fSita "" VALUE 0x3d06e4 __FLOAT32_IEEE_S 0 NO_COMPU_METHOD 0 3.402823e+38 ECU_ADDRESS_EXTENSION 0x80 /end CHARACTERISTIC
/begin CHARACTERISTIC CtApImageProcess_FreeRunning.PpImageProcess_ParkingLot_20ms.DeSVParkingSlot.gstSpaceRear[1].fIdentifierNum "2 uint32 array" VAL_BLK 0x3d06e8 __ULONG_S 0 NO_COMPU_METHOD 0 4294967295 ECU_ADDRESS_EXTENSION 0x80 MATRIX_DIM 2 1 1 /end CHARACTERISTIC
/begin CHARACTERISTIC CtApImageProcess_FreeRunning.PpImageProcess_ParkingLot_20ms.DeSVParkingSlot.gstSpaceRear[1].fReserved "12 uint8 array" VAL_BLK 0x3d06f0 __UBYTE_S 0 NO_COMPU_METHOD 0 255 ECU_ADDRESS_EXTENSION 0x80 MATRIX_DIM 12 1 1 /end CHARACTERISTIC
/begin CHARACTERISTIC CtApImageProcess_FreeRunning.PpImageProcess_ParkingLot_20ms.DeSVParkingSlot.gstSpaceRear[2].nValid "" VALUE 0x3d06fc __UBYTE_S 0 NO_COMPU_METHOD 0 255 ECU_ADDRESS_EXTENSION 0x80 /end CHARACTERISTIC
/begin CHARACTERISTIC CtApImageProcess_FreeRunning.PpImageProcess_ParkingLot_20ms.DeSVParkingSlot.gstSpaceRear[2].gfPos[0] "2 float32 array" VAL_BLK 0x3d0700 __FLOAT32_IEEE_S 0 NO_COMPU_METHOD 0 3.402823e+38 ECU_ADDRESS_EXTENSION 0x80 MATRIX_DIM 2 1 1 /end CHARACTERISTIC
/begin CHARACTERISTIC CtApImageProcess_FreeRunning.PpImageProcess_ParkingLot_20ms.DeSVParkingSlot.gstSpaceRear[2].gfPos[1] "2 float32 array" VAL_BLK 0x3d0708 __FLOAT32_IEEE_S 0 NO_COMPU_METHOD 0 3.402823e+38 ECU_ADDRESS_EXTENSION 0x80 MATRIX_DIM 2 1 1 /end CHARACTERISTIC
/begin CHARACTERISTIC CtApImageProcess_FreeRunning.PpImageProcess_ParkingLot_20ms.DeSVParkingSlot.gstSpaceRear[2].gfPos[2] "2 float32 array" VAL_BLK 0x3d0710 __FLOAT32_IEEE_S 0 NO_COMPU_METHOD 0 3.402823e+38 ECU_ADDRESS_EXTENSION 0x80 MATRIX_DIM 2 1 1 /end CHARACTERISTIC
/begin CHARACTERISTIC CtApImageProcess_FreeRunning.PpImageProcess_ParkingLot_20ms.DeSVParkingSlot.gstSpaceRear[2].gfPos[3] "2 float32 array" VAL_BLK 0x3d0718 __FLOAT32_IEEE_S 0 NO_COMPU_METHOD 0 3.402823e+38 ECU_ADDRESS_EXTENSION 0x80 MATRIX_DIM 2 1 1 /end CHARACTERISTIC
/begin CHARACTERISTIC CtApImageProcess_FreeRunning.PpImageProcess_ParkingLot_20ms.DeSVParkingSlot.gstSpaceRear[2].nQuality "" VALUE 0x3d0720 __UBYTE_S 0 NO_COMPU_METHOD 0 255 ECU_ADDRESS_EXTENSION 0x80 /end CHARACTERISTIC
/begin CHARACTERISTIC CtApImageProcess_FreeRunning.PpImageProcess_ParkingLot_20ms.DeSVParkingSlot.gstSpaceRear[2].nType "" VALUE 0x3d0721 __UBYTE_S 0 NO_COMPU_METHOD 0 255 ECU_ADDRESS_EXTENSION 0x80 /end CHARACTERISTIC
/begin CHARACTERISTIC CtApImageProcess_FreeRunning.PpImageProcess_ParkingLot_20ms.DeSVParkingSlot.gstSpaceRear[2].nParkingGarageID "" VALUE 0x3d0722 __UBYTE_S 0 NO_COMPU_METHOD 0 255 ECU_ADDRESS_EXTENSION 0x80 /end CHARACTERISTIC
/begin CHARACTERISTIC CtApImageProcess_FreeRunning.PpImageProcess_ParkingLot_20ms.DeSVParkingSlot.gstSpaceRear[2].fLineWith "" VALUE 0x3d0724 __FLOAT32_IEEE_S 0 NO_COMPU_METHOD 0 3.402823e+38 ECU_ADDRESS_EXTENSION 0x80 /end CHARACTERISTIC
/begin CHARACTERISTIC CtApImageProcess_FreeRunning.PpImageProcess_ParkingLot_20ms.DeSVParkingSlot.gstSpaceRear[2].fSita "" VALUE 0x3d0728 __FLOAT32_IEEE_S 0 NO_COMPU_METHOD 0 3.402823e+38 ECU_ADDRESS_EXTENSION 0x80 /end CHARACTERISTIC
/begin CHARACTERISTIC CtApImageProcess_FreeRunning.PpImageProcess_ParkingLot_20ms.DeSVParkingSlot.gstSpaceRear[2].fIdentifierNum "2 uint32 array" VAL_BLK 0x3d072c __ULONG_S 0 NO_COMPU_METHOD 0 4294967295 ECU_ADDRESS_EXTENSION 0x80 MATRIX_DIM 2 1 1 /end CHARACTERISTIC
/begin CHARACTERISTIC CtApImageProcess_FreeRunning.PpImageProcess_ParkingLot_20ms.DeSVParkingSlot.gstSpaceRear[2].fReserved "12 uint8 array" VAL_BLK 0x3d0734 __UBYTE_S 0 NO_COMPU_METHOD 0 255 ECU_ADDRESS_EXTENSION 0x80 MATRIX_DIM 12 1 1 /end CHARACTERISTIC
/begin CHARACTERISTIC CtApImageProcess_FreeRunning.PpImageProcess_ParkingLot_20ms.DeSVParkingSlot.gstSpaceRear[3].nValid "" VALUE 0x3d0740 __UBYTE_S 0 NO_COMPU_METHOD 0 255 ECU_ADDRESS_EXTENSION 0x80 /end CHARACTERISTIC
/begin CHARACTERISTIC CtApImageProcess_FreeRunning.PpImageProcess_ParkingLot_20ms.DeSVParkingSlot.gstSpaceRear[3].gfPos[0] "2 float32 array" VAL_BLK 0x3d0744 __FLOAT32_IEEE_S 0 NO_COMPU_METHOD 0 3.402823e+38 ECU_ADDRESS_EXTENSION 0x80 MATRIX_DIM 2 1 1 /end CHARACTERISTIC
/begin CHARACTERISTIC CtApImageProcess_FreeRunning.PpImageProcess_ParkingLot_20ms.DeSVParkingSlot.gstSpaceRear[3].gfPos[1] "2 float32 array" VAL_BLK 0x3d074c __FLOAT32_IEEE_S 0 NO_COMPU_METHOD 0 3.402823e+38 ECU_ADDRESS_EXTENSION 0x80 MATRIX_DIM 2 1 1 /end CHARACTERISTIC
/begin CHARACTERISTIC CtApImageProcess_FreeRunning.PpImageProcess_ParkingLot_20ms.DeSVParkingSlot.gstSpaceRear[3].gfPos[2] "2 float32 array" VAL_BLK 0x3d0754 __FLOAT32_IEEE_S 0 NO_COMPU_METHOD 0 3.402823e+38 ECU_ADDRESS_EXTENSION 0x80 MATRIX_DIM 2 1 1 /end CHARACTERISTIC
/begin CHARACTERISTIC CtApImageProcess_FreeRunning.PpImageProcess_ParkingLot_20ms.DeSVParkingSlot.gstSpaceRear[3].gfPos[3] "2 float32 array" VAL_BLK 0x3d075c __FLOAT32_IEEE_S 0 NO_COMPU_METHOD 0 3.402823e+38 ECU_ADDRESS_EXTENSION 0x80 MATRIX_DIM 2 1 1 /end CHARACTERISTIC
/begin CHARACTERISTIC CtApImageProcess_FreeRunning.PpImageProcess_ParkingLot_20ms.DeSVParkingSlot.gstSpaceRear[3].nQuality "" VALUE 0x3d0764 __UBYTE_S 0 NO_COMPU_METHOD 0 255 ECU_ADDRESS_EXTENSION 0x80 /end CHARACTERISTIC
/begin CHARACTERISTIC CtApImageProcess_FreeRunning.PpImageProcess_ParkingLot_20ms.DeSVParkingSlot.gstSpaceRear[3].nType "" VALUE 0x3d0765 __UBYTE_S 0 NO_COMPU_METHOD 0 255 ECU_ADDRESS_EXTENSION 0x80 /end CHARACTERISTIC
/begin CHARACTERISTIC CtApImageProcess_FreeRunning.PpImageProcess_ParkingLot_20ms.DeSVParkingSlot.gstSpaceRear[3].nParkingGarageID "" VALUE 0x3d0766 __UBYTE_S 0 NO_COMPU_METHOD 0 255 ECU_ADDRESS_EXTENSION 0x80 /end CHARACTERISTIC
/begin CHARACTERISTIC CtApImageProcess_FreeRunning.PpImageProcess_ParkingLot_20ms.DeSVParkingSlot.gstSpaceRear[3].fLineWith "" VALUE 0x3d0768 __FLOAT32_IEEE_S 0 NO_COMPU_METHOD 0 3.402823e+38 ECU_ADDRESS_EXTENSION 0x80 /end CHARACTERISTIC
/begin CHARACTERISTIC CtApImageProcess_FreeRunning.PpImageProcess_ParkingLot_20ms.DeSVParkingSlot.gstSpaceRear[3].fSita "" VALUE 0x3d076c __FLOAT32_IEEE_S 0 NO_COMPU_METHOD 0 3.402823e+38 ECU_ADDRESS_EXTENSION 0x80 /end CHARACTERISTIC
/begin CHARACTERISTIC CtApImageProcess_FreeRunning.PpImageProcess_ParkingLot_20ms.DeSVParkingSlot.gstSpaceRear[3].fIdentifierNum "2 uint32 array" VAL_BLK 0x3d0770 __ULONG_S 0 NO_COMPU_METHOD 0 4294967295 ECU_ADDRESS_EXTENSION 0x80 MATRIX_DIM 2 1 1 /end CHARACTERISTIC
/begin CHARACTERISTIC CtApImageProcess_FreeRunning.PpImageProcess_ParkingLot_20ms.DeSVParkingSlot.gstSpaceRear[3].fReserved "12 uint8 array" VAL_BLK 0x3d0778 __UBYTE_S 0 NO_COMPU_METHOD 0 255 ECU_ADDRESS_EXTENSION 0x80 MATRIX_DIM 12 1 1 /end CHARACTERISTIC
/begin CHARACTERISTIC CtApImageProcess_FreeRunning.PpImageProcess_ParkingLot_20ms.DeSVParkingSlot.gstSpaceRear[4].nValid "" VALUE 0x3d0784 __UBYTE_S 0 NO_COMPU_METHOD 0 255 ECU_ADDRESS_EXTENSION 0x80 /end CHARACTERISTIC
/begin CHARACTERISTIC CtApImageProcess_FreeRunning.PpImageProcess_ParkingLot_20ms.DeSVParkingSlot.gstSpaceRear[4].gfPos[0] "2 float32 array" VAL_BLK 0x3d0788 __FLOAT32_IEEE_S 0 NO_COMPU_METHOD 0 3.402823e+38 ECU_ADDRESS_EXTENSION 0x80 MATRIX_DIM 2 1 1 /end CHARACTERISTIC
/begin CHARACTERISTIC CtApImageProcess_FreeRunning.PpImageProcess_ParkingLot_20ms.DeSVParkingSlot.gstSpaceRear[4].gfPos[1] "2 float32 array" VAL_BLK 0x3d0790 __FLOAT32_IEEE_S 0 NO_COMPU_METHOD 0 3.402823e+38 ECU_ADDRESS_EXTENSION 0x80 MATRIX_DIM 2 1 1 /end CHARACTERISTIC
/begin CHARACTERISTIC CtApImageProcess_FreeRunning.PpImageProcess_ParkingLot_20ms.DeSVParkingSlot.gstSpaceRear[4].gfPos[2] "2 float32 array" VAL_BLK 0x3d0798 __FLOAT32_IEEE_S 0 NO_COMPU_METHOD 0 3.402823e+38 ECU_ADDRESS_EXTENSION 0x80 MATRIX_DIM 2 1 1 /end CHARACTERISTIC
/begin CHARACTERISTIC CtApImageProcess_FreeRunning.PpImageProcess_ParkingLot_20ms.DeSVParkingSlot.gstSpaceRear[4].gfPos[3] "2 float32 array" VAL_BLK 0x3d07a0 __FLOAT32_IEEE_S 0 NO_COMPU_METHOD 0 3.402823e+38 ECU_ADDRESS_EXTENSION 0x80 MATRIX_DIM 2 1 1 /end CHARACTERISTIC
/begin CHARACTERISTIC CtApImageProcess_FreeRunning.PpImageProcess_ParkingLot_20ms.DeSVParkingSlot.gstSpaceRear[4].nQuality "" VALUE 0x3d07a8 __UBYTE_S 0 NO_COMPU_METHOD 0 255 ECU_ADDRESS_EXTENSION 0x80 /end CHARACTERISTIC
/begin CHARACTERISTIC CtApImageProcess_FreeRunning.PpImageProcess_ParkingLot_20ms.DeSVParkingSlot.gstSpaceRear[4].nType "" VALUE 0x3d07a9 __UBYTE_S 0 NO_COMPU_METHOD 0 255 ECU_ADDRESS_EXTENSION 0x80 /end CHARACTERISTIC
/begin CHARACTERISTIC CtApImageProcess_FreeRunning.PpImageProcess_ParkingLot_20ms.DeSVParkingSlot.gstSpaceRear[4].nParkingGarageID "" VALUE 0x3d07aa __UBYTE_S 0 NO_COMPU_METHOD 0 255 ECU_ADDRESS_EXTENSION 0x80 /end CHARACTERISTIC
/begin CHARACTERISTIC CtApImageProcess_FreeRunning.PpImageProcess_ParkingLot_20ms.DeSVParkingSlot.gstSpaceRear[4].fLineWith "" VALUE 0x3d07ac __FLOAT32_IEEE_S 0 NO_COMPU_METHOD 0 3.402823e+38 ECU_ADDRESS_EXTENSION 0x80 /end CHARACTERISTIC
/begin CHARACTERISTIC CtApImageProcess_FreeRunning.PpImageProcess_ParkingLot_20ms.DeSVParkingSlot.gstSpaceRear[4].fSita "" VALUE 0x3d07b0 __FLOAT32_IEEE_S 0 NO_COMPU_METHOD 0 3.402823e+38 ECU_ADDRESS_EXTENSION 0x80 /end CHARACTERISTIC
/begin CHARACTERISTIC CtApImageProcess_FreeRunning.PpImageProcess_ParkingLot_20ms.DeSVParkingSlot.gstSpaceRear[4].fIdentifierNum "2 uint32 array" VAL_BLK 0x3d07b4 __ULONG_S 0 NO_COMPU_METHOD 0 4294967295 ECU_ADDRESS_EXTENSION 0x80 MATRIX_DIM 2 1 1 /end CHARACTERISTIC
/begin CHARACTERISTIC CtApImageProcess_FreeRunning.PpImageProcess_ParkingLot_20ms.DeSVParkingSlot.gstSpaceRear[4].fReserved "12 uint8 array" VAL_BLK 0x3d07bc __UBYTE_S 0 NO_COMPU_METHOD 0 255 ECU_ADDRESS_EXTENSION 0x80 MATRIX_DIM 12 1 1 /end CHARACTERISTIC
/begin CHARACTERISTIC CtApImageProcess_FreeRunning.PpImageProcess_ParkingLot_20ms.DeSVParkingSlot.gstSpaceRear[5].nValid "" VALUE 0x3d07c8 __UBYTE_S 0 NO_COMPU_METHOD 0 255 ECU_ADDRESS_EXTENSION 0x80 /end CHARACTERISTIC
/begin CHARACTERISTIC CtApImageProcess_FreeRunning.PpImageProcess_ParkingLot_20ms.DeSVParkingSlot.gstSpaceRear[5].gfPos[0] "2 float32 array" VAL_BLK 0x3d07cc __FLOAT32_IEEE_S 0 NO_COMPU_METHOD 0 3.402823e+38 ECU_ADDRESS_EXTENSION 0x80 MATRIX_DIM 2 1 1 /end CHARACTERISTIC
/begin CHARACTERISTIC CtApImageProcess_FreeRunning.PpImageProcess_ParkingLot_20ms.DeSVParkingSlot.gstSpaceRear[5].gfPos[1] "2 float32 array" VAL_BLK 0x3d07d4 __FLOAT32_IEEE_S 0 NO_COMPU_METHOD 0 3.402823e+38 ECU_ADDRESS_EXTENSION 0x80 MATRIX_DIM 2 1 1 /end CHARACTERISTIC
/begin CHARACTERISTIC CtApImageProcess_FreeRunning.PpImageProcess_ParkingLot_20ms.DeSVParkingSlot.gstSpaceRear[5].gfPos[2] "2 float32 array" VAL_BLK 0x3d07dc __FLOAT32_IEEE_S 0 NO_COMPU_METHOD 0 3.402823e+38 ECU_ADDRESS_EXTENSION 0x80 MATRIX_DIM 2 1 1 /end CHARACTERISTIC
/begin CHARACTERISTIC CtApImageProcess_FreeRunning.PpImageProcess_ParkingLot_20ms.DeSVParkingSlot.gstSpaceRear[5].gfPos[3] "2 float32 array" VAL_BLK 0x3d07e4 __FLOAT32_IEEE_S 0 NO_COMPU_METHOD 0 3.402823e+38 ECU_ADDRESS_EXTENSION 0x80 MATRIX_DIM 2 1 1 /end CHARACTERISTIC
/begin CHARACTERISTIC CtApImageProcess_FreeRunning.PpImageProcess_ParkingLot_20ms.DeSVParkingSlot.gstSpaceRear[5].nQuality "" VALUE 0x3d07ec __UBYTE_S 0 NO_COMPU_METHOD 0 255 ECU_ADDRESS_EXTENSION 0x80 /end CHARACTERISTIC
/begin CHARACTERISTIC CtApImageProcess_FreeRunning.PpImageProcess_ParkingLot_20ms.DeSVParkingSlot.gstSpaceRear[5].nType "" VALUE 0x3d07ed __UBYTE_S 0 NO_COMPU_METHOD 0 255 ECU_ADDRESS_EXTENSION 0x80 /end CHARACTERISTIC
/begin CHARACTERISTIC CtApImageProcess_FreeRunning.PpImageProcess_ParkingLot_20ms.DeSVParkingSlot.gstSpaceRear[5].nParkingGarageID "" VALUE 0x3d07ee __UBYTE_S 0 NO_COMPU_METHOD 0 255 ECU_ADDRESS_EXTENSION 0x80 /end CHARACTERISTIC
/begin CHARACTERISTIC CtApImageProcess_FreeRunning.PpImageProcess_ParkingLot_20ms.DeSVParkingSlot.gstSpaceRear[5].fLineWith "" VALUE 0x3d07f0 __FLOAT32_IEEE_S 0 NO_COMPU_METHOD 0 3.402823e+38 ECU_ADDRESS_EXTENSION 0x80 /end CHARACTERISTIC
/begin CHARACTERISTIC CtApImageProcess_FreeRunning.PpImageProcess_ParkingLot_20ms.DeSVParkingSlot.gstSpaceRear[5].fSita "" VALUE 0x3d07f4 __FLOAT32_IEEE_S 0 NO_COMPU_METHOD 0 3.402823e+38 ECU_ADDRESS_EXTENSION 0x80 /end CHARACTERISTIC
/begin CHARACTERISTIC CtApImageProcess_FreeRunning.PpImageProcess_ParkingLot_20ms.DeSVParkingSlot.gstSpaceRear[5].fIdentifierNum "2 uint32 array" VAL_BLK 0x3d07f8 __ULONG_S 0 NO_COMPU_METHOD 0 4294967295 ECU_ADDRESS_EXTENSION 0x80 MATRIX_DIM 2 1 1 /end CHARACTERISTIC
/begin CHARACTERISTIC CtApImageProcess_FreeRunning.PpImageProcess_ParkingLot_20ms.DeSVParkingSlot.gstSpaceRear[5].fReserved "12 uint8 array" VAL_BLK 0x3d0800 __UBYTE_S 0 NO_COMPU_METHOD 0 255 ECU_ADDRESS_EXTENSION 0x80 MATRIX_DIM 12 1 1 /end CHARACTERISTIC
/begin CHARACTERISTIC CtApImageProcess_FreeRunning.PpImageProcess_ParkingLot_20ms.DeSVParkingSlot.gstSpaceRear[6].nValid "" VALUE 0x3d080c __UBYTE_S 0 NO_COMPU_METHOD 0 255 ECU_ADDRESS_EXTENSION 0x80 /end CHARACTERISTIC
/begin CHARACTERISTIC CtApImageProcess_FreeRunning.PpImageProcess_ParkingLot_20ms.DeSVParkingSlot.gstSpaceRear[6].gfPos[0] "2 float32 array" VAL_BLK 0x3d0810 __FLOAT32_IEEE_S 0 NO_COMPU_METHOD 0 3.402823e+38 ECU_ADDRESS_EXTENSION 0x80 MATRIX_DIM 2 1 1 /end CHARACTERISTIC
/begin CHARACTERISTIC CtApImageProcess_FreeRunning.PpImageProcess_ParkingLot_20ms.DeSVParkingSlot.gstSpaceRear[6].gfPos[1] "2 float32 array" VAL_BLK 0x3d0818 __FLOAT32_IEEE_S 0 NO_COMPU_METHOD 0 3.402823e+38 ECU_ADDRESS_EXTENSION 0x80 MATRIX_DIM 2 1 1 /end CHARACTERISTIC
/begin CHARACTERISTIC CtApImageProcess_FreeRunning.PpImageProcess_ParkingLot_20ms.DeSVParkingSlot.gstSpaceRear[6].gfPos[2] "2 float32 array" VAL_BLK 0x3d0820 __FLOAT32_IEEE_S 0 NO_COMPU_METHOD 0 3.402823e+38 ECU_ADDRESS_EXTENSION 0x80 MATRIX_DIM 2 1 1 /end CHARACTERISTIC
/begin CHARACTERISTIC CtApImageProcess_FreeRunning.PpImageProcess_ParkingLot_20ms.DeSVParkingSlot.gstSpaceRear[6].gfPos[3] "2 float32 array" VAL_BLK 0x3d0828 __FLOAT32_IEEE_S 0 NO_COMPU_METHOD 0 3.402823e+38 ECU_ADDRESS_EXTENSION 0x80 MATRIX_DIM 2 1 1 /end CHARACTERISTIC
/begin CHARACTERISTIC CtApImageProcess_FreeRunning.PpImageProcess_ParkingLot_20ms.DeSVParkingSlot.gstSpaceRear[6].nQuality "" VALUE 0x3d0830 __UBYTE_S 0 NO_COMPU_METHOD 0 255 ECU_ADDRESS_EXTENSION 0x80 /end CHARACTERISTIC
/begin CHARACTERISTIC CtApImageProcess_FreeRunning.PpImageProcess_ParkingLot_20ms.DeSVParkingSlot.gstSpaceRear[6].nType "" VALUE 0x3d0831 __UBYTE_S 0 NO_COMPU_METHOD 0 255 ECU_ADDRESS_EXTENSION 0x80 /end CHARACTERISTIC
/begin CHARACTERISTIC CtApImageProcess_FreeRunning.PpImageProcess_ParkingLot_20ms.DeSVParkingSlot.gstSpaceRear[6].nParkingGarageID "" VALUE 0x3d0832 __UBYTE_S 0 NO_COMPU_METHOD 0 255 ECU_ADDRESS_EXTENSION 0x80 /end CHARACTERISTIC
/begin CHARACTERISTIC CtApImageProcess_FreeRunning.PpImageProcess_ParkingLot_20ms.DeSVParkingSlot.gstSpaceRear[6].fLineWith "" VALUE 0x3d0834 __FLOAT32_IEEE_S 0 NO_COMPU_METHOD 0 3.402823e+38 ECU_ADDRESS_EXTENSION 0x80 /end CHARACTERISTIC
/begin CHARACTERISTIC CtApImageProcess_FreeRunning.PpImageProcess_ParkingLot_20ms.DeSVParkingSlot.gstSpaceRear[6].fSita "" VALUE 0x3d0838 __FLOAT32_IEEE_S 0 NO_COMPU_METHOD 0 3.402823e+38 ECU_ADDRESS_EXTENSION 0x80 /end CHARACTERISTIC
/begin CHARACTERISTIC CtApImageProcess_FreeRunning.PpImageProcess_ParkingLot_20ms.DeSVParkingSlot.gstSpaceRear[6].fIdentifierNum "2 uint32 array" VAL_BLK 0x3d083c __ULONG_S 0 NO_COMPU_METHOD 0 4294967295 ECU_ADDRESS_EXTENSION 0x80 MATRIX_DIM 2 1 1 /end CHARACTERISTIC
/begin CHARACTERISTIC CtApImageProcess_FreeRunning.PpImageProcess_ParkingLot_20ms.DeSVParkingSlot.gstSpaceRear[6].fReserved "12 uint8 array" VAL_BLK 0x3d0844 __UBYTE_S 0 NO_COMPU_METHOD 0 255 ECU_ADDRESS_EXTENSION 0x80 MATRIX_DIM 12 1 1 /end CHARACTERISTIC
/begin CHARACTERISTIC CtApImageProcess_FreeRunning.PpImageProcess_ParkingLot_20ms.DeSVParkingSlot.gstSpaceRear[7].nValid "" VALUE 0x3d0850 __UBYTE_S 0 NO_COMPU_METHOD 0 255 ECU_ADDRESS_EXTENSION 0x80 /end CHARACTERISTIC
/begin CHARACTERISTIC CtApImageProcess_FreeRunning.PpImageProcess_ParkingLot_20ms.DeSVParkingSlot.gstSpaceRear[7].gfPos[0] "2 float32 array" VAL_BLK 0x3d0854 __FLOAT32_IEEE_S 0 NO_COMPU_METHOD 0 3.402823e+38 ECU_ADDRESS_EXTENSION 0x80 MATRIX_DIM 2 1 1 /end CHARACTERISTIC
/begin CHARACTERISTIC CtApImageProcess_FreeRunning.PpImageProcess_ParkingLot_20ms.DeSVParkingSlot.gstSpaceRear[7].gfPos[1] "2 float32 array" VAL_BLK 0x3d085c __FLOAT32_IEEE_S 0 NO_COMPU_METHOD 0 3.402823e+38 ECU_ADDRESS_EXTENSION 0x80 MATRIX_DIM 2 1 1 /end CHARACTERISTIC
/begin CHARACTERISTIC CtApImageProcess_FreeRunning.PpImageProcess_ParkingLot_20ms.DeSVParkingSlot.gstSpaceRear[7].gfPos[2] "2 float32 array" VAL_BLK 0x3d0864 __FLOAT32_IEEE_S 0 NO_COMPU_METHOD 0 3.402823e+38 ECU_ADDRESS_EXTENSION 0x80 MATRIX_DIM 2 1 1 /end CHARACTERISTIC
/begin CHARACTERISTIC CtApImageProcess_FreeRunning.PpImageProcess_ParkingLot_20ms.DeSVParkingSlot.gstSpaceRear[7].gfPos[3] "2 float32 array" VAL_BLK 0x3d086c __FLOAT32_IEEE_S 0 NO_COMPU_METHOD 0 3.402823e+38 ECU_ADDRESS_EXTENSION 0x80 MATRIX_DIM 2 1 1 /end CHARACTERISTIC
/begin CHARACTERISTIC CtApImageProcess_FreeRunning.PpImageProcess_ParkingLot_20ms.DeSVParkingSlot.gstSpaceRear[7].nQuality "" VALUE 0x3d0874 __UBYTE_S 0 NO_COMPU_METHOD 0 255 ECU_ADDRESS_EXTENSION 0x80 /end CHARACTERISTIC
/begin CHARACTERISTIC CtApImageProcess_FreeRunning.PpImageProcess_ParkingLot_20ms.DeSVParkingSlot.gstSpaceRear[7].nType "" VALUE 0x3d0875 __UBYTE_S 0 NO_COMPU_METHOD 0 255 ECU_ADDRESS_EXTENSION 0x80 /end CHARACTERISTIC
/begin CHARACTERISTIC CtApImageProcess_FreeRunning.PpImageProcess_ParkingLot_20ms.DeSVParkingSlot.gstSpaceRear[7].nParkingGarageID "" VALUE 0x3d0876 __UBYTE_S 0 NO_COMPU_METHOD 0 255 ECU_ADDRESS_EXTENSION 0x80 /end CHARACTERISTIC
/begin CHARACTERISTIC CtApImageProcess_FreeRunning.PpImageProcess_ParkingLot_20ms.DeSVParkingSlot.gstSpaceRear[7].fLineWith "" VALUE 0x3d0878 __FLOAT32_IEEE_S 0 NO_COMPU_METHOD 0 3.402823e+38 ECU_ADDRESS_EXTENSION 0x80 /end CHARACTERISTIC
/begin CHARACTERISTIC CtApImageProcess_FreeRunning.PpImageProcess_ParkingLot_20ms.DeSVParkingSlot.gstSpaceRear[7].fSita "" VALUE 0x3d087c __FLOAT32_IEEE_S 0 NO_COMPU_METHOD 0 3.402823e+38 ECU_ADDRESS_EXTENSION 0x80 /end CHARACTERISTIC
/begin CHARACTERISTIC CtApImageProcess_FreeRunning.PpImageProcess_ParkingLot_20ms.DeSVParkingSlot.gstSpaceRear[7].fIdentifierNum "2 uint32 array" VAL_BLK 0x3d0880 __ULONG_S 0 NO_COMPU_METHOD 0 4294967295 ECU_ADDRESS_EXTENSION 0x80 MATRIX_DIM 2 1 1 /end CHARACTERISTIC
/begin CHARACTERISTIC CtApImageProcess_FreeRunning.PpImageProcess_ParkingLot_20ms.DeSVParkingSlot.gstSpaceRear[7].fReserved "12 uint8 array" VAL_BLK 0x3d0888 __UBYTE_S 0 NO_COMPU_METHOD 0 255 ECU_ADDRESS_EXTENSION 0x80 MATRIX_DIM 12 1 1 /end CHARACTERISTIC
/begin CHARACTERISTIC CtApImageProcess_FreeRunning.PpImageProcess_ParkingLot_20ms.DeSVParkingSlot.fReserved "21 uint8 array" VAL_BLK 0x3d0894 __UBYTE_S 0 NO_COMPU_METHOD 0 255 ECU_ADDRESS_EXTENSION 0x80 MATRIX_DIM 21 1 1 /end CHARACTERISTIC
/begin CHARACTERISTIC CtApImageProcess_FreeRunning.PpImageProcess_ParkingLot_20ms.DeSVParkingSlot.t2 "2 uint32 array" VAL_BLK 0x3d08ac __ULONG_S 0 NO_COMPU_METHOD 0 4294967295 ECU_ADDRESS_EXTENSION 0x80 MATRIX_DIM 2 1 1 /end CHARACTERISTIC
/begin CHARACTERISTIC CtApImageProcess_FreeRunning.PpImageProcess_Position_init_status_60ms.DePosition_init_status.stHeader.Counter "" VALUE 0x3e0000 __UWORD_S 0 NO_COMPU_METHOD 0 65535 ECU_ADDRESS_EXTENSION 0x80 /end CHARACTERISTIC
/begin CHARACTERISTIC CtApImageProcess_FreeRunning.PpImageProcess_Position_init_status_60ms.DePosition_init_status.stHeader.FrameID "" VALUE 0x3e0002 __UBYTE_S 0 NO_COMPU_METHOD 0 255 ECU_ADDRESS_EXTENSION 0x80 /end CHARACTERISTIC
/begin CHARACTERISTIC CtApImageProcess_FreeRunning.PpImageProcess_Position_init_status_60ms.DePosition_init_status.stHeader.TimeStamp "2 uint32 array" VAL_BLK 0x3e0004 __ULONG_S 0 NO_COMPU_METHOD 0 4294967295 ECU_ADDRESS_EXTENSION 0x80 MATRIX_DIM 2 1 1 /end CHARACTERISTIC
/begin CHARACTERISTIC CtApImageProcess_FreeRunning.PpImageProcess_Position_init_status_60ms.DePosition_init_status.isPositionInitial "" VALUE 0x3e000c __UBYTE_S 0 NO_COMPU_METHOD 0 255 ECU_ADDRESS_EXTENSION 0x80 /end CHARACTERISTIC
/begin CHARACTERISTIC CtApImageProcess_FreeRunning.PpImageProcess_ReswevedA2B_50ms.DeReservedA2B.nReserved1 "3 uint8 array" VAL_BLK 0x3f0000 __UBYTE_S 0 NO_COMPU_METHOD 0 255 ECU_ADDRESS_EXTENSION 0x80 MATRIX_DIM 3 1 1 /end CHARACTERISTIC
/begin CHARACTERISTIC CtApImageProcess_FreeRunning.PpImageProcess_ReswevedA2B_50ms.DeReservedA2B.nReserved2 "3 uint16 array" VAL_BLK 0x3f0004 __UWORD_S 0 NO_COMPU_METHOD 0 65535 ECU_ADDRESS_EXTENSION 0x80 MATRIX_DIM 3 1 1 /end CHARACTERISTIC
/begin CHARACTERISTIC CtApImageProcess_FreeRunning.PpImageProcess_ReswevedA2B_50ms.DeReservedA2B.fReserved "3 float32 array" VAL_BLK 0x3f000c __FLOAT32_IEEE_S 0 NO_COMPU_METHOD 0 3.402823e+38 ECU_ADDRESS_EXTENSION 0x80 MATRIX_DIM 3 1 1 /end CHARACTERISTIC
/begin CHARACTERISTIC CtApImageProcess_FreeRunning.PpImageProcess_Status_20ms.DeStatus.stHeader.Counter "" VALUE 0x400000 __UWORD_S 0 NO_COMPU_METHOD 0 65535 ECU_ADDRESS_EXTENSION 0x80 /end CHARACTERISTIC
/begin CHARACTERISTIC CtApImageProcess_FreeRunning.PpImageProcess_Status_20ms.DeStatus.stHeader.FrameID "" VALUE 0x400002 __UBYTE_S 0 NO_COMPU_METHOD 0 255 ECU_ADDRESS_EXTENSION 0x80 /end CHARACTERISTIC
/begin CHARACTERISTIC CtApImageProcess_FreeRunning.PpImageProcess_Status_20ms.DeStatus.stHeader.TimeStamp "2 uint32 array" VAL_BLK 0x400004 __ULONG_S 0 NO_COMPU_METHOD 0 4294967295 ECU_ADDRESS_EXTENSION 0x80 MATRIX_DIM 2 1 1 /end CHARACTERISTIC
/begin CHARACTERISTIC CtApImageProcess_FreeRunning.PpImageProcess_Status_20ms.DeStatus.t2 "2 uint32 array" VAL_BLK 0x40000c __ULONG_S 0 NO_COMPU_METHOD 0 4294967295 ECU_ADDRESS_EXTENSION 0x80 MATRIX_DIM 2 1 1 /end CHARACTERISTIC
/begin CHARACTERISTIC CtApImageProcess_FreeRunning.PpImageProcess_Status_20ms.DeStatus.AVM_Availability "" VALUE 0x400014 __UBYTE_S 0 NO_COMPU_METHOD 0 255 ECU_ADDRESS_EXTENSION 0x80 /end CHARACTERISTIC
/begin CHARACTERISTIC CtApImageProcess_FreeRunning.PpImageProcess_Status_20ms.DeStatus.PLD_Availability "" VALUE 0x400015 __UBYTE_S 0 NO_COMPU_METHOD 0 255 ECU_ADDRESS_EXTENSION 0x80 /end CHARACTERISTIC
/begin CHARACTERISTIC CtApImageProcess_FreeRunning.PpImageProcess_Status_20ms.DeStatus.FreeSpace_Availability "" VALUE 0x400016 __UBYTE_S 0 NO_COMPU_METHOD 0 255 ECU_ADDRESS_EXTENSION 0x80 /end CHARACTERISTIC
/begin CHARACTERISTIC CtApImageProcess_FreeRunning.PpImageProcess_Status_20ms.DeStatus.OD_Availability "" VALUE 0x400017 __UBYTE_S 0 NO_COMPU_METHOD 0 255 ECU_ADDRESS_EXTENSION 0x80 /end CHARACTERISTIC
/begin CHARACTERISTIC CtApImageProcess_FreeRunning.PpImageProcess_Status_20ms.DeStatus.RMD_Availability "" VALUE 0x400018 __UBYTE_S 0 NO_COMPU_METHOD 0 255 ECU_ADDRESS_EXTENSION 0x80 /end CHARACTERISTIC
/begin CHARACTERISTIC CtApImageProcess_FreeRunning.PpImageProcess_Status_20ms.DeStatus.Lane_Availability "" VALUE 0x400019 __UBYTE_S 0 NO_COMPU_METHOD 0 1 ECU_ADDRESS_EXTENSION 0x80 /end CHARACTERISTIC
/begin CHARACTERISTIC CtApImageProcess_FreeRunning.PpImageProcess_Status_20ms.DeStatus.fReserved "20 uint8 array" VAL_BLK 0x40001a __UBYTE_S 0 NO_COMPU_METHOD 0 255 ECU_ADDRESS_EXTENSION 0x80 MATRIX_DIM 20 1 1 /end CHARACTERISTIC
/begin CHARACTERISTIC CtApImageProcess_FreeRunning.PpImageProcess_SVCameraFail_60ms.DeSurroundCameraFail.stHeader.Counter "" VALUE 0x410000 __UWORD_S 0 NO_COMPU_METHOD 0 65535 ECU_ADDRESS_EXTENSION 0x80 /end CHARACTERISTIC
/begin CHARACTERISTIC CtApImageProcess_FreeRunning.PpImageProcess_SVCameraFail_60ms.DeSurroundCameraFail.stHeader.FrameID "" VALUE 0x410002 __UBYTE_S 0 NO_COMPU_METHOD 0 255 ECU_ADDRESS_EXTENSION 0x80 /end CHARACTERISTIC
/begin CHARACTERISTIC CtApImageProcess_FreeRunning.PpImageProcess_SVCameraFail_60ms.DeSurroundCameraFail.stHeader.TimeStamp "2 uint32 array" VAL_BLK 0x410004 __ULONG_S 0 NO_COMPU_METHOD 0 4294967295 ECU_ADDRESS_EXTENSION 0x80 MATRIX_DIM 2 1 1 /end CHARACTERISTIC
/begin CHARACTERISTIC CtApImageProcess_FreeRunning.PpImageProcess_SVCameraFail_60ms.DeSurroundCameraFail.Front_SV_Camera_Status "" VALUE 0x41000c __UBYTE_S 0 NO_COMPU_METHOD 0 255 ECU_ADDRESS_EXTENSION 0x80 /end CHARACTERISTIC
/begin CHARACTERISTIC CtApImageProcess_FreeRunning.PpImageProcess_SVCameraFail_60ms.DeSurroundCameraFail.Rear_SV_Camera_Status "" VALUE 0x41000d __UBYTE_S 0 NO_COMPU_METHOD 0 255 ECU_ADDRESS_EXTENSION 0x80 /end CHARACTERISTIC
/begin CHARACTERISTIC CtApImageProcess_FreeRunning.PpImageProcess_SVCameraFail_60ms.DeSurroundCameraFail.Left_SV_Camera_Status "" VALUE 0x41000e __UBYTE_S 0 NO_COMPU_METHOD 0 255 ECU_ADDRESS_EXTENSION 0x80 /end CHARACTERISTIC
/begin CHARACTERISTIC CtApImageProcess_FreeRunning.PpImageProcess_SVCameraFail_60ms.DeSurroundCameraFail.Right_SV_Camera_Status "" VALUE 0x41000f __UBYTE_S 0 NO_COMPU_METHOD 0 255 ECU_ADDRESS_EXTENSION 0x80 /end CHARACTERISTIC
/begin CHARACTERISTIC CtApImageProcess_FreeRunning.PpImageProcess_SVCameraFail_60ms.DeSurroundCameraFail.nReserved "8 uint8 array" VAL_BLK 0x410010 __UBYTE_S 0 NO_COMPU_METHOD 0 255 ECU_ADDRESS_EXTENSION 0x80 MATRIX_DIM 8 1 1 /end CHARACTERISTIC
/begin CHARACTERISTIC CtApImageProcess_FreeRunning.PpImageProcess_SVData_Upload_status_300ms.DeSVData_Upload_status.SVData_Upload_status "" VALUE 0x420000 __UBYTE_S 0 NO_COMPU_METHOD 0 255 ECU_ADDRESS_EXTENSION 0x80 /end CHARACTERISTIC
/begin CHARACTERISTIC CtApImageProcess_FreeRunning.PpImageProcess_SVData_Upload_status_300ms.DeSVData_Upload_status.nReserved "6 uint8 array" VAL_BLK 0x420001 __UBYTE_S 0 NO_COMPU_METHOD 0 255 ECU_ADDRESS_EXTENSION 0x80 MATRIX_DIM 6 1 1 /end CHARACTERISTIC
/begin CHARACTERISTIC CtApImageProcess_FreeRunning.PpPdImageProcess_FreeRunningWrite.DeImageProcess_FreeRunning_Normal.DeStatus "" VALUE 0x430000 __UWORD_S 0 CtApImageProcess_FreeRunning.PpPdImageProcess_FreeRunningWrite.DeImageProcess_FreeRunning_Normal.DeStatus.Dt_ENUM_PdDatablockStatus.CONVERSION 0 65535 ECU_ADDRESS_EXTENSION 0x80 /end CHARACTERISTIC
/begin CHARACTERISTIC CtApImageProcess_FreeRunning.PpPdImageProcess_FreeRunningWrite.DeImageProcess_FreeRunning_Normal.DeVersion.DeExpectedVersion.DeMajor "" VALUE 0x430004 __UBYTE_S 0 NO_COMPU_METHOD 0 255 ECU_ADDRESS_EXTENSION 0x80 /end CHARACTERISTIC
/begin CHARACTERISTIC CtApImageProcess_FreeRunning.PpPdImageProcess_FreeRunningWrite.DeImageProcess_FreeRunning_Normal.DeVersion.DeExpectedVersion.DeMinor "" VALUE 0x430005 __UBYTE_S 0 NO_COMPU_METHOD 0 255 ECU_ADDRESS_EXTENSION 0x80 /end CHARACTERISTIC
/begin CHARACTERISTIC CtApImageProcess_FreeRunning.PpPdImageProcess_FreeRunningWrite.DeImageProcess_FreeRunning_Normal.DeVersion.DeVersion.DeMajor "" VALUE 0x430008 __UBYTE_S 0 NO_COMPU_METHOD 0 255 ECU_ADDRESS_EXTENSION 0x80 /end CHARACTERISTIC
/begin CHARACTERISTIC CtApImageProcess_FreeRunning.PpPdImageProcess_FreeRunningWrite.DeImageProcess_FreeRunning_Normal.DeVersion.DeVersion.DeMinor "" VALUE 0x430009 __UBYTE_S 0 NO_COMPU_METHOD 0 255 ECU_ADDRESS_EXTENSION 0x80 /end CHARACTERISTIC
/begin CHARACTERISTIC CtApImageProcess_FreeRunning.PpPdImageProcess_FreeRunningWrite.DeImageProcess_FreeRunning_Normal.DeData.ngSignal "10 sint32 array" VAL_BLK 0x43000c __SLONG_S 0 NO_COMPU_METHOD -2147483648 2147483647 ECU_ADDRESS_EXTENSION 0x80 MATRIX_DIM 10 1 1 /end CHARACTERISTIC
/begin CHARACTERISTIC CtApImageProcess_FreeRunning.PpPdImageProcess_FreeRunningWrite.DeImageProcess_FreeRunning_Normal.DeData.fgSignal "10 float32 array" VAL_BLK 0x430034 __FLOAT32_IEEE_S 0 NO_COMPU_METHOD 0 3.402823e+38 ECU_ADDRESS_EXTENSION 0x80 MATRIX_DIM 10 1 1 /end CHARACTERISTIC
/begin CHARACTERISTIC CtApImageProcess_FreeRunning.PpPdImageProcess_FreeRunningWrite.DeImageProcess_Normal.DeStatus "" VALUE 0x440000 __UWORD_S 0 CtApImageProcess_FreeRunning.PpPdImageProcess_FreeRunningWrite.DeImageProcess_Normal.DeStatus.Dt_ENUM_PdDatablockStatus.CONVERSION 0 65535 ECU_ADDRESS_EXTENSION 0x80 /end CHARACTERISTIC
/begin CHARACTERISTIC CtApImageProcess_FreeRunning.PpPdImageProcess_FreeRunningWrite.DeImageProcess_Normal.DeVersion.DeExpectedVersion.DeMajor "" VALUE 0x440004 __UBYTE_S 0 NO_COMPU_METHOD 0 255 ECU_ADDRESS_EXTENSION 0x80 /end CHARACTERISTIC
/begin CHARACTERISTIC CtApImageProcess_FreeRunning.PpPdImageProcess_FreeRunningWrite.DeImageProcess_Normal.DeVersion.DeExpectedVersion.DeMinor "" VALUE 0x440005 __UBYTE_S 0 NO_COMPU_METHOD 0 255 ECU_ADDRESS_EXTENSION 0x80 /end CHARACTERISTIC
/begin CHARACTERISTIC CtApImageProcess_FreeRunning.PpPdImageProcess_FreeRunningWrite.DeImageProcess_Normal.DeVersion.DeVersion.DeMajor "" VALUE 0x440008 __UBYTE_S 0 NO_COMPU_METHOD 0 255 ECU_ADDRESS_EXTENSION 0x80 /end CHARACTERISTIC
/begin CHARACTERISTIC CtApImageProcess_FreeRunning.PpPdImageProcess_FreeRunningWrite.DeImageProcess_Normal.DeVersion.DeVersion.DeMinor "" VALUE 0x440009 __UBYTE_S 0 NO_COMPU_METHOD 0 255 ECU_ADDRESS_EXTENSION 0x80 /end CHARACTERISTIC
/begin CHARACTERISTIC CtApImageProcess_FreeRunning.PpPdImageProcess_FreeRunningWrite.DeImageProcess_Normal.DeData.stHeader_Counter "" VALUE 0x44000c __UWORD_S 0 NO_COMPU_METHOD 0 65535 ECU_ADDRESS_EXTENSION 0x80 /end CHARACTERISTIC
/begin CHARACTERISTIC CtApImageProcess_FreeRunning.PpPdImageProcess_FreeRunningWrite.DeImageProcess_Normal.DeData.stHeader_FrameID "" VALUE 0x44000e __UBYTE_S 0 NO_COMPU_METHOD 0 255 ECU_ADDRESS_EXTENSION 0x80 /end CHARACTERISTIC
/begin CHARACTERISTIC CtApImageProcess_FreeRunning.PpPdImageProcess_FreeRunningWrite.DeImageProcess_Normal.DeData.stHeader_TimeStamp "2 uint32 array" VAL_BLK 0x440010 __ULONG_S 0 NO_COMPU_METHOD 0 4294967295 ECU_ADDRESS_EXTENSION 0x80 MATRIX_DIM 2 1 1 /end CHARACTERISTIC
/begin CHARACTERISTIC CtApImageProcess_FreeRunning.PpPdImageProcess_FreeRunningWrite.DeImageProcess_Normal.DeData.stCamInt_w "" VALUE 0x440018 __SLONG_S 0 NO_COMPU_METHOD -2147483648 2147483647 ECU_ADDRESS_EXTENSION 0x80 /end CHARACTERISTIC
/begin CHARACTERISTIC CtApImageProcess_FreeRunning.PpPdImageProcess_FreeRunningWrite.DeImageProcess_Normal.DeData.stCamInt_h "" VALUE 0x44001c __SLONG_S 0 NO_COMPU_METHOD -2147483648 2147483647 ECU_ADDRESS_EXTENSION 0x80 /end CHARACTERISTIC
/begin CHARACTERISTIC CtApImageProcess_FreeRunning.PpPdImageProcess_FreeRunningWrite.DeImageProcess_Normal.DeData.stCamInt_cu "" VALUE 0x440020 __FLOAT32_IEEE_S 0 NO_COMPU_METHOD 0 3.402823e+38 ECU_ADDRESS_EXTENSION 0x80 /end CHARACTERISTIC
/begin CHARACTERISTIC CtApImageProcess_FreeRunning.PpPdImageProcess_FreeRunningWrite.DeImageProcess_Normal.DeData.stCamInt_cv "" VALUE 0x440024 __FLOAT32_IEEE_S 0 NO_COMPU_METHOD 0 3.402823e+38 ECU_ADDRESS_EXTENSION 0x80 /end CHARACTERISTIC
/begin CHARACTERISTIC CtApImageProcess_FreeRunning.PpPdImageProcess_FreeRunningWrite.DeImageProcess_Normal.DeData.stCamInt_skew_c "" VALUE 0x440028 __FLOAT32_IEEE_S 0 NO_COMPU_METHOD 0 3.402823e+38 ECU_ADDRESS_EXTENSION 0x80 /end CHARACTERISTIC
/begin CHARACTERISTIC CtApImageProcess_FreeRunning.PpPdImageProcess_FreeRunningWrite.DeImageProcess_Normal.DeData.stCamInt_skew_d "" VALUE 0x44002c __FLOAT32_IEEE_S 0 NO_COMPU_METHOD 0 3.402823e+38 ECU_ADDRESS_EXTENSION 0x80 /end CHARACTERISTIC
/begin CHARACTERISTIC CtApImageProcess_FreeRunning.PpPdImageProcess_FreeRunningWrite.DeImageProcess_Normal.DeData.stCamInt_skew_e "" VALUE 0x440030 __FLOAT32_IEEE_S 0 NO_COMPU_METHOD 0 3.402823e+38 ECU_ADDRESS_EXTENSION 0x80 /end CHARACTERISTIC
/begin CHARACTERISTIC CtApImageProcess_FreeRunning.PpPdImageProcess_FreeRunningWrite.DeImageProcess_Normal.DeData.stCamInt_fu_or_hfov_at_cu "" VALUE 0x440034 __FLOAT32_IEEE_S 0 NO_COMPU_METHOD 0 3.402823e+38 ECU_ADDRESS_EXTENSION 0x80 /end CHARACTERISTIC
/begin CHARACTERISTIC CtApImageProcess_FreeRunning.PpPdImageProcess_FreeRunningWrite.DeImageProcess_Normal.DeData.stCamInt_fu_or_hfov_at_cv "" VALUE 0x440038 __FLOAT32_IEEE_S 0 NO_COMPU_METHOD 0 3.402823e+38 ECU_ADDRESS_EXTENSION 0x80 /end CHARACTERISTIC
/begin CHARACTERISTIC CtApImageProcess_FreeRunning.PpPdImageProcess_FreeRunningWrite.DeImageProcess_Normal.DeData.stCamInt_use_fov "" VALUE 0x44003c __SLONG_S 0 NO_COMPU_METHOD -2147483648 2147483647 ECU_ADDRESS_EXTENSION 0x80 /end CHARACTERISTIC
/begin CHARACTERISTIC CtApImageProcess_FreeRunning.PpPdImageProcess_FreeRunningWrite.DeImageProcess_Normal.DeData.stCamInt_lut "" VALUE 0x440040 __SLONG_S 0 NO_COMPU_METHOD -2147483648 2147483647 ECU_ADDRESS_EXTENSION 0x80 /end CHARACTERISTIC
/begin CHARACTERISTIC CtApImageProcess_FreeRunning.PpPdImageProcess_FreeRunningWrite.DeImageProcess_Normal.DeData.stCamExt_rx "" VALUE 0x440044 __FLOAT32_IEEE_S 0 NO_COMPU_METHOD 0 3.402823e+38 ECU_ADDRESS_EXTENSION 0x80 /end CHARACTERISTIC
/begin CHARACTERISTIC CtApImageProcess_FreeRunning.PpPdImageProcess_FreeRunningWrite.DeImageProcess_Normal.DeData.stCamExt_ry "" VALUE 0x440048 __FLOAT32_IEEE_S 0 NO_COMPU_METHOD 0 3.402823e+38 ECU_ADDRESS_EXTENSION 0x80 /end CHARACTERISTIC
/begin CHARACTERISTIC CtApImageProcess_FreeRunning.PpPdImageProcess_FreeRunningWrite.DeImageProcess_Normal.DeData.stCamExt_rz "" VALUE 0x44004c __FLOAT32_IEEE_S 0 NO_COMPU_METHOD 0 3.402823e+38 ECU_ADDRESS_EXTENSION 0x80 /end CHARACTERISTIC
/begin CHARACTERISTIC CtApImageProcess_FreeRunning.PpPdImageProcess_FreeRunningWrite.DeImageProcess_Normal.DeData.stCamExt_tx "" VALUE 0x440050 __FLOAT32_IEEE_S 0 NO_COMPU_METHOD 0 3.402823e+38 ECU_ADDRESS_EXTENSION 0x80 /end CHARACTERISTIC
/begin CHARACTERISTIC CtApImageProcess_FreeRunning.PpPdImageProcess_FreeRunningWrite.DeImageProcess_Normal.DeData.stCamExt_ty "" VALUE 0x440054 __FLOAT32_IEEE_S 0 NO_COMPU_METHOD 0 3.402823e+38 ECU_ADDRESS_EXTENSION 0x80 /end CHARACTERISTIC
/begin CHARACTERISTIC CtApImageProcess_FreeRunning.PpPdImageProcess_FreeRunningWrite.DeImageProcess_Normal.DeData.stCamExt_tz "" VALUE 0x440058 __FLOAT32_IEEE_S 0 NO_COMPU_METHOD 0 3.402823e+38 ECU_ADDRESS_EXTENSION 0x80 /end CHARACTERISTIC
/begin CHARACTERISTIC CtApImageProcess_FreeRunning.PpPdImageProcess_FreeRunningWrite.DeImageProcess_Normal.DeData.stCarParam_eachPulseDist "" VALUE 0x44005c __FLOAT32_IEEE_S 0 NO_COMPU_METHOD 0 3.402823e+38 ECU_ADDRESS_EXTENSION 0x80 /end CHARACTERISTIC
/begin CHARACTERISTIC CtApImageProcess_FreeRunning.PpPdImageProcess_FreeRunningWrite.DeImageProcess_Normal.DeData.stCarParam_frontWheelDriven "" VALUE 0x440060 __UBYTE_S 0 NO_COMPU_METHOD 0 255 ECU_ADDRESS_EXTENSION 0x80 /end CHARACTERISTIC
/begin CHARACTERISTIC CtApImageProcess_FreeRunning.PpPdImageProcess_FreeRunningWrite.DeImageProcess_Normal.DeData.stCarParam_reserved "31 float32 array" VAL_BLK 0x440064 __FLOAT32_IEEE_S 0 NO_COMPU_METHOD 0 3.402823e+38 ECU_ADDRESS_EXTENSION 0x80 MATRIX_DIM 31 1 1 /end CHARACTERISTIC
/begin CHARACTERISTIC CtApImageProcess_FreeRunning.PpPdImageProcess_FreeRunningWrite.DeImageProcess_Normal.DeData.stCarParam_gnMotionModelCalib_01 "200 uint8 array" VAL_BLK 0x4400e0 __UBYTE_S 0 NO_COMPU_METHOD 0 255 ECU_ADDRESS_EXTENSION 0x80 MATRIX_DIM 200 1 1 /end CHARACTERISTIC
/begin CHARACTERISTIC CtApImageProcess_FreeRunning.PpPdImageProcess_FreeRunningWrite.DeImageProcess_Normal.DeData.stCarParam_gnMotionModelCalib_02 "200 uint8 array" VAL_BLK 0x4401a8 __UBYTE_S 0 NO_COMPU_METHOD 0 255 ECU_ADDRESS_EXTENSION 0x80 MATRIX_DIM 200 1 1 /end CHARACTERISTIC
/begin CHARACTERISTIC CtApImageProcess_FreeRunning.PpPdImageProcess_FreeRunningWrite.DeImageProcess_Normal.DeData.stCarParam_gnMotionModelCalib_03 "200 uint8 array" VAL_BLK 0x440270 __UBYTE_S 0 NO_COMPU_METHOD 0 255 ECU_ADDRESS_EXTENSION 0x80 MATRIX_DIM 200 1 1 /end CHARACTERISTIC
/begin CHARACTERISTIC CtApImageProcess_FreeRunning.PpPdImageProcess_FreeRunningWrite.DeImageProcess_Normal.DeData.stCarParam_gnMotionModelCalib_04 "200 uint8 array" VAL_BLK 0x440338 __UBYTE_S 0 NO_COMPU_METHOD 0 255 ECU_ADDRESS_EXTENSION 0x80 MATRIX_DIM 200 1 1 /end CHARACTERISTIC
/begin CHARACTERISTIC CtApImageProcess_FreeRunning.PpPdImageProcess_FreeRunningWrite.DeImageProcess_Normal.DeData.stCarParam_gnMotionModelCalib_05 "200 uint8 array" VAL_BLK 0x440400 __UBYTE_S 0 NO_COMPU_METHOD 0 255 ECU_ADDRESS_EXTENSION 0x80 MATRIX_DIM 200 1 1 /end CHARACTERISTIC
/begin CHARACTERISTIC CtApImageProcess_FreeRunning.PpPdImageProcess_FreeRunningWrite.DeImageProcess_Normal.DeData.stCarParam_gnMotionModelCalib_06 "200 uint8 array" VAL_BLK 0x4404c8 __UBYTE_S 0 NO_COMPU_METHOD 0 255 ECU_ADDRESS_EXTENSION 0x80 MATRIX_DIM 200 1 1 /end CHARACTERISTIC
/begin CHARACTERISTIC CtApImageProcess_FreeRunning.PpPdImageProcess_FreeRunningWrite.DeImageProcessSec_Normal.DeStatus "" VALUE 0x450000 __UWORD_S 0 CtApImageProcess_FreeRunning.PpPdImageProcess_FreeRunningWrite.DeImageProcessSec_Normal.DeStatus.Dt_ENUM_PdDatablockStatus.CONVERSION 0 65535 ECU_ADDRESS_EXTENSION 0x80 /end CHARACTERISTIC
/begin CHARACTERISTIC CtApImageProcess_FreeRunning.PpPdImageProcess_FreeRunningWrite.DeImageProcessSec_Normal.DeVersion.DeExpectedVersion.DeMajor "" VALUE 0x450004 __UBYTE_S 0 NO_COMPU_METHOD 0 255 ECU_ADDRESS_EXTENSION 0x80 /end CHARACTERISTIC
/begin CHARACTERISTIC CtApImageProcess_FreeRunning.PpPdImageProcess_FreeRunningWrite.DeImageProcessSec_Normal.DeVersion.DeExpectedVersion.DeMinor "" VALUE 0x450005 __UBYTE_S 0 NO_COMPU_METHOD 0 255 ECU_ADDRESS_EXTENSION 0x80 /end CHARACTERISTIC
/begin CHARACTERISTIC CtApImageProcess_FreeRunning.PpPdImageProcess_FreeRunningWrite.DeImageProcessSec_Normal.DeVersion.DeVersion.DeMajor "" VALUE 0x450008 __UBYTE_S 0 NO_COMPU_METHOD 0 255 ECU_ADDRESS_EXTENSION 0x80 /end CHARACTERISTIC
/begin CHARACTERISTIC CtApImageProcess_FreeRunning.PpPdImageProcess_FreeRunningWrite.DeImageProcessSec_Normal.DeVersion.DeVersion.DeMinor "" VALUE 0x450009 __UBYTE_S 0 NO_COMPU_METHOD 0 255 ECU_ADDRESS_EXTENSION 0x80 /end CHARACTERISTIC
/begin CHARACTERISTIC CtApImageProcess_FreeRunning.PpPdImageProcess_FreeRunningWrite.DeImageProcessSec_Normal.DeData "150 uint8 array" VAL_BLK 0x45000c __UBYTE_S 0 NO_COMPU_METHOD 0 255 ECU_ADDRESS_EXTENSION 0x80 MATRIX_DIM 150 1 1 /end CHARACTERISTIC
/begin CHARACTERISTIC CtApImageProcess_FreeRunning.PpBdImageProcessRead.BdSV_Normal.DeStatus "" VALUE 0x24c0000 __UWORD_S 0 CtApImageProcess_FreeRunning.PpBdImageProcessRead.BdSV_Normal.DeStatus.Dt_ENUM_PdDatablockStatus.CONVERSION 0 65535 ECU_ADDRESS_EXTENSION 0x80 /end CHARACTERISTIC
/begin CHARACTERISTIC CtApImageProcess_FreeRunning.PpBdImageProcessRead.BdSV_Normal.DeVersion.DeExpectedVersion.DeMajor "" VALUE 0x24c0004 __UBYTE_S 0 NO_COMPU_METHOD 0 255 ECU_ADDRESS_EXTENSION 0x80 /end CHARACTERISTIC
/begin CHARACTERISTIC CtApImageProcess_FreeRunning.PpBdImageProcessRead.BdSV_Normal.DeVersion.DeExpectedVersion.DeMinor "" VALUE 0x24c0005 __UBYTE_S 0 NO_COMPU_METHOD 0 255 ECU_ADDRESS_EXTENSION 0x80 /end CHARACTERISTIC
/begin CHARACTERISTIC CtApImageProcess_FreeRunning.PpBdImageProcessRead.BdSV_Normal.DeVersion.DeVersion.DeMajor "" VALUE 0x24c0008 __UBYTE_S 0 NO_COMPU_METHOD 0 255 ECU_ADDRESS_EXTENSION 0x80 /end CHARACTERISTIC
/begin CHARACTERISTIC CtApImageProcess_FreeRunning.PpBdImageProcessRead.BdSV_Normal.DeVersion.DeVersion.DeMinor "" VALUE 0x24c0009 __UBYTE_S 0 NO_COMPU_METHOD 0 255 ECU_ADDRESS_EXTENSION 0x80 /end CHARACTERISTIC
/begin CHARACTERISTIC CtApImageProcess_FreeRunning.PpBdImageProcessRead.BdSV_Normal.DeData "4694304 uint8 array" VAL_BLK 0x24c000c __UBYTE_S 0 NO_COMPU_METHOD 0 255 ECU_ADDRESS_EXTENSION 0x80 MATRIX_DIM 4694304 1 1 /end CHARACTERISTIC
/begin CHARACTERISTIC CtApImageProcess_FreeRunning.PpCOM_BMS_HSC1_100ms.DeBMS_HSC1_FrP11.BMSOnbdChrgrPlugOn_h1HSC1 "" VALUE 0x24d0000 __UBYTE_S 0 NO_COMPU_METHOD 0 1 ECU_ADDRESS_EXTENSION 0x80 /end CHARACTERISTIC
/begin CHARACTERISTIC CtApImageProcess_FreeRunning.PpCOM_BMS_HSC1_100ms.DeBMS_HSC1_FrP11.BMSOfbdChrgrPlugOn_h1HSC1 "" VALUE 0x24d0001 __UBYTE_S 0 NO_COMPU_METHOD 0 1 ECU_ADDRESS_EXTENSION 0x80 /end CHARACTERISTIC
/begin CHARACTERISTIC CtApImageProcess_FreeRunning.PpCOM_FICM_HSC4_50ms.DeFICM_HSC4_FrP13.CMDMODHSC4 "" VALUE 0x24e0000 __UBYTE_S 0 NO_COMPU_METHOD 0 1 ECU_ADDRESS_EXTENSION 0x80 /end CHARACTERISTIC
/begin CHARACTERISTIC CtApImageProcess_FreeRunning.PpCOM_FICM_HSC4_50ms.DeFICM_HSC4_FrP13.AlisysrdyHSC4 "" VALUE 0x24e0001 __UBYTE_S 0 NO_COMPU_METHOD 0 1 ECU_ADDRESS_EXTENSION 0x80 /end CHARACTERISTIC
/begin CHARACTERISTIC CtApImageProcess_FreeRunning.PpCOM_FICM_HSC4_AVM_100ms.DeFICM_HSC4_FrP18_FrP35_AVM.SurndViewSelnVHSC4 "" VALUE 0x24f0000 __UBYTE_S 0 NO_COMPU_METHOD 0 1 ECU_ADDRESS_EXTENSION 0x80 /end CHARACTERISTIC
/begin CHARACTERISTIC CtApImageProcess_FreeRunning.PpCOM_FICM_HSC4_AVM_100ms.DeFICM_HSC4_FrP18_FrP35_AVM.SurndViewSeln_oldHSC4 "" VALUE 0x24f0001 __UBYTE_S 0 NO_COMPU_METHOD 0 255 ECU_ADDRESS_EXTENSION 0x80 /end CHARACTERISTIC
/begin CHARACTERISTIC CtApImageProcess_FreeRunning.PpCOM_FICM_HSC4_AVM_100ms.DeFICM_HSC4_FrP18_FrP35_AVM.SurVwSlcHSC4 "" VALUE 0x24f0002 __UBYTE_S 0 NO_COMPU_METHOD 0 255 ECU_ADDRESS_EXTENSION 0x80 /end CHARACTERISTIC
/begin CHARACTERISTIC CtApImageProcess_FreeRunning.PpCOM_FICM_HSC4_AVM_100ms.DeFICM_HSC4_FrP19.AutoViewChgHSC4 "" VALUE 0x2500000 __UBYTE_S 0 NO_COMPU_METHOD 0 1 ECU_ADDRESS_EXTENSION 0x80 /end CHARACTERISTIC
/begin CHARACTERISTIC CtApImageProcess_FreeRunning.PpCOM_FICM_HSC4_AVM_10ms.DeFICM_HSC4_FrP32.SurndViewSelnHSC4 "" VALUE 0x2510000 __UBYTE_S 0 NO_COMPU_METHOD 0 255 ECU_ADDRESS_EXTENSION 0x80 /end CHARACTERISTIC
/begin CHARACTERISTIC CtApImageProcess_FreeRunning.PpCOM_FICM_HSC4_AVM_10ms.DeFICM_HSC4_FrP32.SCREEN_COORD_AXHSC4 "" VALUE 0x2510002 __UWORD_S 0 NO_COMPU_METHOD 0 65535 ECU_ADDRESS_EXTENSION 0x80 /end CHARACTERISTIC
/begin CHARACTERISTIC CtApImageProcess_FreeRunning.PpCOM_FICM_HSC4_AVM_10ms.DeFICM_HSC4_FrP32.TOUCH_SCREEN_ACMDHSC4 "" VALUE 0x2510004 __UBYTE_S 0 NO_COMPU_METHOD 0 255 ECU_ADDRESS_EXTENSION 0x80 /end CHARACTERISTIC
/begin CHARACTERISTIC CtApImageProcess_FreeRunning.PpCOM_FICM_HSC4_AVM_10ms.DeFICM_HSC4_FrP32.SCREEN_COORD_AYHSC4 "" VALUE 0x2510006 __UWORD_S 0 NO_COMPU_METHOD 0 65535 ECU_ADDRESS_EXTENSION 0x80 /end CHARACTERISTIC
/begin CHARACTERISTIC CtApImageProcess_FreeRunning.PpCOM_FICM_HSC4_AVM_10ms.DeFICM_HSC4_FrP32.TOUCH_SCREEN_STATUSHSC4 "" VALUE 0x2510008 __UBYTE_S 0 NO_COMPU_METHOD 0 255 ECU_ADDRESS_EXTENSION 0x80 /end CHARACTERISTIC
/begin CHARACTERISTIC CtApImageProcess_FreeRunning.PpCOM_FICM_HSC4_AVM_10ms.DeFICM_HSC4_FrP32.SCREEN_COORD_BXHSC4 "" VALUE 0x251000a __UWORD_S 0 NO_COMPU_METHOD 0 65535 ECU_ADDRESS_EXTENSION 0x80 /end CHARACTERISTIC
/begin CHARACTERISTIC CtApImageProcess_FreeRunning.PpCOM_FICM_HSC4_AVM_10ms.DeFICM_HSC4_FrP32.TOUCH_SCREEN_BCMDHSC4 "" VALUE 0x251000c __UBYTE_S 0 NO_COMPU_METHOD 0 255 ECU_ADDRESS_EXTENSION 0x80 /end CHARACTERISTIC
/begin CHARACTERISTIC CtApImageProcess_FreeRunning.PpCOM_FICM_HSC4_AVM_10ms.DeFICM_HSC4_FrP32.SCREEN_COORD_BYHSC4 "" VALUE 0x251000e __UWORD_S 0 NO_COMPU_METHOD 0 65535 ECU_ADDRESS_EXTENSION 0x80 /end CHARACTERISTIC
/begin CHARACTERISTIC CtApImageProcess_FreeRunning.PpCOM_TPMS_HSC3_400ms.DeTPMS_HSC3_FrP01.RRTireTemVHSC4 "" VALUE 0x2520000 __UBYTE_S 0 NO_COMPU_METHOD 0 1 ECU_ADDRESS_EXTENSION 0x80 /end CHARACTERISTIC
/begin CHARACTERISTIC CtApImageProcess_FreeRunning.PpCOM_TPMS_HSC3_400ms.DeTPMS_HSC3_FrP01.RRTireTemHSC4 "" VALUE 0x2520002 __SWORD_S 0 NO_COMPU_METHOD -32768 32767 ECU_ADDRESS_EXTENSION 0x80 /end CHARACTERISTIC
/begin CHARACTERISTIC CtApImageProcess_FreeRunning.PpCOM_TPMS_HSC3_400ms.DeTPMS_HSC3_FrP01.RRTirePrsVHSC4 "" VALUE 0x2520004 __UBYTE_S 0 NO_COMPU_METHOD 0 1 ECU_ADDRESS_EXTENSION 0x80 /end CHARACTERISTIC
/begin CHARACTERISTIC CtApImageProcess_FreeRunning.PpCOM_TPMS_HSC3_400ms.DeTPMS_HSC3_FrP01.RRTirePrsHSC4 "" VALUE 0x2520006 __UWORD_S 0 NO_COMPU_METHOD 0 65535 ECU_ADDRESS_EXTENSION 0x80 /end CHARACTERISTIC
/begin CHARACTERISTIC CtApImageProcess_FreeRunning.PpCOM_TPMS_HSC3_400ms.DeTPMS_HSC3_FrP01.RLTireTemVHSC4 "" VALUE 0x2520008 __UBYTE_S 0 NO_COMPU_METHOD 0 1 ECU_ADDRESS_EXTENSION 0x80 /end CHARACTERISTIC
/begin CHARACTERISTIC CtApImageProcess_FreeRunning.PpCOM_TPMS_HSC3_400ms.DeTPMS_HSC3_FrP01.RLTireTemHSC4 "" VALUE 0x252000a __SWORD_S 0 NO_COMPU_METHOD -32768 32767 ECU_ADDRESS_EXTENSION 0x80 /end CHARACTERISTIC
/begin CHARACTERISTIC CtApImageProcess_FreeRunning.PpCOM_TPMS_HSC3_400ms.DeTPMS_HSC3_FrP01.RLTirePrsVHSC4 "" VALUE 0x252000c __UBYTE_S 0 NO_COMPU_METHOD 0 1 ECU_ADDRESS_EXTENSION 0x80 /end CHARACTERISTIC
/begin CHARACTERISTIC CtApImageProcess_FreeRunning.PpCOM_TPMS_HSC3_400ms.DeTPMS_HSC3_FrP01.RLTirePrsHSC4 "" VALUE 0x252000e __UWORD_S 0 NO_COMPU_METHOD 0 65535 ECU_ADDRESS_EXTENSION 0x80 /end CHARACTERISTIC
/begin CHARACTERISTIC CtApImageProcess_FreeRunning.PpCOM_TPMS_HSC3_400ms.DeTPMS_HSC3_FrP01.FRTireTemVHSC4 "" VALUE 0x2520010 __UBYTE_S 0 NO_COMPU_METHOD 0 1 ECU_ADDRESS_EXTENSION 0x80 /end CHARACTERISTIC
/begin CHARACTERISTIC CtApImageProcess_FreeRunning.PpCOM_TPMS_HSC3_400ms.DeTPMS_HSC3_FrP01.FRTireTemHSC4 "" VALUE 0x2520012 __SWORD_S 0 NO_COMPU_METHOD -32768 32767 ECU_ADDRESS_EXTENSION 0x80 /end CHARACTERISTIC
/begin CHARACTERISTIC CtApImageProcess_FreeRunning.PpCOM_TPMS_HSC3_400ms.DeTPMS_HSC3_FrP01.FRTirePrsVHSC4 "" VALUE 0x2520014 __UBYTE_S 0 NO_COMPU_METHOD 0 1 ECU_ADDRESS_EXTENSION 0x80 /end CHARACTERISTIC
/begin CHARACTERISTIC CtApImageProcess_FreeRunning.PpCOM_TPMS_HSC3_400ms.DeTPMS_HSC3_FrP01.FRTirePrsHSC4 "" VALUE 0x2520016 __UWORD_S 0 NO_COMPU_METHOD 0 65535 ECU_ADDRESS_EXTENSION 0x80 /end CHARACTERISTIC
/begin CHARACTERISTIC CtApImageProcess_FreeRunning.PpCOM_TPMS_HSC3_400ms.DeTPMS_HSC3_FrP01.FLTireTemVHSC4 "" VALUE 0x2520018 __UBYTE_S 0 NO_COMPU_METHOD 0 1 ECU_ADDRESS_EXTENSION 0x80 /end CHARACTERISTIC
/begin CHARACTERISTIC CtApImageProcess_FreeRunning.PpCOM_TPMS_HSC3_400ms.DeTPMS_HSC3_FrP01.FLTireTemHSC4 "" VALUE 0x252001a __SWORD_S 0 NO_COMPU_METHOD -32768 32767 ECU_ADDRESS_EXTENSION 0x80 /end CHARACTERISTIC
/begin CHARACTERISTIC CtApImageProcess_FreeRunning.PpCOM_TPMS_HSC3_400ms.DeTPMS_HSC3_FrP01.FLTirePrsVHSC4 "" VALUE 0x252001c __UBYTE_S 0 NO_COMPU_METHOD 0 1 ECU_ADDRESS_EXTENSION 0x80 /end CHARACTERISTIC
/begin CHARACTERISTIC CtApImageProcess_FreeRunning.PpCOM_TPMS_HSC3_400ms.DeTPMS_HSC3_FrP01.FLTirePrsHSC4 "" VALUE 0x252001e __UWORD_S 0 NO_COMPU_METHOD 0 65535 ECU_ADDRESS_EXTENSION 0x80 /end CHARACTERISTIC
/begin CHARACTERISTIC CtApImageProcess_FreeRunning.PpCOM_TPMS_HSC3_400ms.DeTPMS_HSC3_FrP02.DeStatus_TPMS_HSC3_FrP02 "" VALUE 0x2530000 __UBYTE_S 0 NO_COMPU_METHOD 0 255 ECU_ADDRESS_EXTENSION 0x80 /end CHARACTERISTIC
/begin CHARACTERISTIC CtApImageProcess_FreeRunning.PpCOM_TPMS_HSC3_400ms.DeTPMS_HSC3_FrP02.FLTireStsHSC4 "" VALUE 0x2530001 __UBYTE_S 0 NO_COMPU_METHOD 0 255 ECU_ADDRESS_EXTENSION 0x80 /end CHARACTERISTIC
/begin CHARACTERISTIC CtApImageProcess_FreeRunning.PpCOM_TPMS_HSC3_400ms.DeTPMS_HSC3_FrP02.FRTireStsHSC4 "" VALUE 0x2530002 __UBYTE_S 0 NO_COMPU_METHOD 0 255 ECU_ADDRESS_EXTENSION 0x80 /end CHARACTERISTIC
/begin CHARACTERISTIC CtApImageProcess_FreeRunning.PpCOM_TPMS_HSC3_400ms.DeTPMS_HSC3_FrP02.RLTireStsHSC4 "" VALUE 0x2530003 __UBYTE_S 0 NO_COMPU_METHOD 0 255 ECU_ADDRESS_EXTENSION 0x80 /end CHARACTERISTIC
/begin CHARACTERISTIC CtApImageProcess_FreeRunning.PpCOM_TPMS_HSC3_400ms.DeTPMS_HSC3_FrP02.RRTireStsHSC4 "" VALUE 0x2530004 __UBYTE_S 0 NO_COMPU_METHOD 0 255 ECU_ADDRESS_EXTENSION 0x80 /end CHARACTERISTIC
/begin CHARACTERISTIC CtApImageProcess_FreeRunning.PpCOM_TPMS_HSC3_400ms.DeTPMS_HSC3_FrP02.DeTimestamp.DeTimestampEGT.DeTimestampHigh "" VALUE 0x2530008 __ULONG_S 0 NO_COMPU_METHOD 0 4294967295 ECU_ADDRESS_EXTENSION 0x80 /end CHARACTERISTIC
/begin CHARACTERISTIC CtApImageProcess_FreeRunning.PpCOM_TPMS_HSC3_400ms.DeTPMS_HSC3_FrP02.DeTimestamp.DeTimestampEGT.DeTimestampLow "" VALUE 0x253000c __ULONG_S 0 NO_COMPU_METHOD 0 4294967295 ECU_ADDRESS_EXTENSION 0x80 /end CHARACTERISTIC
/begin CHARACTERISTIC CtApImageProcess_FreeRunning.PpCOM_TPMS_HSC3_400ms.DeTPMS_HSC3_FrP02.DeTimestamp.DeTimestampMW_RX.DeTimestampHigh "" VALUE 0x2530010 __ULONG_S 0 NO_COMPU_METHOD 0 4294967295 ECU_ADDRESS_EXTENSION 0x80 /end CHARACTERISTIC
/begin CHARACTERISTIC CtApImageProcess_FreeRunning.PpCOM_TPMS_HSC3_400ms.DeTPMS_HSC3_FrP02.DeTimestamp.DeTimestampMW_RX.DeTimestampLow "" VALUE 0x2530014 __ULONG_S 0 NO_COMPU_METHOD 0 4294967295 ECU_ADDRESS_EXTENSION 0x80 /end CHARACTERISTIC
/begin CHARACTERISTIC CtApImageProcess_FreeRunning.PpCOM_TPMS_HSC3_400ms.DeTPMS_HSC3_FrP02.DeTimestamp.DeTimestampMW_TX.DeTimestampHigh "" VALUE 0x2530018 __ULONG_S 0 NO_COMPU_METHOD 0 4294967295 ECU_ADDRESS_EXTENSION 0x80 /end CHARACTERISTIC
/begin CHARACTERISTIC CtApImageProcess_FreeRunning.PpCOM_TPMS_HSC3_400ms.DeTPMS_HSC3_FrP02.DeTimestamp.DeTimestampMW_TX.DeTimestampLow "" VALUE 0x253001c __ULONG_S 0 NO_COMPU_METHOD 0 4294967295 ECU_ADDRESS_EXTENSION 0x80 /end CHARACTERISTIC
/begin CHARACTERISTIC CtApImageProcess_FreeRunning.PpDiagCoding.DeCoding.FW_Dummy "" VALUE 0x2540000 __UBYTE_S 0 NO_COMPU_METHOD 0 255 ECU_ADDRESS_EXTENSION 0x80 /end CHARACTERISTIC
/begin CHARACTERISTIC CtApImageProcess_FreeRunning.PpDR_Merges_10ms.DeDR_List.stHeader.Counter "" VALUE 0x2550000 __UWORD_S 0 NO_COMPU_METHOD 0 65535 ECU_ADDRESS_EXTENSION 0x80 /end CHARACTERISTIC
/begin CHARACTERISTIC CtApImageProcess_FreeRunning.PpDR_Merges_10ms.DeDR_List.stHeader.FrameID "" VALUE 0x2550002 __UBYTE_S 0 NO_COMPU_METHOD 0 255 ECU_ADDRESS_EXTENSION 0x80 /end CHARACTERISTIC
/begin CHARACTERISTIC CtApImageProcess_FreeRunning.PpDR_Merges_10ms.DeDR_List.stHeader.TimeStamp "2 uint32 array" VAL_BLK 0x2550004 __ULONG_S 0 NO_COMPU_METHOD 0 4294967295 ECU_ADDRESS_EXTENSION 0x80 MATRIX_DIM 2 1 1 /end CHARACTERISTIC
/begin CHARACTERISTIC CtApImageProcess_FreeRunning.PpDR_Merges_10ms.DeDR_List.Origin_time "" VALUE 0x2550010 __FLOAT64_IEEE_S 0 NO_COMPU_METHOD 0 3.402823e+38 ECU_ADDRESS_EXTENSION 0x80 /end CHARACTERISTIC
/begin CHARACTERISTIC CtApImageProcess_FreeRunning.PpDR_Merges_10ms.DeDR_List.Origin_utm_x "" VALUE 0x2550018 __FLOAT64_IEEE_S 0 NO_COMPU_METHOD 0 3.402823e+38 ECU_ADDRESS_EXTENSION 0x80 /end CHARACTERISTIC
/begin CHARACTERISTIC CtApImageProcess_FreeRunning.PpDR_Merges_10ms.DeDR_List.Origin_utm_y "" VALUE 0x2550020 __FLOAT64_IEEE_S 0 NO_COMPU_METHOD 0 3.402823e+38 ECU_ADDRESS_EXTENSION 0x80 /end CHARACTERISTIC
/begin CHARACTERISTIC CtApImageProcess_FreeRunning.PpDR_Merges_10ms.DeDR_List.Origin_utm_z "" VALUE 0x2550028 __FLOAT64_IEEE_S 0 NO_COMPU_METHOD 0 3.402823e+38 ECU_ADDRESS_EXTENSION 0x80 /end CHARACTERISTIC
/begin CHARACTERISTIC CtApImageProcess_FreeRunning.PpDR_Merges_10ms.DeDR_List.Origin_utm_heading "" VALUE 0x2550030 __FLOAT32_IEEE_S 0 NO_COMPU_METHOD 0 3.402823e+38 ECU_ADDRESS_EXTENSION 0x80 /end CHARACTERISTIC
/begin CHARACTERISTIC CtApImageProcess_FreeRunning.PpDR_Merges_10ms.DeDR_List.DR_List[0].stHeader.Counter "" VALUE 0x2550038 __UWORD_S 0 NO_COMPU_METHOD 0 65535 ECU_ADDRESS_EXTENSION 0x80 /end CHARACTERISTIC
/begin CHARACTERISTIC CtApImageProcess_FreeRunning.PpDR_Merges_10ms.DeDR_List.DR_List[0].stHeader.FrameID "" VALUE 0x255003a __UBYTE_S 0 NO_COMPU_METHOD 0 255 ECU_ADDRESS_EXTENSION 0x80 /end CHARACTERISTIC
/begin CHARACTERISTIC CtApImageProcess_FreeRunning.PpDR_Merges_10ms.DeDR_List.DR_List[0].stHeader.TimeStamp "2 uint32 array" VAL_BLK 0x255003c __ULONG_S 0 NO_COMPU_METHOD 0 4294967295 ECU_ADDRESS_EXTENSION 0x80 MATRIX_DIM 2 1 1 /end CHARACTERISTIC
/begin CHARACTERISTIC CtApImageProcess_FreeRunning.PpDR_Merges_10ms.DeDR_List.DR_List[0].count "" VALUE 0x2550044 __UBYTE_S 0 NO_COMPU_METHOD 0 255 ECU_ADDRESS_EXTENSION 0x80 /end CHARACTERISTIC
/begin CHARACTERISTIC CtApImageProcess_FreeRunning.PpDR_Merges_10ms.DeDR_List.DR_List[0].time_sec "" VALUE 0x2550048 __FLOAT64_IEEE_S 0 NO_COMPU_METHOD 0 3.402823e+38 ECU_ADDRESS_EXTENSION 0x80 /end CHARACTERISTIC
/begin CHARACTERISTIC CtApImageProcess_FreeRunning.PpDR_Merges_10ms.DeDR_List.DR_List[0].utm_x "" VALUE 0x2550050 __FLOAT64_IEEE_S 0 NO_COMPU_METHOD 0 3.402823e+38 ECU_ADDRESS_EXTENSION 0x80 /end CHARACTERISTIC
/begin CHARACTERISTIC CtApImageProcess_FreeRunning.PpDR_Merges_10ms.DeDR_List.DR_List[0].utm_y "" VALUE 0x2550058 __FLOAT64_IEEE_S 0 NO_COMPU_METHOD 0 3.402823e+38 ECU_ADDRESS_EXTENSION 0x80 /end CHARACTERISTIC
/begin CHARACTERISTIC CtApImageProcess_FreeRunning.PpDR_Merges_10ms.DeDR_List.DR_List[0].utm_z "" VALUE 0x2550060 __FLOAT32_IEEE_S 0 NO_COMPU_METHOD 0 3.402823e+38 ECU_ADDRESS_EXTENSION 0x80 /end CHARACTERISTIC
/begin CHARACTERISTIC CtApImageProcess_FreeRunning.PpDR_Merges_10ms.DeDR_List.DR_List[0].heading "" VALUE 0x2550064 __FLOAT32_IEEE_S 0 NO_COMPU_METHOD 0 3.402823e+38 ECU_ADDRESS_EXTENSION 0x80 /end CHARACTERISTIC
/begin CHARACTERISTIC CtApImageProcess_FreeRunning.PpDR_Merges_10ms.DeDR_List.DR_List[0].delta_x "" VALUE 0x2550068 __FLOAT32_IEEE_S 0 NO_COMPU_METHOD 0 3.402823e+38 ECU_ADDRESS_EXTENSION 0x80 /end CHARACTERISTIC
/begin CHARACTERISTIC CtApImageProcess_FreeRunning.PpDR_Merges_10ms.DeDR_List.DR_List[0].delta_y "" VALUE 0x255006c __FLOAT32_IEEE_S 0 NO_COMPU_METHOD 0 3.402823e+38 ECU_ADDRESS_EXTENSION 0x80 /end CHARACTERISTIC
/begin CHARACTERISTIC CtApImageProcess_FreeRunning.PpDR_Merges_10ms.DeDR_List.DR_List[0].delta_z "" VALUE 0x2550070 __FLOAT32_IEEE_S 0 NO_COMPU_METHOD 0 3.402823e+38 ECU_ADDRESS_EXTENSION 0x80 /end CHARACTERISTIC
/begin CHARACTERISTIC CtApImageProcess_FreeRunning.PpDR_Merges_10ms.DeDR_List.DR_List[0].delta_yaw "" VALUE 0x2550074 __FLOAT32_IEEE_S 0 NO_COMPU_METHOD 0 3.402823e+38 ECU_ADDRESS_EXTENSION 0x80 /end CHARACTERISTIC
/begin CHARACTERISTIC CtApImageProcess_FreeRunning.PpDR_Merges_10ms.DeDR_List.DR_List[0].belif "" VALUE 0x2550078 __FLOAT32_IEEE_S 0 NO_COMPU_METHOD 0 3.402823e+38 ECU_ADDRESS_EXTENSION 0x80 /end CHARACTERISTIC
/begin CHARACTERISTIC CtApImageProcess_FreeRunning.PpDR_Merges_10ms.DeDR_List.DR_List[0].reserved_int "5 uint32 array" VAL_BLK 0x255007c __ULONG_S 0 NO_COMPU_METHOD 0 4294967295 ECU_ADDRESS_EXTENSION 0x80 MATRIX_DIM 5 1 1 /end CHARACTERISTIC
/begin CHARACTERISTIC CtApImageProcess_FreeRunning.PpDR_Merges_10ms.DeDR_List.DR_List[1].stHeader.Counter "" VALUE 0x2550090 __UWORD_S 0 NO_COMPU_METHOD 0 65535 ECU_ADDRESS_EXTENSION 0x80 /end CHARACTERISTIC
/begin CHARACTERISTIC CtApImageProcess_FreeRunning.PpDR_Merges_10ms.DeDR_List.DR_List[1].stHeader.FrameID "" VALUE 0x2550092 __UBYTE_S 0 NO_COMPU_METHOD 0 255 ECU_ADDRESS_EXTENSION 0x80 /end CHARACTERISTIC
/begin CHARACTERISTIC CtApImageProcess_FreeRunning.PpDR_Merges_10ms.DeDR_List.DR_List[1].stHeader.TimeStamp "2 uint32 array" VAL_BLK 0x2550094 __ULONG_S 0 NO_COMPU_METHOD 0 4294967295 ECU_ADDRESS_EXTENSION 0x80 MATRIX_DIM 2 1 1 /end CHARACTERISTIC
/begin CHARACTERISTIC CtApImageProcess_FreeRunning.PpDR_Merges_10ms.DeDR_List.DR_List[1].count "" VALUE 0x255009c __UBYTE_S 0 NO_COMPU_METHOD 0 255 ECU_ADDRESS_EXTENSION 0x80 /end CHARACTERISTIC
/begin CHARACTERISTIC CtApImageProcess_FreeRunning.PpDR_Merges_10ms.DeDR_List.DR_List[1].time_sec "" VALUE 0x25500a0 __FLOAT64_IEEE_S 0 NO_COMPU_METHOD 0 3.402823e+38 ECU_ADDRESS_EXTENSION 0x80 /end CHARACTERISTIC
/begin CHARACTERISTIC CtApImageProcess_FreeRunning.PpDR_Merges_10ms.DeDR_List.DR_List[1].utm_x "" VALUE 0x25500a8 __FLOAT64_IEEE_S 0 NO_COMPU_METHOD 0 3.402823e+38 ECU_ADDRESS_EXTENSION 0x80 /end CHARACTERISTIC
/begin CHARACTERISTIC CtApImageProcess_FreeRunning.PpDR_Merges_10ms.DeDR_List.DR_List[1].utm_y "" VALUE 0x25500b0 __FLOAT64_IEEE_S 0 NO_COMPU_METHOD 0 3.402823e+38 ECU_ADDRESS_EXTENSION 0x80 /end CHARACTERISTIC
/begin CHARACTERISTIC CtApImageProcess_FreeRunning.PpDR_Merges_10ms.DeDR_List.DR_List[1].utm_z "" VALUE 0x25500b8 __FLOAT32_IEEE_S 0 NO_COMPU_METHOD 0 3.402823e+38 ECU_ADDRESS_EXTENSION 0x80 /end CHARACTERISTIC
/begin CHARACTERISTIC CtApImageProcess_FreeRunning.PpDR_Merges_10ms.DeDR_List.DR_List[1].heading "" VALUE 0x25500bc __FLOAT32_IEEE_S 0 NO_COMPU_METHOD 0 3.402823e+38 ECU_ADDRESS_EXTENSION 0x80 /end CHARACTERISTIC
/begin CHARACTERISTIC CtApImageProcess_FreeRunning.PpDR_Merges_10ms.DeDR_List.DR_List[1].delta_x "" VALUE 0x25500c0 __FLOAT32_IEEE_S 0 NO_COMPU_METHOD 0 3.402823e+38 ECU_ADDRESS_EXTENSION 0x80 /end CHARACTERISTIC
/begin CHARACTERISTIC CtApImageProcess_FreeRunning.PpDR_Merges_10ms.DeDR_List.DR_List[1].delta_y "" VALUE 0x25500c4 __FLOAT32_IEEE_S 0 NO_COMPU_METHOD 0 3.402823e+38 ECU_ADDRESS_EXTENSION 0x80 /end CHARACTERISTIC
/begin CHARACTERISTIC CtApImageProcess_FreeRunning.PpDR_Merges_10ms.DeDR_List.DR_List[1].delta_z "" VALUE 0x25500c8 __FLOAT32_IEEE_S 0 NO_COMPU_METHOD 0 3.402823e+38 ECU_ADDRESS_EXTENSION 0x80 /end CHARACTERISTIC
/begin CHARACTERISTIC CtApImageProcess_FreeRunning.PpDR_Merges_10ms.DeDR_List.DR_List[1].delta_yaw "" VALUE 0x25500cc __FLOAT32_IEEE_S 0 NO_COMPU_METHOD 0 3.402823e+38 ECU_ADDRESS_EXTENSION 0x80 /end CHARACTERISTIC
/begin CHARACTERISTIC CtApImageProcess_FreeRunning.PpDR_Merges_10ms.DeDR_List.DR_List[1].belif "" VALUE 0x25500d0 __FLOAT32_IEEE_S 0 NO_COMPU_METHOD 0 3.402823e+38 ECU_ADDRESS_EXTENSION 0x80 /end CHARACTERISTIC
/begin CHARACTERISTIC CtApImageProcess_FreeRunning.PpDR_Merges_10ms.DeDR_List.DR_List[1].reserved_int "5 uint32 array" VAL_BLK 0x25500d4 __ULONG_S 0 NO_COMPU_METHOD 0 4294967295 ECU_ADDRESS_EXTENSION 0x80 MATRIX_DIM 5 1 1 /end CHARACTERISTIC
/begin CHARACTERISTIC CtApImageProcess_FreeRunning.PpDR_Merges_10ms.DeDR_List.DR_List[2].stHeader.Counter "" VALUE 0x25500e8 __UWORD_S 0 NO_COMPU_METHOD 0 65535 ECU_ADDRESS_EXTENSION 0x80 /end CHARACTERISTIC
/begin CHARACTERISTIC CtApImageProcess_FreeRunning.PpDR_Merges_10ms.DeDR_List.DR_List[2].stHeader.FrameID "" VALUE 0x25500ea __UBYTE_S 0 NO_COMPU_METHOD 0 255 ECU_ADDRESS_EXTENSION 0x80 /end CHARACTERISTIC
/begin CHARACTERISTIC CtApImageProcess_FreeRunning.PpDR_Merges_10ms.DeDR_List.DR_List[2].stHeader.TimeStamp "2 uint32 array" VAL_BLK 0x25500ec __ULONG_S 0 NO_COMPU_METHOD 0 4294967295 ECU_ADDRESS_EXTENSION 0x80 MATRIX_DIM 2 1 1 /end CHARACTERISTIC
/begin CHARACTERISTIC CtApImageProcess_FreeRunning.PpDR_Merges_10ms.DeDR_List.DR_List[2].count "" VALUE 0x25500f4 __UBYTE_S 0 NO_COMPU_METHOD 0 255 ECU_ADDRESS_EXTENSION 0x80 /end CHARACTERISTIC
/begin CHARACTERISTIC CtApImageProcess_FreeRunning.PpDR_Merges_10ms.DeDR_List.DR_List[2].time_sec "" VALUE 0x25500f8 __FLOAT64_IEEE_S 0 NO_COMPU_METHOD 0 3.402823e+38 ECU_ADDRESS_EXTENSION 0x80 /end CHARACTERISTIC
/begin CHARACTERISTIC CtApImageProcess_FreeRunning.PpDR_Merges_10ms.DeDR_List.DR_List[2].utm_x "" VALUE 0x2550100 __FLOAT64_IEEE_S 0 NO_COMPU_METHOD 0 3.402823e+38 ECU_ADDRESS_EXTENSION 0x80 /end CHARACTERISTIC
/begin CHARACTERISTIC CtApImageProcess_FreeRunning.PpDR_Merges_10ms.DeDR_List.DR_List[2].utm_y "" VALUE 0x2550108 __FLOAT64_IEEE_S 0 NO_COMPU_METHOD 0 3.402823e+38 ECU_ADDRESS_EXTENSION 0x80 /end CHARACTERISTIC
/begin CHARACTERISTIC CtApImageProcess_FreeRunning.PpDR_Merges_10ms.DeDR_List.DR_List[2].utm_z "" VALUE 0x2550110 __FLOAT32_IEEE_S 0 NO_COMPU_METHOD 0 3.402823e+38 ECU_ADDRESS_EXTENSION 0x80 /end CHARACTERISTIC
/begin CHARACTERISTIC CtApImageProcess_FreeRunning.PpDR_Merges_10ms.DeDR_List.DR_List[2].heading "" VALUE 0x2550114 __FLOAT32_IEEE_S 0 NO_COMPU_METHOD 0 3.402823e+38 ECU_ADDRESS_EXTENSION 0x80 /end CHARACTERISTIC
/begin CHARACTERISTIC CtApImageProcess_FreeRunning.PpDR_Merges_10ms.DeDR_List.DR_List[2].delta_x "" VALUE 0x2550118 __FLOAT32_IEEE_S 0 NO_COMPU_METHOD 0 3.402823e+38 ECU_ADDRESS_EXTENSION 0x80 /end CHARACTERISTIC
/begin CHARACTERISTIC CtApImageProcess_FreeRunning.PpDR_Merges_10ms.DeDR_List.DR_List[2].delta_y "" VALUE 0x255011c __FLOAT32_IEEE_S 0 NO_COMPU_METHOD 0 3.402823e+38 ECU_ADDRESS_EXTENSION 0x80 /end CHARACTERISTIC
/begin CHARACTERISTIC CtApImageProcess_FreeRunning.PpDR_Merges_10ms.DeDR_List.DR_List[2].delta_z "" VALUE 0x2550120 __FLOAT32_IEEE_S 0 NO_COMPU_METHOD 0 3.402823e+38 ECU_ADDRESS_EXTENSION 0x80 /end CHARACTERISTIC
/begin CHARACTERISTIC CtApImageProcess_FreeRunning.PpDR_Merges_10ms.DeDR_List.DR_List[2].delta_yaw "" VALUE 0x2550124 __FLOAT32_IEEE_S 0 NO_COMPU_METHOD 0 3.402823e+38 ECU_ADDRESS_EXTENSION 0x80 /end CHARACTERISTIC
/begin CHARACTERISTIC CtApImageProcess_FreeRunning.PpDR_Merges_10ms.DeDR_List.DR_List[2].belif "" VALUE 0x2550128 __FLOAT32_IEEE_S 0 NO_COMPU_METHOD 0 3.402823e+38 ECU_ADDRESS_EXTENSION 0x80 /end CHARACTERISTIC
/begin CHARACTERISTIC CtApImageProcess_FreeRunning.PpDR_Merges_10ms.DeDR_List.DR_List[2].reserved_int "5 uint32 array" VAL_BLK 0x255012c __ULONG_S 0 NO_COMPU_METHOD 0 4294967295 ECU_ADDRESS_EXTENSION 0x80 MATRIX_DIM 5 1 1 /end CHARACTERISTIC
/begin CHARACTERISTIC CtApImageProcess_FreeRunning.PpDR_Merges_10ms.DeDR_List.DR_List[3].stHeader.Counter "" VALUE 0x2550140 __UWORD_S 0 NO_COMPU_METHOD 0 65535 ECU_ADDRESS_EXTENSION 0x80 /end CHARACTERISTIC
/begin CHARACTERISTIC CtApImageProcess_FreeRunning.PpDR_Merges_10ms.DeDR_List.DR_List[3].stHeader.FrameID "" VALUE 0x2550142 __UBYTE_S 0 NO_COMPU_METHOD 0 255 ECU_ADDRESS_EXTENSION 0x80 /end CHARACTERISTIC
/begin CHARACTERISTIC CtApImageProcess_FreeRunning.PpDR_Merges_10ms.DeDR_List.DR_List[3].stHeader.TimeStamp "2 uint32 array" VAL_BLK 0x2550144 __ULONG_S 0 NO_COMPU_METHOD 0 4294967295 ECU_ADDRESS_EXTENSION 0x80 MATRIX_DIM 2 1 1 /end CHARACTERISTIC
/begin CHARACTERISTIC CtApImageProcess_FreeRunning.PpDR_Merges_10ms.DeDR_List.DR_List[3].count "" VALUE 0x255014c __UBYTE_S 0 NO_COMPU_METHOD 0 255 ECU_ADDRESS_EXTENSION 0x80 /end CHARACTERISTIC
/begin CHARACTERISTIC CtApImageProcess_FreeRunning.PpDR_Merges_10ms.DeDR_List.DR_List[3].time_sec "" VALUE 0x2550150 __FLOAT64_IEEE_S 0 NO_COMPU_METHOD 0 3.402823e+38 ECU_ADDRESS_EXTENSION 0x80 /end CHARACTERISTIC
/begin CHARACTERISTIC CtApImageProcess_FreeRunning.PpDR_Merges_10ms.DeDR_List.DR_List[3].utm_x "" VALUE 0x2550158 __FLOAT64_IEEE_S 0 NO_COMPU_METHOD 0 3.402823e+38 ECU_ADDRESS_EXTENSION 0x80 /end CHARACTERISTIC
/begin CHARACTERISTIC CtApImageProcess_FreeRunning.PpDR_Merges_10ms.DeDR_List.DR_List[3].utm_y "" VALUE 0x2550160 __FLOAT64_IEEE_S 0 NO_COMPU_METHOD 0 3.402823e+38 ECU_ADDRESS_EXTENSION 0x80 /end CHARACTERISTIC
/begin CHARACTERISTIC CtApImageProcess_FreeRunning.PpDR_Merges_10ms.DeDR_List.DR_List[3].utm_z "" VALUE 0x2550168 __FLOAT32_IEEE_S 0 NO_COMPU_METHOD 0 3.402823e+38 ECU_ADDRESS_EXTENSION 0x80 /end CHARACTERISTIC
/begin CHARACTERISTIC CtApImageProcess_FreeRunning.PpDR_Merges_10ms.DeDR_List.DR_List[3].heading "" VALUE 0x255016c __FLOAT32_IEEE_S 0 NO_COMPU_METHOD 0 3.402823e+38 ECU_ADDRESS_EXTENSION 0x80 /end CHARACTERISTIC
/begin CHARACTERISTIC CtApImageProcess_FreeRunning.PpDR_Merges_10ms.DeDR_List.DR_List[3].delta_x "" VALUE 0x2550170 __FLOAT32_IEEE_S 0 NO_COMPU_METHOD 0 3.402823e+38 ECU_ADDRESS_EXTENSION 0x80 /end CHARACTERISTIC
/begin CHARACTERISTIC CtApImageProcess_FreeRunning.PpDR_Merges_10ms.DeDR_List.DR_List[3].delta_y "" VALUE 0x2550174 __FLOAT32_IEEE_S 0 NO_COMPU_METHOD 0 3.402823e+38 ECU_ADDRESS_EXTENSION 0x80 /end CHARACTERISTIC
/begin CHARACTERISTIC CtApImageProcess_FreeRunning.PpDR_Merges_10ms.DeDR_List.DR_List[3].delta_z "" VALUE 0x2550178 __FLOAT32_IEEE_S 0 NO_COMPU_METHOD 0 3.402823e+38 ECU_ADDRESS_EXTENSION 0x80 /end CHARACTERISTIC
/begin CHARACTERISTIC CtApImageProcess_FreeRunning.PpDR_Merges_10ms.DeDR_List.DR_List[3].delta_yaw "" VALUE 0x255017c __FLOAT32_IEEE_S 0 NO_COMPU_METHOD 0 3.402823e+38 ECU_ADDRESS_EXTENSION 0x80 /end CHARACTERISTIC
/begin CHARACTERISTIC CtApImageProcess_FreeRunning.PpDR_Merges_10ms.DeDR_List.DR_List[3].belif "" VALUE 0x2550180 __FLOAT32_IEEE_S 0 NO_COMPU_METHOD 0 3.402823e+38 ECU_ADDRESS_EXTENSION 0x80 /end CHARACTERISTIC
/begin CHARACTERISTIC CtApImageProcess_FreeRunning.PpDR_Merges_10ms.DeDR_List.DR_List[3].reserved_int "5 uint32 array" VAL_BLK 0x2550184 __ULONG_S 0 NO_COMPU_METHOD 0 4294967295 ECU_ADDRESS_EXTENSION 0x80 MATRIX_DIM 5 1 1 /end CHARACTERISTIC
/begin CHARACTERISTIC CtApImageProcess_FreeRunning.PpDR_Merges_10ms.DeDR_List.DR_List[4].stHeader.Counter "" VALUE 0x2550198 __UWORD_S 0 NO_COMPU_METHOD 0 65535 ECU_ADDRESS_EXTENSION 0x80 /end CHARACTERISTIC
/begin CHARACTERISTIC CtApImageProcess_FreeRunning.PpDR_Merges_10ms.DeDR_List.DR_List[4].stHeader.FrameID "" VALUE 0x255019a __UBYTE_S 0 NO_COMPU_METHOD 0 255 ECU_ADDRESS_EXTENSION 0x80 /end CHARACTERISTIC
/begin CHARACTERISTIC CtApImageProcess_FreeRunning.PpDR_Merges_10ms.DeDR_List.DR_List[4].stHeader.TimeStamp "2 uint32 array" VAL_BLK 0x255019c __ULONG_S 0 NO_COMPU_METHOD 0 4294967295 ECU_ADDRESS_EXTENSION 0x80 MATRIX_DIM 2 1 1 /end CHARACTERISTIC
/begin CHARACTERISTIC CtApImageProcess_FreeRunning.PpDR_Merges_10ms.DeDR_List.DR_List[4].count "" VALUE 0x25501a4 __UBYTE_S 0 NO_COMPU_METHOD 0 255 ECU_ADDRESS_EXTENSION 0x80 /end CHARACTERISTIC
/begin CHARACTERISTIC CtApImageProcess_FreeRunning.PpDR_Merges_10ms.DeDR_List.DR_List[4].time_sec "" VALUE 0x25501a8 __FLOAT64_IEEE_S 0 NO_COMPU_METHOD 0 3.402823e+38 ECU_ADDRESS_EXTENSION 0x80 /end CHARACTERISTIC
/begin CHARACTERISTIC CtApImageProcess_FreeRunning.PpDR_Merges_10ms.DeDR_List.DR_List[4].utm_x "" VALUE 0x25501b0 __FLOAT64_IEEE_S 0 NO_COMPU_METHOD 0 3.402823e+38 ECU_ADDRESS_EXTENSION 0x80 /end CHARACTERISTIC
/begin CHARACTERISTIC CtApImageProcess_FreeRunning.PpDR_Merges_10ms.DeDR_List.DR_List[4].utm_y "" VALUE 0x25501b8 __FLOAT64_IEEE_S 0 NO_COMPU_METHOD 0 3.402823e+38 ECU_ADDRESS_EXTENSION 0x80 /end CHARACTERISTIC
/begin CHARACTERISTIC CtApImageProcess_FreeRunning.PpDR_Merges_10ms.DeDR_List.DR_List[4].utm_z "" VALUE 0x25501c0 __FLOAT32_IEEE_S 0 NO_COMPU_METHOD 0 3.402823e+38 ECU_ADDRESS_EXTENSION 0x80 /end CHARACTERISTIC
/begin CHARACTERISTIC CtApImageProcess_FreeRunning.PpDR_Merges_10ms.DeDR_List.DR_List[4].heading "" VALUE 0x25501c4 __FLOAT32_IEEE_S 0 NO_COMPU_METHOD 0 3.402823e+38 ECU_ADDRESS_EXTENSION 0x80 /end CHARACTERISTIC
/begin CHARACTERISTIC CtApImageProcess_FreeRunning.PpDR_Merges_10ms.DeDR_List.DR_List[4].delta_x "" VALUE 0x25501c8 __FLOAT32_IEEE_S 0 NO_COMPU_METHOD 0 3.402823e+38 ECU_ADDRESS_EXTENSION 0x80 /end CHARACTERISTIC
/begin CHARACTERISTIC CtApImageProcess_FreeRunning.PpDR_Merges_10ms.DeDR_List.DR_List[4].delta_y "" VALUE 0x25501cc __FLOAT32_IEEE_S 0 NO_COMPU_METHOD 0 3.402823e+38 ECU_ADDRESS_EXTENSION 0x80 /end CHARACTERISTIC
/begin CHARACTERISTIC CtApImageProcess_FreeRunning.PpDR_Merges_10ms.DeDR_List.DR_List[4].delta_z "" VALUE 0x25501d0 __FLOAT32_IEEE_S 0 NO_COMPU_METHOD 0 3.402823e+38 ECU_ADDRESS_EXTENSION 0x80 /end CHARACTERISTIC
/begin CHARACTERISTIC CtApImageProcess_FreeRunning.PpDR_Merges_10ms.DeDR_List.DR_List[4].delta_yaw "" VALUE 0x25501d4 __FLOAT32_IEEE_S 0 NO_COMPU_METHOD 0 3.402823e+38 ECU_ADDRESS_EXTENSION 0x80 /end CHARACTERISTIC
/begin CHARACTERISTIC CtApImageProcess_FreeRunning.PpDR_Merges_10ms.DeDR_List.DR_List[4].belif "" VALUE 0x25501d8 __FLOAT32_IEEE_S 0 NO_COMPU_METHOD 0 3.402823e+38 ECU_ADDRESS_EXTENSION 0x80 /end CHARACTERISTIC
/begin CHARACTERISTIC CtApImageProcess_FreeRunning.PpDR_Merges_10ms.DeDR_List.DR_List[4].reserved_int "5 uint32 array" VAL_BLK 0x25501dc __ULONG_S 0 NO_COMPU_METHOD 0 4294967295 ECU_ADDRESS_EXTENSION 0x80 MATRIX_DIM 5 1 1 /end CHARACTERISTIC
/begin CHARACTERISTIC CtApImageProcess_FreeRunning.PpDR_Merges_10ms.DeDR_List.DR_List[5].stHeader.Counter "" VALUE 0x25501f0 __UWORD_S 0 NO_COMPU_METHOD 0 65535 ECU_ADDRESS_EXTENSION 0x80 /end CHARACTERISTIC
/begin CHARACTERISTIC CtApImageProcess_FreeRunning.PpDR_Merges_10ms.DeDR_List.DR_List[5].stHeader.FrameID "" VALUE 0x25501f2 __UBYTE_S 0 NO_COMPU_METHOD 0 255 ECU_ADDRESS_EXTENSION 0x80 /end CHARACTERISTIC
/begin CHARACTERISTIC CtApImageProcess_FreeRunning.PpDR_Merges_10ms.DeDR_List.DR_List[5].stHeader.TimeStamp "2 uint32 array" VAL_BLK 0x25501f4 __ULONG_S 0 NO_COMPU_METHOD 0 4294967295 ECU_ADDRESS_EXTENSION 0x80 MATRIX_DIM 2 1 1 /end CHARACTERISTIC
/begin CHARACTERISTIC CtApImageProcess_FreeRunning.PpDR_Merges_10ms.DeDR_List.DR_List[5].count "" VALUE 0x25501fc __UBYTE_S 0 NO_COMPU_METHOD 0 255 ECU_ADDRESS_EXTENSION 0x80 /end CHARACTERISTIC
/begin CHARACTERISTIC CtApImageProcess_FreeRunning.PpDR_Merges_10ms.DeDR_List.DR_List[5].time_sec "" VALUE 0x2550200 __FLOAT64_IEEE_S 0 NO_COMPU_METHOD 0 3.402823e+38 ECU_ADDRESS_EXTENSION 0x80 /end CHARACTERISTIC
/begin CHARACTERISTIC CtApImageProcess_FreeRunning.PpDR_Merges_10ms.DeDR_List.DR_List[5].utm_x "" VALUE 0x2550208 __FLOAT64_IEEE_S 0 NO_COMPU_METHOD 0 3.402823e+38 ECU_ADDRESS_EXTENSION 0x80 /end CHARACTERISTIC
/begin CHARACTERISTIC CtApImageProcess_FreeRunning.PpDR_Merges_10ms.DeDR_List.DR_List[5].utm_y "" VALUE 0x2550210 __FLOAT64_IEEE_S 0 NO_COMPU_METHOD 0 3.402823e+38 ECU_ADDRESS_EXTENSION 0x80 /end CHARACTERISTIC
/begin CHARACTERISTIC CtApImageProcess_FreeRunning.PpDR_Merges_10ms.DeDR_List.DR_List[5].utm_z "" VALUE 0x2550218 __FLOAT32_IEEE_S 0 NO_COMPU_METHOD 0 3.402823e+38 ECU_ADDRESS_EXTENSION 0x80 /end CHARACTERISTIC
/begin CHARACTERISTIC CtApImageProcess_FreeRunning.PpDR_Merges_10ms.DeDR_List.DR_List[5].heading "" VALUE 0x255021c __FLOAT32_IEEE_S 0 NO_COMPU_METHOD 0 3.402823e+38 ECU_ADDRESS_EXTENSION 0x80 /end CHARACTERISTIC
/begin CHARACTERISTIC CtApImageProcess_FreeRunning.PpDR_Merges_10ms.DeDR_List.DR_List[5].delta_x "" VALUE 0x2550220 __FLOAT32_IEEE_S 0 NO_COMPU_METHOD 0 3.402823e+38 ECU_ADDRESS_EXTENSION 0x80 /end CHARACTERISTIC
/begin CHARACTERISTIC CtApImageProcess_FreeRunning.PpDR_Merges_10ms.DeDR_List.DR_List[5].delta_y "" VALUE 0x2550224 __FLOAT32_IEEE_S 0 NO_COMPU_METHOD 0 3.402823e+38 ECU_ADDRESS_EXTENSION 0x80 /end CHARACTERISTIC
/begin CHARACTERISTIC CtApImageProcess_FreeRunning.PpDR_Merges_10ms.DeDR_List.DR_List[5].delta_z "" VALUE 0x2550228 __FLOAT32_IEEE_S 0 NO_COMPU_METHOD 0 3.402823e+38 ECU_ADDRESS_EXTENSION 0x80 /end CHARACTERISTIC
/begin CHARACTERISTIC CtApImageProcess_FreeRunning.PpDR_Merges_10ms.DeDR_List.DR_List[5].delta_yaw "" VALUE 0x255022c __FLOAT32_IEEE_S 0 NO_COMPU_METHOD 0 3.402823e+38 ECU_ADDRESS_EXTENSION 0x80 /end CHARACTERISTIC
/begin CHARACTERISTIC CtApImageProcess_FreeRunning.PpDR_Merges_10ms.DeDR_List.DR_List[5].belif "" VALUE 0x2550230 __FLOAT32_IEEE_S 0 NO_COMPU_METHOD 0 3.402823e+38 ECU_ADDRESS_EXTENSION 0x80 /end CHARACTERISTIC
/begin CHARACTERISTIC CtApImageProcess_FreeRunning.PpDR_Merges_10ms.DeDR_List.DR_List[5].reserved_int "5 uint32 array" VAL_BLK 0x2550234 __ULONG_S 0 NO_COMPU_METHOD 0 4294967295 ECU_ADDRESS_EXTENSION 0x80 MATRIX_DIM 5 1 1 /end CHARACTERISTIC
/begin CHARACTERISTIC CtApImageProcess_FreeRunning.PpDR_Merges_10ms.DeDR_List.DR_List[6].stHeader.Counter "" VALUE 0x2550248 __UWORD_S 0 NO_COMPU_METHOD 0 65535 ECU_ADDRESS_EXTENSION 0x80 /end CHARACTERISTIC
/begin CHARACTERISTIC CtApImageProcess_FreeRunning.PpDR_Merges_10ms.DeDR_List.DR_List[6].stHeader.FrameID "" VALUE 0x255024a __UBYTE_S 0 NO_COMPU_METHOD 0 255 ECU_ADDRESS_EXTENSION 0x80 /end CHARACTERISTIC
/begin CHARACTERISTIC CtApImageProcess_FreeRunning.PpDR_Merges_10ms.DeDR_List.DR_List[6].stHeader.TimeStamp "2 uint32 array" VAL_BLK 0x255024c __ULONG_S 0 NO_COMPU_METHOD 0 4294967295 ECU_ADDRESS_EXTENSION 0x80 MATRIX_DIM 2 1 1 /end CHARACTERISTIC
/begin CHARACTERISTIC CtApImageProcess_FreeRunning.PpDR_Merges_10ms.DeDR_List.DR_List[6].count "" VALUE 0x2550254 __UBYTE_S 0 NO_COMPU_METHOD 0 255 ECU_ADDRESS_EXTENSION 0x80 /end CHARACTERISTIC
/begin CHARACTERISTIC CtApImageProcess_FreeRunning.PpDR_Merges_10ms.DeDR_List.DR_List[6].time_sec "" VALUE 0x2550258 __FLOAT64_IEEE_S 0 NO_COMPU_METHOD 0 3.402823e+38 ECU_ADDRESS_EXTENSION 0x80 /end CHARACTERISTIC
/begin CHARACTERISTIC CtApImageProcess_FreeRunning.PpDR_Merges_10ms.DeDR_List.DR_List[6].utm_x "" VALUE 0x2550260 __FLOAT64_IEEE_S 0 NO_COMPU_METHOD 0 3.402823e+38 ECU_ADDRESS_EXTENSION 0x80 /end CHARACTERISTIC
/begin CHARACTERISTIC CtApImageProcess_FreeRunning.PpDR_Merges_10ms.DeDR_List.DR_List[6].utm_y "" VALUE 0x2550268 __FLOAT64_IEEE_S 0 NO_COMPU_METHOD 0 3.402823e+38 ECU_ADDRESS_EXTENSION 0x80 /end CHARACTERISTIC
/begin CHARACTERISTIC CtApImageProcess_FreeRunning.PpDR_Merges_10ms.DeDR_List.DR_List[6].utm_z "" VALUE 0x2550270 __FLOAT32_IEEE_S 0 NO_COMPU_METHOD 0 3.402823e+38 ECU_ADDRESS_EXTENSION 0x80 /end CHARACTERISTIC
/begin CHARACTERISTIC CtApImageProcess_FreeRunning.PpDR_Merges_10ms.DeDR_List.DR_List[6].heading "" VALUE 0x2550274 __FLOAT32_IEEE_S 0 NO_COMPU_METHOD 0 3.402823e+38 ECU_ADDRESS_EXTENSION 0x80 /end CHARACTERISTIC
/begin CHARACTERISTIC CtApImageProcess_FreeRunning.PpDR_Merges_10ms.DeDR_List.DR_List[6].delta_x "" VALUE 0x2550278 __FLOAT32_IEEE_S 0 NO_COMPU_METHOD 0 3.402823e+38 ECU_ADDRESS_EXTENSION 0x80 /end CHARACTERISTIC
/begin CHARACTERISTIC CtApImageProcess_FreeRunning.PpDR_Merges_10ms.DeDR_List.DR_List[6].delta_y "" VALUE 0x255027c __FLOAT32_IEEE_S 0 NO_COMPU_METHOD 0 3.402823e+38 ECU_ADDRESS_EXTENSION 0x80 /end CHARACTERISTIC
/begin CHARACTERISTIC CtApImageProcess_FreeRunning.PpDR_Merges_10ms.DeDR_List.DR_List[6].delta_z "" VALUE 0x2550280 __FLOAT32_IEEE_S 0 NO_COMPU_METHOD 0 3.402823e+38 ECU_ADDRESS_EXTENSION 0x80 /end CHARACTERISTIC
/begin CHARACTERISTIC CtApImageProcess_FreeRunning.PpDR_Merges_10ms.DeDR_List.DR_List[6].delta_yaw "" VALUE 0x2550284 __FLOAT32_IEEE_S 0 NO_COMPU_METHOD 0 3.402823e+38 ECU_ADDRESS_EXTENSION 0x80 /end CHARACTERISTIC
/begin CHARACTERISTIC CtApImageProcess_FreeRunning.PpDR_Merges_10ms.DeDR_List.DR_List[6].belif "" VALUE 0x2550288 __FLOAT32_IEEE_S 0 NO_COMPU_METHOD 0 3.402823e+38 ECU_ADDRESS_EXTENSION 0x80 /end CHARACTERISTIC
/begin CHARACTERISTIC CtApImageProcess_FreeRunning.PpDR_Merges_10ms.DeDR_List.DR_List[6].reserved_int "5 uint32 array" VAL_BLK 0x255028c __ULONG_S 0 NO_COMPU_METHOD 0 4294967295 ECU_ADDRESS_EXTENSION 0x80 MATRIX_DIM 5 1 1 /end CHARACTERISTIC
/begin CHARACTERISTIC CtApImageProcess_FreeRunning.PpDR_Merges_10ms.DeDR_List.DR_List[7].stHeader.Counter "" VALUE 0x25502a0 __UWORD_S 0 NO_COMPU_METHOD 0 65535 ECU_ADDRESS_EXTENSION 0x80 /end CHARACTERISTIC
/begin CHARACTERISTIC CtApImageProcess_FreeRunning.PpDR_Merges_10ms.DeDR_List.DR_List[7].stHeader.FrameID "" VALUE 0x25502a2 __UBYTE_S 0 NO_COMPU_METHOD 0 255 ECU_ADDRESS_EXTENSION 0x80 /end CHARACTERISTIC
/begin CHARACTERISTIC CtApImageProcess_FreeRunning.PpDR_Merges_10ms.DeDR_List.DR_List[7].stHeader.TimeStamp "2 uint32 array" VAL_BLK 0x25502a4 __ULONG_S 0 NO_COMPU_METHOD 0 4294967295 ECU_ADDRESS_EXTENSION 0x80 MATRIX_DIM 2 1 1 /end CHARACTERISTIC
/begin CHARACTERISTIC CtApImageProcess_FreeRunning.PpDR_Merges_10ms.DeDR_List.DR_List[7].count "" VALUE 0x25502ac __UBYTE_S 0 NO_COMPU_METHOD 0 255 ECU_ADDRESS_EXTENSION 0x80 /end CHARACTERISTIC
/begin CHARACTERISTIC CtApImageProcess_FreeRunning.PpDR_Merges_10ms.DeDR_List.DR_List[7].time_sec "" VALUE 0x25502b0 __FLOAT64_IEEE_S 0 NO_COMPU_METHOD 0 3.402823e+38 ECU_ADDRESS_EXTENSION 0x80 /end CHARACTERISTIC
/begin CHARACTERISTIC CtApImageProcess_FreeRunning.PpDR_Merges_10ms.DeDR_List.DR_List[7].utm_x "" VALUE 0x25502b8 __FLOAT64_IEEE_S 0 NO_COMPU_METHOD 0 3.402823e+38 ECU_ADDRESS_EXTENSION 0x80 /end CHARACTERISTIC
/begin CHARACTERISTIC CtApImageProcess_FreeRunning.PpDR_Merges_10ms.DeDR_List.DR_List[7].utm_y "" VALUE 0x25502c0 __FLOAT64_IEEE_S 0 NO_COMPU_METHOD 0 3.402823e+38 ECU_ADDRESS_EXTENSION 0x80 /end CHARACTERISTIC
/begin CHARACTERISTIC CtApImageProcess_FreeRunning.PpDR_Merges_10ms.DeDR_List.DR_List[7].utm_z "" VALUE 0x25502c8 __FLOAT32_IEEE_S 0 NO_COMPU_METHOD 0 3.402823e+38 ECU_ADDRESS_EXTENSION 0x80 /end CHARACTERISTIC
/begin CHARACTERISTIC CtApImageProcess_FreeRunning.PpDR_Merges_10ms.DeDR_List.DR_List[7].heading "" VALUE 0x25502cc __FLOAT32_IEEE_S 0 NO_COMPU_METHOD 0 3.402823e+38 ECU_ADDRESS_EXTENSION 0x80 /end CHARACTERISTIC
/begin CHARACTERISTIC CtApImageProcess_FreeRunning.PpDR_Merges_10ms.DeDR_List.DR_List[7].delta_x "" VALUE 0x25502d0 __FLOAT32_IEEE_S 0 NO_COMPU_METHOD 0 3.402823e+38 ECU_ADDRESS_EXTENSION 0x80 /end CHARACTERISTIC
/begin CHARACTERISTIC CtApImageProcess_FreeRunning.PpDR_Merges_10ms.DeDR_List.DR_List[7].delta_y "" VALUE 0x25502d4 __FLOAT32_IEEE_S 0 NO_COMPU_METHOD 0 3.402823e+38 ECU_ADDRESS_EXTENSION 0x80 /end CHARACTERISTIC
/begin CHARACTERISTIC CtApImageProcess_FreeRunning.PpDR_Merges_10ms.DeDR_List.DR_List[7].delta_z "" VALUE 0x25502d8 __FLOAT32_IEEE_S 0 NO_COMPU_METHOD 0 3.402823e+38 ECU_ADDRESS_EXTENSION 0x80 /end CHARACTERISTIC
/begin CHARACTERISTIC CtApImageProcess_FreeRunning.PpDR_Merges_10ms.DeDR_List.DR_List[7].delta_yaw "" VALUE 0x25502dc __FLOAT32_IEEE_S 0 NO_COMPU_METHOD 0 3.402823e+38 ECU_ADDRESS_EXTENSION 0x80 /end CHARACTERISTIC
/begin CHARACTERISTIC CtApImageProcess_FreeRunning.PpDR_Merges_10ms.DeDR_List.DR_List[7].belif "" VALUE 0x25502e0 __FLOAT32_IEEE_S 0 NO_COMPU_METHOD 0 3.402823e+38 ECU_ADDRESS_EXTENSION 0x80 /end CHARACTERISTIC
/begin CHARACTERISTIC CtApImageProcess_FreeRunning.PpDR_Merges_10ms.DeDR_List.DR_List[7].reserved_int "5 uint32 array" VAL_BLK 0x25502e4 __ULONG_S 0 NO_COMPU_METHOD 0 4294967295 ECU_ADDRESS_EXTENSION 0x80 MATRIX_DIM 5 1 1 /end CHARACTERISTIC
/begin CHARACTERISTIC CtApImageProcess_FreeRunning.PpDR_Merges_10ms.DeDR_List.DR_List[8].stHeader.Counter "" VALUE 0x25502f8 __UWORD_S 0 NO_COMPU_METHOD 0 65535 ECU_ADDRESS_EXTENSION 0x80 /end CHARACTERISTIC
/begin CHARACTERISTIC CtApImageProcess_FreeRunning.PpDR_Merges_10ms.DeDR_List.DR_List[8].stHeader.FrameID "" VALUE 0x25502fa __UBYTE_S 0 NO_COMPU_METHOD 0 255 ECU_ADDRESS_EXTENSION 0x80 /end CHARACTERISTIC
/begin CHARACTERISTIC CtApImageProcess_FreeRunning.PpDR_Merges_10ms.DeDR_List.DR_List[8].stHeader.TimeStamp "2 uint32 array" VAL_BLK 0x25502fc __ULONG_S 0 NO_COMPU_METHOD 0 4294967295 ECU_ADDRESS_EXTENSION 0x80 MATRIX_DIM 2 1 1 /end CHARACTERISTIC
/begin CHARACTERISTIC CtApImageProcess_FreeRunning.PpDR_Merges_10ms.DeDR_List.DR_List[8].count "" VALUE 0x2550304 __UBYTE_S 0 NO_COMPU_METHOD 0 255 ECU_ADDRESS_EXTENSION 0x80 /end CHARACTERISTIC
/begin CHARACTERISTIC CtApImageProcess_FreeRunning.PpDR_Merges_10ms.DeDR_List.DR_List[8].time_sec "" VALUE 0x2550308 __FLOAT64_IEEE_S 0 NO_COMPU_METHOD 0 3.402823e+38 ECU_ADDRESS_EXTENSION 0x80 /end CHARACTERISTIC
/begin CHARACTERISTIC CtApImageProcess_FreeRunning.PpDR_Merges_10ms.DeDR_List.DR_List[8].utm_x "" VALUE 0x2550310 __FLOAT64_IEEE_S 0 NO_COMPU_METHOD 0 3.402823e+38 ECU_ADDRESS_EXTENSION 0x80 /end CHARACTERISTIC
/begin CHARACTERISTIC CtApImageProcess_FreeRunning.PpDR_Merges_10ms.DeDR_List.DR_List[8].utm_y "" VALUE 0x2550318 __FLOAT64_IEEE_S 0 NO_COMPU_METHOD 0 3.402823e+38 ECU_ADDRESS_EXTENSION 0x80 /end CHARACTERISTIC
/begin CHARACTERISTIC CtApImageProcess_FreeRunning.PpDR_Merges_10ms.DeDR_List.DR_List[8].utm_z "" VALUE 0x2550320 __FLOAT32_IEEE_S 0 NO_COMPU_METHOD 0 3.402823e+38 ECU_ADDRESS_EXTENSION 0x80 /end CHARACTERISTIC
/begin CHARACTERISTIC CtApImageProcess_FreeRunning.PpDR_Merges_10ms.DeDR_List.DR_List[8].heading "" VALUE 0x2550324 __FLOAT32_IEEE_S 0 NO_COMPU_METHOD 0 3.402823e+38 ECU_ADDRESS_EXTENSION 0x80 /end CHARACTERISTIC
/begin CHARACTERISTIC CtApImageProcess_FreeRunning.PpDR_Merges_10ms.DeDR_List.DR_List[8].delta_x "" VALUE 0x2550328 __FLOAT32_IEEE_S 0 NO_COMPU_METHOD 0 3.402823e+38 ECU_ADDRESS_EXTENSION 0x80 /end CHARACTERISTIC
/begin CHARACTERISTIC CtApImageProcess_FreeRunning.PpDR_Merges_10ms.DeDR_List.DR_List[8].delta_y "" VALUE 0x255032c __FLOAT32_IEEE_S 0 NO_COMPU_METHOD 0 3.402823e+38 ECU_ADDRESS_EXTENSION 0x80 /end CHARACTERISTIC
/begin CHARACTERISTIC CtApImageProcess_FreeRunning.PpDR_Merges_10ms.DeDR_List.DR_List[8].delta_z "" VALUE 0x2550330 __FLOAT32_IEEE_S 0 NO_COMPU_METHOD 0 3.402823e+38 ECU_ADDRESS_EXTENSION 0x80 /end CHARACTERISTIC
/begin CHARACTERISTIC CtApImageProcess_FreeRunning.PpDR_Merges_10ms.DeDR_List.DR_List[8].delta_yaw "" VALUE 0x2550334 __FLOAT32_IEEE_S 0 NO_COMPU_METHOD 0 3.402823e+38 ECU_ADDRESS_EXTENSION 0x80 /end CHARACTERISTIC
/begin CHARACTERISTIC CtApImageProcess_FreeRunning.PpDR_Merges_10ms.DeDR_List.DR_List[8].belif "" VALUE 0x2550338 __FLOAT32_IEEE_S 0 NO_COMPU_METHOD 0 3.402823e+38 ECU_ADDRESS_EXTENSION 0x80 /end CHARACTERISTIC
/begin CHARACTERISTIC CtApImageProcess_FreeRunning.PpDR_Merges_10ms.DeDR_List.DR_List[8].reserved_int "5 uint32 array" VAL_BLK 0x255033c __ULONG_S 0 NO_COMPU_METHOD 0 4294967295 ECU_ADDRESS_EXTENSION 0x80 MATRIX_DIM 5 1 1 /end CHARACTERISTIC
/begin CHARACTERISTIC CtApImageProcess_FreeRunning.PpDR_Merges_10ms.DeDR_List.DR_List[9].stHeader.Counter "" VALUE 0x2550350 __UWORD_S 0 NO_COMPU_METHOD 0 65535 ECU_ADDRESS_EXTENSION 0x80 /end CHARACTERISTIC
/begin CHARACTERISTIC CtApImageProcess_FreeRunning.PpDR_Merges_10ms.DeDR_List.DR_List[9].stHeader.FrameID "" VALUE 0x2550352 __UBYTE_S 0 NO_COMPU_METHOD 0 255 ECU_ADDRESS_EXTENSION 0x80 /end CHARACTERISTIC
/begin CHARACTERISTIC CtApImageProcess_FreeRunning.PpDR_Merges_10ms.DeDR_List.DR_List[9].stHeader.TimeStamp "2 uint32 array" VAL_BLK 0x2550354 __ULONG_S 0 NO_COMPU_METHOD 0 4294967295 ECU_ADDRESS_EXTENSION 0x80 MATRIX_DIM 2 1 1 /end CHARACTERISTIC
/begin CHARACTERISTIC CtApImageProcess_FreeRunning.PpDR_Merges_10ms.DeDR_List.DR_List[9].count "" VALUE 0x255035c __UBYTE_S 0 NO_COMPU_METHOD 0 255 ECU_ADDRESS_EXTENSION 0x80 /end CHARACTERISTIC
/begin CHARACTERISTIC CtApImageProcess_FreeRunning.PpDR_Merges_10ms.DeDR_List.DR_List[9].time_sec "" VALUE 0x2550360 __FLOAT64_IEEE_S 0 NO_COMPU_METHOD 0 3.402823e+38 ECU_ADDRESS_EXTENSION 0x80 /end CHARACTERISTIC
/begin CHARACTERISTIC CtApImageProcess_FreeRunning.PpDR_Merges_10ms.DeDR_List.DR_List[9].utm_x "" VALUE 0x2550368 __FLOAT64_IEEE_S 0 NO_COMPU_METHOD 0 3.402823e+38 ECU_ADDRESS_EXTENSION 0x80 /end CHARACTERISTIC
/begin CHARACTERISTIC CtApImageProcess_FreeRunning.PpDR_Merges_10ms.DeDR_List.DR_List[9].utm_y "" VALUE 0x2550370 __FLOAT64_IEEE_S 0 NO_COMPU_METHOD 0 3.402823e+38 ECU_ADDRESS_EXTENSION 0x80 /end CHARACTERISTIC
/begin CHARACTERISTIC CtApImageProcess_FreeRunning.PpDR_Merges_10ms.DeDR_List.DR_List[9].utm_z "" VALUE 0x2550378 __FLOAT32_IEEE_S 0 NO_COMPU_METHOD 0 3.402823e+38 ECU_ADDRESS_EXTENSION 0x80 /end CHARACTERISTIC
/begin CHARACTERISTIC CtApImageProcess_FreeRunning.PpDR_Merges_10ms.DeDR_List.DR_List[9].heading "" VALUE 0x255037c __FLOAT32_IEEE_S 0 NO_COMPU_METHOD 0 3.402823e+38 ECU_ADDRESS_EXTENSION 0x80 /end CHARACTERISTIC
/begin CHARACTERISTIC CtApImageProcess_FreeRunning.PpDR_Merges_10ms.DeDR_List.DR_List[9].delta_x "" VALUE 0x2550380 __FLOAT32_IEEE_S 0 NO_COMPU_METHOD 0 3.402823e+38 ECU_ADDRESS_EXTENSION 0x80 /end CHARACTERISTIC
/begin CHARACTERISTIC CtApImageProcess_FreeRunning.PpDR_Merges_10ms.DeDR_List.DR_List[9].delta_y "" VALUE 0x2550384 __FLOAT32_IEEE_S 0 NO_COMPU_METHOD 0 3.402823e+38 ECU_ADDRESS_EXTENSION 0x80 /end CHARACTERISTIC
/begin CHARACTERISTIC CtApImageProcess_FreeRunning.PpDR_Merges_10ms.DeDR_List.DR_List[9].delta_z "" VALUE 0x2550388 __FLOAT32_IEEE_S 0 NO_COMPU_METHOD 0 3.402823e+38 ECU_ADDRESS_EXTENSION 0x80 /end CHARACTERISTIC
/begin CHARACTERISTIC CtApImageProcess_FreeRunning.PpDR_Merges_10ms.DeDR_List.DR_List[9].delta_yaw "" VALUE 0x255038c __FLOAT32_IEEE_S 0 NO_COMPU_METHOD 0 3.402823e+38 ECU_ADDRESS_EXTENSION 0x80 /end CHARACTERISTIC
/begin CHARACTERISTIC CtApImageProcess_FreeRunning.PpDR_Merges_10ms.DeDR_List.DR_List[9].belif "" VALUE 0x2550390 __FLOAT32_IEEE_S 0 NO_COMPU_METHOD 0 3.402823e+38 ECU_ADDRESS_EXTENSION 0x80 /end CHARACTERISTIC
/begin CHARACTERISTIC CtApImageProcess_FreeRunning.PpDR_Merges_10ms.DeDR_List.DR_List[9].reserved_int "5 uint32 array" VAL_BLK 0x2550394 __ULONG_S 0 NO_COMPU_METHOD 0 4294967295 ECU_ADDRESS_EXTENSION 0x80 MATRIX_DIM 5 1 1 /end CHARACTERISTIC
/begin CHARACTERISTIC CtApImageProcess_FreeRunning.PpDR_Merges_10ms.DeDR_List.DR_List[10].stHeader.Counter "" VALUE 0x25503a8 __UWORD_S 0 NO_COMPU_METHOD 0 65535 ECU_ADDRESS_EXTENSION 0x80 /end CHARACTERISTIC
/begin CHARACTERISTIC CtApImageProcess_FreeRunning.PpDR_Merges_10ms.DeDR_List.DR_List[10].stHeader.FrameID "" VALUE 0x25503aa __UBYTE_S 0 NO_COMPU_METHOD 0 255 ECU_ADDRESS_EXTENSION 0x80 /end CHARACTERISTIC
/begin CHARACTERISTIC CtApImageProcess_FreeRunning.PpDR_Merges_10ms.DeDR_List.DR_List[10].stHeader.TimeStamp "2 uint32 array" VAL_BLK 0x25503ac __ULONG_S 0 NO_COMPU_METHOD 0 4294967295 ECU_ADDRESS_EXTENSION 0x80 MATRIX_DIM 2 1 1 /end CHARACTERISTIC
/begin CHARACTERISTIC CtApImageProcess_FreeRunning.PpDR_Merges_10ms.DeDR_List.DR_List[10].count "" VALUE 0x25503b4 __UBYTE_S 0 NO_COMPU_METHOD 0 255 ECU_ADDRESS_EXTENSION 0x80 /end CHARACTERISTIC
/begin CHARACTERISTIC CtApImageProcess_FreeRunning.PpDR_Merges_10ms.DeDR_List.DR_List[10].time_sec "" VALUE 0x25503b8 __FLOAT64_IEEE_S 0 NO_COMPU_METHOD 0 3.402823e+38 ECU_ADDRESS_EXTENSION 0x80 /end CHARACTERISTIC
/begin CHARACTERISTIC CtApImageProcess_FreeRunning.PpDR_Merges_10ms.DeDR_List.DR_List[10].utm_x "" VALUE 0x25503c0 __FLOAT64_IEEE_S 0 NO_COMPU_METHOD 0 3.402823e+38 ECU_ADDRESS_EXTENSION 0x80 /end CHARACTERISTIC
/begin CHARACTERISTIC CtApImageProcess_FreeRunning.PpDR_Merges_10ms.DeDR_List.DR_List[10].utm_y "" VALUE 0x25503c8 __FLOAT64_IEEE_S 0 NO_COMPU_METHOD 0 3.402823e+38 ECU_ADDRESS_EXTENSION 0x80 /end CHARACTERISTIC
/begin CHARACTERISTIC CtApImageProcess_FreeRunning.PpDR_Merges_10ms.DeDR_List.DR_List[10].utm_z "" VALUE 0x25503d0 __FLOAT32_IEEE_S 0 NO_COMPU_METHOD 0 3.402823e+38 ECU_ADDRESS_EXTENSION 0x80 /end CHARACTERISTIC
/begin CHARACTERISTIC CtApImageProcess_FreeRunning.PpDR_Merges_10ms.DeDR_List.DR_List[10].heading "" VALUE 0x25503d4 __FLOAT32_IEEE_S 0 NO_COMPU_METHOD 0 3.402823e+38 ECU_ADDRESS_EXTENSION 0x80 /end CHARACTERISTIC
/begin CHARACTERISTIC CtApImageProcess_FreeRunning.PpDR_Merges_10ms.DeDR_List.DR_List[10].delta_x "" VALUE 0x25503d8 __FLOAT32_IEEE_S 0 NO_COMPU_METHOD 0 3.402823e+38 ECU_ADDRESS_EXTENSION 0x80 /end CHARACTERISTIC
/begin CHARACTERISTIC CtApImageProcess_FreeRunning.PpDR_Merges_10ms.DeDR_List.DR_List[10].delta_y "" VALUE 0x25503dc __FLOAT32_IEEE_S 0 NO_COMPU_METHOD 0 3.402823e+38 ECU_ADDRESS_EXTENSION 0x80 /end CHARACTERISTIC
/begin CHARACTERISTIC CtApImageProcess_FreeRunning.PpDR_Merges_10ms.DeDR_List.DR_List[10].delta_z "" VALUE 0x25503e0 __FLOAT32_IEEE_S 0 NO_COMPU_METHOD 0 3.402823e+38 ECU_ADDRESS_EXTENSION 0x80 /end CHARACTERISTIC
/begin CHARACTERISTIC CtApImageProcess_FreeRunning.PpDR_Merges_10ms.DeDR_List.DR_List[10].delta_yaw "" VALUE 0x25503e4 __FLOAT32_IEEE_S 0 NO_COMPU_METHOD 0 3.402823e+38 ECU_ADDRESS_EXTENSION 0x80 /end CHARACTERISTIC
/begin CHARACTERISTIC CtApImageProcess_FreeRunning.PpDR_Merges_10ms.DeDR_List.DR_List[10].belif "" VALUE 0x25503e8 __FLOAT32_IEEE_S 0 NO_COMPU_METHOD 0 3.402823e+38 ECU_ADDRESS_EXTENSION 0x80 /end CHARACTERISTIC
/begin CHARACTERISTIC CtApImageProcess_FreeRunning.PpDR_Merges_10ms.DeDR_List.DR_List[10].reserved_int "5 uint32 array" VAL_BLK 0x25503ec __ULONG_S 0 NO_COMPU_METHOD 0 4294967295 ECU_ADDRESS_EXTENSION 0x80 MATRIX_DIM 5 1 1 /end CHARACTERISTIC
/begin CHARACTERISTIC CtApImageProcess_FreeRunning.PpDR_Merges_10ms.DeDR_List.DR_List[11].stHeader.Counter "" VALUE 0x2550400 __UWORD_S 0 NO_COMPU_METHOD 0 65535 ECU_ADDRESS_EXTENSION 0x80 /end CHARACTERISTIC
/begin CHARACTERISTIC CtApImageProcess_FreeRunning.PpDR_Merges_10ms.DeDR_List.DR_List[11].stHeader.FrameID "" VALUE 0x2550402 __UBYTE_S 0 NO_COMPU_METHOD 0 255 ECU_ADDRESS_EXTENSION 0x80 /end CHARACTERISTIC
/begin CHARACTERISTIC CtApImageProcess_FreeRunning.PpDR_Merges_10ms.DeDR_List.DR_List[11].stHeader.TimeStamp "2 uint32 array" VAL_BLK 0x2550404 __ULONG_S 0 NO_COMPU_METHOD 0 4294967295 ECU_ADDRESS_EXTENSION 0x80 MATRIX_DIM 2 1 1 /end CHARACTERISTIC
/begin CHARACTERISTIC CtApImageProcess_FreeRunning.PpDR_Merges_10ms.DeDR_List.DR_List[11].count "" VALUE 0x255040c __UBYTE_S 0 NO_COMPU_METHOD 0 255 ECU_ADDRESS_EXTENSION 0x80 /end CHARACTERISTIC
/begin CHARACTERISTIC CtApImageProcess_FreeRunning.PpDR_Merges_10ms.DeDR_List.DR_List[11].time_sec "" VALUE 0x2550410 __FLOAT64_IEEE_S 0 NO_COMPU_METHOD 0 3.402823e+38 ECU_ADDRESS_EXTENSION 0x80 /end CHARACTERISTIC
/begin CHARACTERISTIC CtApImageProcess_FreeRunning.PpDR_Merges_10ms.DeDR_List.DR_List[11].utm_x "" VALUE 0x2550418 __FLOAT64_IEEE_S 0 NO_COMPU_METHOD 0 3.402823e+38 ECU_ADDRESS_EXTENSION 0x80 /end CHARACTERISTIC
/begin CHARACTERISTIC CtApImageProcess_FreeRunning.PpDR_Merges_10ms.DeDR_List.DR_List[11].utm_y "" VALUE 0x2550420 __FLOAT64_IEEE_S 0 NO_COMPU_METHOD 0 3.402823e+38 ECU_ADDRESS_EXTENSION 0x80 /end CHARACTERISTIC
/begin CHARACTERISTIC CtApImageProcess_FreeRunning.PpDR_Merges_10ms.DeDR_List.DR_List[11].utm_z "" VALUE 0x2550428 __FLOAT32_IEEE_S 0 NO_COMPU_METHOD 0 3.402823e+38 ECU_ADDRESS_EXTENSION 0x80 /end CHARACTERISTIC
/begin CHARACTERISTIC CtApImageProcess_FreeRunning.PpDR_Merges_10ms.DeDR_List.DR_List[11].heading "" VALUE 0x255042c __FLOAT32_IEEE_S 0 NO_COMPU_METHOD 0 3.402823e+38 ECU_ADDRESS_EXTENSION 0x80 /end CHARACTERISTIC
/begin CHARACTERISTIC CtApImageProcess_FreeRunning.PpDR_Merges_10ms.DeDR_List.DR_List[11].delta_x "" VALUE 0x2550430 __FLOAT32_IEEE_S 0 NO_COMPU_METHOD 0 3.402823e+38 ECU_ADDRESS_EXTENSION 0x80 /end CHARACTERISTIC
/begin CHARACTERISTIC CtApImageProcess_FreeRunning.PpDR_Merges_10ms.DeDR_List.DR_List[11].delta_y "" VALUE 0x2550434 __FLOAT32_IEEE_S 0 NO_COMPU_METHOD 0 3.402823e+38 ECU_ADDRESS_EXTENSION 0x80 /end CHARACTERISTIC
/begin CHARACTERISTIC CtApImageProcess_FreeRunning.PpDR_Merges_10ms.DeDR_List.DR_List[11].delta_z "" VALUE 0x2550438 __FLOAT32_IEEE_S 0 NO_COMPU_METHOD 0 3.402823e+38 ECU_ADDRESS_EXTENSION 0x80 /end CHARACTERISTIC
/begin CHARACTERISTIC CtApImageProcess_FreeRunning.PpDR_Merges_10ms.DeDR_List.DR_List[11].delta_yaw "" VALUE 0x255043c __FLOAT32_IEEE_S 0 NO_COMPU_METHOD 0 3.402823e+38 ECU_ADDRESS_EXTENSION 0x80 /end CHARACTERISTIC
/begin CHARACTERISTIC CtApImageProcess_FreeRunning.PpDR_Merges_10ms.DeDR_List.DR_List[11].belif "" VALUE 0x2550440 __FLOAT32_IEEE_S 0 NO_COMPU_METHOD 0 3.402823e+38 ECU_ADDRESS_EXTENSION 0x80 /end CHARACTERISTIC
/begin CHARACTERISTIC CtApImageProcess_FreeRunning.PpDR_Merges_10ms.DeDR_List.DR_List[11].reserved_int "5 uint32 array" VAL_BLK 0x2550444 __ULONG_S 0 NO_COMPU_METHOD 0 4294967295 ECU_ADDRESS_EXTENSION 0x80 MATRIX_DIM 5 1 1 /end CHARACTERISTIC
/begin CHARACTERISTIC CtApImageProcess_FreeRunning.PpDR_Merges_10ms.DeDR_List.DR_List[12].stHeader.Counter "" VALUE 0x2550458 __UWORD_S 0 NO_COMPU_METHOD 0 65535 ECU_ADDRESS_EXTENSION 0x80 /end CHARACTERISTIC
/begin CHARACTERISTIC CtApImageProcess_FreeRunning.PpDR_Merges_10ms.DeDR_List.DR_List[12].stHeader.FrameID "" VALUE 0x255045a __UBYTE_S 0 NO_COMPU_METHOD 0 255 ECU_ADDRESS_EXTENSION 0x80 /end CHARACTERISTIC
/begin CHARACTERISTIC CtApImageProcess_FreeRunning.PpDR_Merges_10ms.DeDR_List.DR_List[12].stHeader.TimeStamp "2 uint32 array" VAL_BLK 0x255045c __ULONG_S 0 NO_COMPU_METHOD 0 4294967295 ECU_ADDRESS_EXTENSION 0x80 MATRIX_DIM 2 1 1 /end CHARACTERISTIC
/begin CHARACTERISTIC CtApImageProcess_FreeRunning.PpDR_Merges_10ms.DeDR_List.DR_List[12].count "" VALUE 0x2550464 __UBYTE_S 0 NO_COMPU_METHOD 0 255 ECU_ADDRESS_EXTENSION 0x80 /end CHARACTERISTIC
/begin CHARACTERISTIC CtApImageProcess_FreeRunning.PpDR_Merges_10ms.DeDR_List.DR_List[12].time_sec "" VALUE 0x2550468 __FLOAT64_IEEE_S 0 NO_COMPU_METHOD 0 3.402823e+38 ECU_ADDRESS_EXTENSION 0x80 /end CHARACTERISTIC
/begin CHARACTERISTIC CtApImageProcess_FreeRunning.PpDR_Merges_10ms.DeDR_List.DR_List[12].utm_x "" VALUE 0x2550470 __FLOAT64_IEEE_S 0 NO_COMPU_METHOD 0 3.402823e+38 ECU_ADDRESS_EXTENSION 0x80 /end CHARACTERISTIC
/begin CHARACTERISTIC CtApImageProcess_FreeRunning.PpDR_Merges_10ms.DeDR_List.DR_List[12].utm_y "" VALUE 0x2550478 __FLOAT64_IEEE_S 0 NO_COMPU_METHOD 0 3.402823e+38 ECU_ADDRESS_EXTENSION 0x80 /end CHARACTERISTIC
/begin CHARACTERISTIC CtApImageProcess_FreeRunning.PpDR_Merges_10ms.DeDR_List.DR_List[12].utm_z "" VALUE 0x2550480 __FLOAT32_IEEE_S 0 NO_COMPU_METHOD 0 3.402823e+38 ECU_ADDRESS_EXTENSION 0x80 /end CHARACTERISTIC
/begin CHARACTERISTIC CtApImageProcess_FreeRunning.PpDR_Merges_10ms.DeDR_List.DR_List[12].heading "" VALUE 0x2550484 __FLOAT32_IEEE_S 0 NO_COMPU_METHOD 0 3.402823e+38 ECU_ADDRESS_EXTENSION 0x80 /end CHARACTERISTIC
/begin CHARACTERISTIC CtApImageProcess_FreeRunning.PpDR_Merges_10ms.DeDR_List.DR_List[12].delta_x "" VALUE 0x2550488 __FLOAT32_IEEE_S 0 NO_COMPU_METHOD 0 3.402823e+38 ECU_ADDRESS_EXTENSION 0x80 /end CHARACTERISTIC
/begin CHARACTERISTIC CtApImageProcess_FreeRunning.PpDR_Merges_10ms.DeDR_List.DR_List[12].delta_y "" VALUE 0x255048c __FLOAT32_IEEE_S 0 NO_COMPU_METHOD 0 3.402823e+38 ECU_ADDRESS_EXTENSION 0x80 /end CHARACTERISTIC
/begin CHARACTERISTIC CtApImageProcess_FreeRunning.PpDR_Merges_10ms.DeDR_List.DR_List[12].delta_z "" VALUE 0x2550490 __FLOAT32_IEEE_S 0 NO_COMPU_METHOD 0 3.402823e+38 ECU_ADDRESS_EXTENSION 0x80 /end CHARACTERISTIC
/begin CHARACTERISTIC CtApImageProcess_FreeRunning.PpDR_Merges_10ms.DeDR_List.DR_List[12].delta_yaw "" VALUE 0x2550494 __FLOAT32_IEEE_S 0 NO_COMPU_METHOD 0 3.402823e+38 ECU_ADDRESS_EXTENSION 0x80 /end CHARACTERISTIC
/begin CHARACTERISTIC CtApImageProcess_FreeRunning.PpDR_Merges_10ms.DeDR_List.DR_List[12].belif "" VALUE 0x2550498 __FLOAT32_IEEE_S 0 NO_COMPU_METHOD 0 3.402823e+38 ECU_ADDRESS_EXTENSION 0x80 /end CHARACTERISTIC
/begin CHARACTERISTIC CtApImageProcess_FreeRunning.PpDR_Merges_10ms.DeDR_List.DR_List[12].reserved_int "5 uint32 array" VAL_BLK 0x255049c __ULONG_S 0 NO_COMPU_METHOD 0 4294967295 ECU_ADDRESS_EXTENSION 0x80 MATRIX_DIM 5 1 1 /end CHARACTERISTIC
/begin CHARACTERISTIC CtApImageProcess_FreeRunning.PpDR_Merges_10ms.DeDR_List.DR_List[13].stHeader.Counter "" VALUE 0x25504b0 __UWORD_S 0 NO_COMPU_METHOD 0 65535 ECU_ADDRESS_EXTENSION 0x80 /end CHARACTERISTIC
/begin CHARACTERISTIC CtApImageProcess_FreeRunning.PpDR_Merges_10ms.DeDR_List.DR_List[13].stHeader.FrameID "" VALUE 0x25504b2 __UBYTE_S 0 NO_COMPU_METHOD 0 255 ECU_ADDRESS_EXTENSION 0x80 /end CHARACTERISTIC
/begin CHARACTERISTIC CtApImageProcess_FreeRunning.PpDR_Merges_10ms.DeDR_List.DR_List[13].stHeader.TimeStamp "2 uint32 array" VAL_BLK 0x25504b4 __ULONG_S 0 NO_COMPU_METHOD 0 4294967295 ECU_ADDRESS_EXTENSION 0x80 MATRIX_DIM 2 1 1 /end CHARACTERISTIC
/begin CHARACTERISTIC CtApImageProcess_FreeRunning.PpDR_Merges_10ms.DeDR_List.DR_List[13].count "" VALUE 0x25504bc __UBYTE_S 0 NO_COMPU_METHOD 0 255 ECU_ADDRESS_EXTENSION 0x80 /end CHARACTERISTIC
/begin CHARACTERISTIC CtApImageProcess_FreeRunning.PpDR_Merges_10ms.DeDR_List.DR_List[13].time_sec "" VALUE 0x25504c0 __FLOAT64_IEEE_S 0 NO_COMPU_METHOD 0 3.402823e+38 ECU_ADDRESS_EXTENSION 0x80 /end CHARACTERISTIC
/begin CHARACTERISTIC CtApImageProcess_FreeRunning.PpDR_Merges_10ms.DeDR_List.DR_List[13].utm_x "" VALUE 0x25504c8 __FLOAT64_IEEE_S 0 NO_COMPU_METHOD 0 3.402823e+38 ECU_ADDRESS_EXTENSION 0x80 /end CHARACTERISTIC
/begin CHARACTERISTIC CtApImageProcess_FreeRunning.PpDR_Merges_10ms.DeDR_List.DR_List[13].utm_y "" VALUE 0x25504d0 __FLOAT64_IEEE_S 0 NO_COMPU_METHOD 0 3.402823e+38 ECU_ADDRESS_EXTENSION 0x80 /end CHARACTERISTIC
/begin CHARACTERISTIC CtApImageProcess_FreeRunning.PpDR_Merges_10ms.DeDR_List.DR_List[13].utm_z "" VALUE 0x25504d8 __FLOAT32_IEEE_S 0 NO_COMPU_METHOD 0 3.402823e+38 ECU_ADDRESS_EXTENSION 0x80 /end CHARACTERISTIC
/begin CHARACTERISTIC CtApImageProcess_FreeRunning.PpDR_Merges_10ms.DeDR_List.DR_List[13].heading "" VALUE 0x25504dc __FLOAT32_IEEE_S 0 NO_COMPU_METHOD 0 3.402823e+38 ECU_ADDRESS_EXTENSION 0x80 /end CHARACTERISTIC
/begin CHARACTERISTIC CtApImageProcess_FreeRunning.PpDR_Merges_10ms.DeDR_List.DR_List[13].delta_x "" VALUE 0x25504e0 __FLOAT32_IEEE_S 0 NO_COMPU_METHOD 0 3.402823e+38 ECU_ADDRESS_EXTENSION 0x80 /end CHARACTERISTIC
/begin CHARACTERISTIC CtApImageProcess_FreeRunning.PpDR_Merges_10ms.DeDR_List.DR_List[13].delta_y "" VALUE 0x25504e4 __FLOAT32_IEEE_S 0 NO_COMPU_METHOD 0 3.402823e+38 ECU_ADDRESS_EXTENSION 0x80 /end CHARACTERISTIC
/begin CHARACTERISTIC CtApImageProcess_FreeRunning.PpDR_Merges_10ms.DeDR_List.DR_List[13].delta_z "" VALUE 0x25504e8 __FLOAT32_IEEE_S 0 NO_COMPU_METHOD 0 3.402823e+38 ECU_ADDRESS_EXTENSION 0x80 /end CHARACTERISTIC
/begin CHARACTERISTIC CtApImageProcess_FreeRunning.PpDR_Merges_10ms.DeDR_List.DR_List[13].delta_yaw "" VALUE 0x25504ec __FLOAT32_IEEE_S 0 NO_COMPU_METHOD 0 3.402823e+38 ECU_ADDRESS_EXTENSION 0x80 /end CHARACTERISTIC
/begin CHARACTERISTIC CtApImageProcess_FreeRunning.PpDR_Merges_10ms.DeDR_List.DR_List[13].belif "" VALUE 0x25504f0 __FLOAT32_IEEE_S 0 NO_COMPU_METHOD 0 3.402823e+38 ECU_ADDRESS_EXTENSION 0x80 /end CHARACTERISTIC
/begin CHARACTERISTIC CtApImageProcess_FreeRunning.PpDR_Merges_10ms.DeDR_List.DR_List[13].reserved_int "5 uint32 array" VAL_BLK 0x25504f4 __ULONG_S 0 NO_COMPU_METHOD 0 4294967295 ECU_ADDRESS_EXTENSION 0x80 MATRIX_DIM 5 1 1 /end CHARACTERISTIC
/begin CHARACTERISTIC CtApImageProcess_FreeRunning.PpDR_Merges_10ms.DeDR_List.DR_List[14].stHeader.Counter "" VALUE 0x2550508 __UWORD_S 0 NO_COMPU_METHOD 0 65535 ECU_ADDRESS_EXTENSION 0x80 /end CHARACTERISTIC
/begin CHARACTERISTIC CtApImageProcess_FreeRunning.PpDR_Merges_10ms.DeDR_List.DR_List[14].stHeader.FrameID "" VALUE 0x255050a __UBYTE_S 0 NO_COMPU_METHOD 0 255 ECU_ADDRESS_EXTENSION 0x80 /end CHARACTERISTIC
/begin CHARACTERISTIC CtApImageProcess_FreeRunning.PpDR_Merges_10ms.DeDR_List.DR_List[14].stHeader.TimeStamp "2 uint32 array" VAL_BLK 0x255050c __ULONG_S 0 NO_COMPU_METHOD 0 4294967295 ECU_ADDRESS_EXTENSION 0x80 MATRIX_DIM 2 1 1 /end CHARACTERISTIC
/begin CHARACTERISTIC CtApImageProcess_FreeRunning.PpDR_Merges_10ms.DeDR_List.DR_List[14].count "" VALUE 0x2550514 __UBYTE_S 0 NO_COMPU_METHOD 0 255 ECU_ADDRESS_EXTENSION 0x80 /end CHARACTERISTIC
/begin CHARACTERISTIC CtApImageProcess_FreeRunning.PpDR_Merges_10ms.DeDR_List.DR_List[14].time_sec "" VALUE 0x2550518 __FLOAT64_IEEE_S 0 NO_COMPU_METHOD 0 3.402823e+38 ECU_ADDRESS_EXTENSION 0x80 /end CHARACTERISTIC
/begin CHARACTERISTIC CtApImageProcess_FreeRunning.PpDR_Merges_10ms.DeDR_List.DR_List[14].utm_x "" VALUE 0x2550520 __FLOAT64_IEEE_S 0 NO_COMPU_METHOD 0 3.402823e+38 ECU_ADDRESS_EXTENSION 0x80 /end CHARACTERISTIC
/begin CHARACTERISTIC CtApImageProcess_FreeRunning.PpDR_Merges_10ms.DeDR_List.DR_List[14].utm_y "" VALUE 0x2550528 __FLOAT64_IEEE_S 0 NO_COMPU_METHOD 0 3.402823e+38 ECU_ADDRESS_EXTENSION 0x80 /end CHARACTERISTIC
/begin CHARACTERISTIC CtApImageProcess_FreeRunning.PpDR_Merges_10ms.DeDR_List.DR_List[14].utm_z "" VALUE 0x2550530 __FLOAT32_IEEE_S 0 NO_COMPU_METHOD 0 3.402823e+38 ECU_ADDRESS_EXTENSION 0x80 /end CHARACTERISTIC
/begin CHARACTERISTIC CtApImageProcess_FreeRunning.PpDR_Merges_10ms.DeDR_List.DR_List[14].heading "" VALUE 0x2550534 __FLOAT32_IEEE_S 0 NO_COMPU_METHOD 0 3.402823e+38 ECU_ADDRESS_EXTENSION 0x80 /end CHARACTERISTIC
/begin CHARACTERISTIC CtApImageProcess_FreeRunning.PpDR_Merges_10ms.DeDR_List.DR_List[14].delta_x "" VALUE 0x2550538 __FLOAT32_IEEE_S 0 NO_COMPU_METHOD 0 3.402823e+38 ECU_ADDRESS_EXTENSION 0x80 /end CHARACTERISTIC
/begin CHARACTERISTIC CtApImageProcess_FreeRunning.PpDR_Merges_10ms.DeDR_List.DR_List[14].delta_y "" VALUE 0x255053c __FLOAT32_IEEE_S 0 NO_COMPU_METHOD 0 3.402823e+38 ECU_ADDRESS_EXTENSION 0x80 /end CHARACTERISTIC
/begin CHARACTERISTIC CtApImageProcess_FreeRunning.PpDR_Merges_10ms.DeDR_List.DR_List[14].delta_z "" VALUE 0x2550540 __FLOAT32_IEEE_S 0 NO_COMPU_METHOD 0 3.402823e+38 ECU_ADDRESS_EXTENSION 0x80 /end CHARACTERISTIC
/begin CHARACTERISTIC CtApImageProcess_FreeRunning.PpDR_Merges_10ms.DeDR_List.DR_List[14].delta_yaw "" VALUE 0x2550544 __FLOAT32_IEEE_S 0 NO_COMPU_METHOD 0 3.402823e+38 ECU_ADDRESS_EXTENSION 0x80 /end CHARACTERISTIC
/begin CHARACTERISTIC CtApImageProcess_FreeRunning.PpDR_Merges_10ms.DeDR_List.DR_List[14].belif "" VALUE 0x2550548 __FLOAT32_IEEE_S 0 NO_COMPU_METHOD 0 3.402823e+38 ECU_ADDRESS_EXTENSION 0x80 /end CHARACTERISTIC
/begin CHARACTERISTIC CtApImageProcess_FreeRunning.PpDR_Merges_10ms.DeDR_List.DR_List[14].reserved_int "5 uint32 array" VAL_BLK 0x255054c __ULONG_S 0 NO_COMPU_METHOD 0 4294967295 ECU_ADDRESS_EXTENSION 0x80 MATRIX_DIM 5 1 1 /end CHARACTERISTIC
/begin CHARACTERISTIC CtApImageProcess_FreeRunning.PpDR_Merges_10ms.DeDR_List.DR_List[15].stHeader.Counter "" VALUE 0x2550560 __UWORD_S 0 NO_COMPU_METHOD 0 65535 ECU_ADDRESS_EXTENSION 0x80 /end CHARACTERISTIC
/begin CHARACTERISTIC CtApImageProcess_FreeRunning.PpDR_Merges_10ms.DeDR_List.DR_List[15].stHeader.FrameID "" VALUE 0x2550562 __UBYTE_S 0 NO_COMPU_METHOD 0 255 ECU_ADDRESS_EXTENSION 0x80 /end CHARACTERISTIC
/begin CHARACTERISTIC CtApImageProcess_FreeRunning.PpDR_Merges_10ms.DeDR_List.DR_List[15].stHeader.TimeStamp "2 uint32 array" VAL_BLK 0x2550564 __ULONG_S 0 NO_COMPU_METHOD 0 4294967295 ECU_ADDRESS_EXTENSION 0x80 MATRIX_DIM 2 1 1 /end CHARACTERISTIC
/begin CHARACTERISTIC CtApImageProcess_FreeRunning.PpDR_Merges_10ms.DeDR_List.DR_List[15].count "" VALUE 0x255056c __UBYTE_S 0 NO_COMPU_METHOD 0 255 ECU_ADDRESS_EXTENSION 0x80 /end CHARACTERISTIC
/begin CHARACTERISTIC CtApImageProcess_FreeRunning.PpDR_Merges_10ms.DeDR_List.DR_List[15].time_sec "" VALUE 0x2550570 __FLOAT64_IEEE_S 0 NO_COMPU_METHOD 0 3.402823e+38 ECU_ADDRESS_EXTENSION 0x80 /end CHARACTERISTIC
/begin CHARACTERISTIC CtApImageProcess_FreeRunning.PpDR_Merges_10ms.DeDR_List.DR_List[15].utm_x "" VALUE 0x2550578 __FLOAT64_IEEE_S 0 NO_COMPU_METHOD 0 3.402823e+38 ECU_ADDRESS_EXTENSION 0x80 /end CHARACTERISTIC
/begin CHARACTERISTIC CtApImageProcess_FreeRunning.PpDR_Merges_10ms.DeDR_List.DR_List[15].utm_y "" VALUE 0x2550580 __FLOAT64_IEEE_S 0 NO_COMPU_METHOD 0 3.402823e+38 ECU_ADDRESS_EXTENSION 0x80 /end CHARACTERISTIC
/begin CHARACTERISTIC CtApImageProcess_FreeRunning.PpDR_Merges_10ms.DeDR_List.DR_List[15].utm_z "" VALUE 0x2550588 __FLOAT32_IEEE_S 0 NO_COMPU_METHOD 0 3.402823e+38 ECU_ADDRESS_EXTENSION 0x80 /end CHARACTERISTIC
/begin CHARACTERISTIC CtApImageProcess_FreeRunning.PpDR_Merges_10ms.DeDR_List.DR_List[15].heading "" VALUE 0x255058c __FLOAT32_IEEE_S 0 NO_COMPU_METHOD 0 3.402823e+38 ECU_ADDRESS_EXTENSION 0x80 /end CHARACTERISTIC
/begin CHARACTERISTIC CtApImageProcess_FreeRunning.PpDR_Merges_10ms.DeDR_List.DR_List[15].delta_x "" VALUE 0x2550590 __FLOAT32_IEEE_S 0 NO_COMPU_METHOD 0 3.402823e+38 ECU_ADDRESS_EXTENSION 0x80 /end CHARACTERISTIC
/begin CHARACTERISTIC CtApImageProcess_FreeRunning.PpDR_Merges_10ms.DeDR_List.DR_List[15].delta_y "" VALUE 0x2550594 __FLOAT32_IEEE_S 0 NO_COMPU_METHOD 0 3.402823e+38 ECU_ADDRESS_EXTENSION 0x80 /end CHARACTERISTIC
/begin CHARACTERISTIC CtApImageProcess_FreeRunning.PpDR_Merges_10ms.DeDR_List.DR_List[15].delta_z "" VALUE 0x2550598 __FLOAT32_IEEE_S 0 NO_COMPU_METHOD 0 3.402823e+38 ECU_ADDRESS_EXTENSION 0x80 /end CHARACTERISTIC
/begin CHARACTERISTIC CtApImageProcess_FreeRunning.PpDR_Merges_10ms.DeDR_List.DR_List[15].delta_yaw "" VALUE 0x255059c __FLOAT32_IEEE_S 0 NO_COMPU_METHOD 0 3.402823e+38 ECU_ADDRESS_EXTENSION 0x80 /end CHARACTERISTIC
/begin CHARACTERISTIC CtApImageProcess_FreeRunning.PpDR_Merges_10ms.DeDR_List.DR_List[15].belif "" VALUE 0x25505a0 __FLOAT32_IEEE_S 0 NO_COMPU_METHOD 0 3.402823e+38 ECU_ADDRESS_EXTENSION 0x80 /end CHARACTERISTIC
/begin CHARACTERISTIC CtApImageProcess_FreeRunning.PpDR_Merges_10ms.DeDR_List.DR_List[15].reserved_int "5 uint32 array" VAL_BLK 0x25505a4 __ULONG_S 0 NO_COMPU_METHOD 0 4294967295 ECU_ADDRESS_EXTENSION 0x80 MATRIX_DIM 5 1 1 /end CHARACTERISTIC
/begin CHARACTERISTIC CtApImageProcess_FreeRunning.PpDR_Merges_10ms.DeDR_List.DR_List[16].stHeader.Counter "" VALUE 0x25505b8 __UWORD_S 0 NO_COMPU_METHOD 0 65535 ECU_ADDRESS_EXTENSION 0x80 /end CHARACTERISTIC
/begin CHARACTERISTIC CtApImageProcess_FreeRunning.PpDR_Merges_10ms.DeDR_List.DR_List[16].stHeader.FrameID "" VALUE 0x25505ba __UBYTE_S 0 NO_COMPU_METHOD 0 255 ECU_ADDRESS_EXTENSION 0x80 /end CHARACTERISTIC
/begin CHARACTERISTIC CtApImageProcess_FreeRunning.PpDR_Merges_10ms.DeDR_List.DR_List[16].stHeader.TimeStamp "2 uint32 array" VAL_BLK 0x25505bc __ULONG_S 0 NO_COMPU_METHOD 0 4294967295 ECU_ADDRESS_EXTENSION 0x80 MATRIX_DIM 2 1 1 /end CHARACTERISTIC
/begin CHARACTERISTIC CtApImageProcess_FreeRunning.PpDR_Merges_10ms.DeDR_List.DR_List[16].count "" VALUE 0x25505c4 __UBYTE_S 0 NO_COMPU_METHOD 0 255 ECU_ADDRESS_EXTENSION 0x80 /end CHARACTERISTIC
/begin CHARACTERISTIC CtApImageProcess_FreeRunning.PpDR_Merges_10ms.DeDR_List.DR_List[16].time_sec "" VALUE 0x25505c8 __FLOAT64_IEEE_S 0 NO_COMPU_METHOD 0 3.402823e+38 ECU_ADDRESS_EXTENSION 0x80 /end CHARACTERISTIC
/begin CHARACTERISTIC CtApImageProcess_FreeRunning.PpDR_Merges_10ms.DeDR_List.DR_List[16].utm_x "" VALUE 0x25505d0 __FLOAT64_IEEE_S 0 NO_COMPU_METHOD 0 3.402823e+38 ECU_ADDRESS_EXTENSION 0x80 /end CHARACTERISTIC
/begin CHARACTERISTIC CtApImageProcess_FreeRunning.PpDR_Merges_10ms.DeDR_List.DR_List[16].utm_y "" VALUE 0x25505d8 __FLOAT64_IEEE_S 0 NO_COMPU_METHOD 0 3.402823e+38 ECU_ADDRESS_EXTENSION 0x80 /end CHARACTERISTIC
/begin CHARACTERISTIC CtApImageProcess_FreeRunning.PpDR_Merges_10ms.DeDR_List.DR_List[16].utm_z "" VALUE 0x25505e0 __FLOAT32_IEEE_S 0 NO_COMPU_METHOD 0 3.402823e+38 ECU_ADDRESS_EXTENSION 0x80 /end CHARACTERISTIC
/begin CHARACTERISTIC CtApImageProcess_FreeRunning.PpDR_Merges_10ms.DeDR_List.DR_List[16].heading "" VALUE 0x25505e4 __FLOAT32_IEEE_S 0 NO_COMPU_METHOD 0 3.402823e+38 ECU_ADDRESS_EXTENSION 0x80 /end CHARACTERISTIC
/begin CHARACTERISTIC CtApImageProcess_FreeRunning.PpDR_Merges_10ms.DeDR_List.DR_List[16].delta_x "" VALUE 0x25505e8 __FLOAT32_IEEE_S 0 NO_COMPU_METHOD 0 3.402823e+38 ECU_ADDRESS_EXTENSION 0x80 /end CHARACTERISTIC
/begin CHARACTERISTIC CtApImageProcess_FreeRunning.PpDR_Merges_10ms.DeDR_List.DR_List[16].delta_y "" VALUE 0x25505ec __FLOAT32_IEEE_S 0 NO_COMPU_METHOD 0 3.402823e+38 ECU_ADDRESS_EXTENSION 0x80 /end CHARACTERISTIC
/begin CHARACTERISTIC CtApImageProcess_FreeRunning.PpDR_Merges_10ms.DeDR_List.DR_List[16].delta_z "" VALUE 0x25505f0 __FLOAT32_IEEE_S 0 NO_COMPU_METHOD 0 3.402823e+38 ECU_ADDRESS_EXTENSION 0x80 /end CHARACTERISTIC
/begin CHARACTERISTIC CtApImageProcess_FreeRunning.PpDR_Merges_10ms.DeDR_List.DR_List[16].delta_yaw "" VALUE 0x25505f4 __FLOAT32_IEEE_S 0 NO_COMPU_METHOD 0 3.402823e+38 ECU_ADDRESS_EXTENSION 0x80 /end CHARACTERISTIC
/begin CHARACTERISTIC CtApImageProcess_FreeRunning.PpDR_Merges_10ms.DeDR_List.DR_List[16].belif "" VALUE 0x25505f8 __FLOAT32_IEEE_S 0 NO_COMPU_METHOD 0 3.402823e+38 ECU_ADDRESS_EXTENSION 0x80 /end CHARACTERISTIC
/begin CHARACTERISTIC CtApImageProcess_FreeRunning.PpDR_Merges_10ms.DeDR_List.DR_List[16].reserved_int "5 uint32 array" VAL_BLK 0x25505fc __ULONG_S 0 NO_COMPU_METHOD 0 4294967295 ECU_ADDRESS_EXTENSION 0x80 MATRIX_DIM 5 1 1 /end CHARACTERISTIC
/begin CHARACTERISTIC CtApImageProcess_FreeRunning.PpDR_Merges_10ms.DeDR_List.DR_List[17].stHeader.Counter "" VALUE 0x2550610 __UWORD_S 0 NO_COMPU_METHOD 0 65535 ECU_ADDRESS_EXTENSION 0x80 /end CHARACTERISTIC
/begin CHARACTERISTIC CtApImageProcess_FreeRunning.PpDR_Merges_10ms.DeDR_List.DR_List[17].stHeader.FrameID "" VALUE 0x2550612 __UBYTE_S 0 NO_COMPU_METHOD 0 255 ECU_ADDRESS_EXTENSION 0x80 /end CHARACTERISTIC
/begin CHARACTERISTIC CtApImageProcess_FreeRunning.PpDR_Merges_10ms.DeDR_List.DR_List[17].stHeader.TimeStamp "2 uint32 array" VAL_BLK 0x2550614 __ULONG_S 0 NO_COMPU_METHOD 0 4294967295 ECU_ADDRESS_EXTENSION 0x80 MATRIX_DIM 2 1 1 /end CHARACTERISTIC
/begin CHARACTERISTIC CtApImageProcess_FreeRunning.PpDR_Merges_10ms.DeDR_List.DR_List[17].count "" VALUE 0x255061c __UBYTE_S 0 NO_COMPU_METHOD 0 255 ECU_ADDRESS_EXTENSION 0x80 /end CHARACTERISTIC
/begin CHARACTERISTIC CtApImageProcess_FreeRunning.PpDR_Merges_10ms.DeDR_List.DR_List[17].time_sec "" VALUE 0x2550620 __FLOAT64_IEEE_S 0 NO_COMPU_METHOD 0 3.402823e+38 ECU_ADDRESS_EXTENSION 0x80 /end CHARACTERISTIC
/begin CHARACTERISTIC CtApImageProcess_FreeRunning.PpDR_Merges_10ms.DeDR_List.DR_List[17].utm_x "" VALUE 0x2550628 __FLOAT64_IEEE_S 0 NO_COMPU_METHOD 0 3.402823e+38 ECU_ADDRESS_EXTENSION 0x80 /end CHARACTERISTIC
/begin CHARACTERISTIC CtApImageProcess_FreeRunning.PpDR_Merges_10ms.DeDR_List.DR_List[17].utm_y "" VALUE 0x2550630 __FLOAT64_IEEE_S 0 NO_COMPU_METHOD 0 3.402823e+38 ECU_ADDRESS_EXTENSION 0x80 /end CHARACTERISTIC
/begin CHARACTERISTIC CtApImageProcess_FreeRunning.PpDR_Merges_10ms.DeDR_List.DR_List[17].utm_z "" VALUE 0x2550638 __FLOAT32_IEEE_S 0 NO_COMPU_METHOD 0 3.402823e+38 ECU_ADDRESS_EXTENSION 0x80 /end CHARACTERISTIC
/begin CHARACTERISTIC CtApImageProcess_FreeRunning.PpDR_Merges_10ms.DeDR_List.DR_List[17].heading "" VALUE 0x255063c __FLOAT32_IEEE_S 0 NO_COMPU_METHOD 0 3.402823e+38 ECU_ADDRESS_EXTENSION 0x80 /end CHARACTERISTIC
/begin CHARACTERISTIC CtApImageProcess_FreeRunning.PpDR_Merges_10ms.DeDR_List.DR_List[17].delta_x "" VALUE 0x2550640 __FLOAT32_IEEE_S 0 NO_COMPU_METHOD 0 3.402823e+38 ECU_ADDRESS_EXTENSION 0x80 /end CHARACTERISTIC
/begin CHARACTERISTIC CtApImageProcess_FreeRunning.PpDR_Merges_10ms.DeDR_List.DR_List[17].delta_y "" VALUE 0x2550644 __FLOAT32_IEEE_S 0 NO_COMPU_METHOD 0 3.402823e+38 ECU_ADDRESS_EXTENSION 0x80 /end CHARACTERISTIC
/begin CHARACTERISTIC CtApImageProcess_FreeRunning.PpDR_Merges_10ms.DeDR_List.DR_List[17].delta_z "" VALUE 0x2550648 __FLOAT32_IEEE_S 0 NO_COMPU_METHOD 0 3.402823e+38 ECU_ADDRESS_EXTENSION 0x80 /end CHARACTERISTIC
/begin CHARACTERISTIC CtApImageProcess_FreeRunning.PpDR_Merges_10ms.DeDR_List.DR_List[17].delta_yaw "" VALUE 0x255064c __FLOAT32_IEEE_S 0 NO_COMPU_METHOD 0 3.402823e+38 ECU_ADDRESS_EXTENSION 0x80 /end CHARACTERISTIC
/begin CHARACTERISTIC CtApImageProcess_FreeRunning.PpDR_Merges_10ms.DeDR_List.DR_List[17].belif "" VALUE 0x2550650 __FLOAT32_IEEE_S 0 NO_COMPU_METHOD 0 3.402823e+38 ECU_ADDRESS_EXTENSION 0x80 /end CHARACTERISTIC
/begin CHARACTERISTIC CtApImageProcess_FreeRunning.PpDR_Merges_10ms.DeDR_List.DR_List[17].reserved_int "5 uint32 array" VAL_BLK 0x2550654 __ULONG_S 0 NO_COMPU_METHOD 0 4294967295 ECU_ADDRESS_EXTENSION 0x80 MATRIX_DIM 5 1 1 /end CHARACTERISTIC
/begin CHARACTERISTIC CtApImageProcess_FreeRunning.PpDR_Merges_10ms.DeDR_List.DR_List[18].stHeader.Counter "" VALUE 0x2550668 __UWORD_S 0 NO_COMPU_METHOD 0 65535 ECU_ADDRESS_EXTENSION 0x80 /end CHARACTERISTIC
/begin CHARACTERISTIC CtApImageProcess_FreeRunning.PpDR_Merges_10ms.DeDR_List.DR_List[18].stHeader.FrameID "" VALUE 0x255066a __UBYTE_S 0 NO_COMPU_METHOD 0 255 ECU_ADDRESS_EXTENSION 0x80 /end CHARACTERISTIC
/begin CHARACTERISTIC CtApImageProcess_FreeRunning.PpDR_Merges_10ms.DeDR_List.DR_List[18].stHeader.TimeStamp "2 uint32 array" VAL_BLK 0x255066c __ULONG_S 0 NO_COMPU_METHOD 0 4294967295 ECU_ADDRESS_EXTENSION 0x80 MATRIX_DIM 2 1 1 /end CHARACTERISTIC
/begin CHARACTERISTIC CtApImageProcess_FreeRunning.PpDR_Merges_10ms.DeDR_List.DR_List[18].count "" VALUE 0x2550674 __UBYTE_S 0 NO_COMPU_METHOD 0 255 ECU_ADDRESS_EXTENSION 0x80 /end CHARACTERISTIC
/begin CHARACTERISTIC CtApImageProcess_FreeRunning.PpDR_Merges_10ms.DeDR_List.DR_List[18].time_sec "" VALUE 0x2550678 __FLOAT64_IEEE_S 0 NO_COMPU_METHOD 0 3.402823e+38 ECU_ADDRESS_EXTENSION 0x80 /end CHARACTERISTIC
/begin CHARACTERISTIC CtApImageProcess_FreeRunning.PpDR_Merges_10ms.DeDR_List.DR_List[18].utm_x "" VALUE 0x2550680 __FLOAT64_IEEE_S 0 NO_COMPU_METHOD 0 3.402823e+38 ECU_ADDRESS_EXTENSION 0x80 /end CHARACTERISTIC
/begin CHARACTERISTIC CtApImageProcess_FreeRunning.PpDR_Merges_10ms.DeDR_List.DR_List[18].utm_y "" VALUE 0x2550688 __FLOAT64_IEEE_S 0 NO_COMPU_METHOD 0 3.402823e+38 ECU_ADDRESS_EXTENSION 0x80 /end CHARACTERISTIC
/begin CHARACTERISTIC CtApImageProcess_FreeRunning.PpDR_Merges_10ms.DeDR_List.DR_List[18].utm_z "" VALUE 0x2550690 __FLOAT32_IEEE_S 0 NO_COMPU_METHOD 0 3.402823e+38 ECU_ADDRESS_EXTENSION 0x80 /end CHARACTERISTIC
/begin CHARACTERISTIC CtApImageProcess_FreeRunning.PpDR_Merges_10ms.DeDR_List.DR_List[18].heading "" VALUE 0x2550694 __FLOAT32_IEEE_S 0 NO_COMPU_METHOD 0 3.402823e+38 ECU_ADDRESS_EXTENSION 0x80 /end CHARACTERISTIC
/begin CHARACTERISTIC CtApImageProcess_FreeRunning.PpDR_Merges_10ms.DeDR_List.DR_List[18].delta_x "" VALUE 0x2550698 __FLOAT32_IEEE_S 0 NO_COMPU_METHOD 0 3.402823e+38 ECU_ADDRESS_EXTENSION 0x80 /end CHARACTERISTIC
/begin CHARACTERISTIC CtApImageProcess_FreeRunning.PpDR_Merges_10ms.DeDR_List.DR_List[18].delta_y "" VALUE 0x255069c __FLOAT32_IEEE_S 0 NO_COMPU_METHOD 0 3.402823e+38 ECU_ADDRESS_EXTENSION 0x80 /end CHARACTERISTIC
/begin CHARACTERISTIC CtApImageProcess_FreeRunning.PpDR_Merges_10ms.DeDR_List.DR_List[18].delta_z "" VALUE 0x25506a0 __FLOAT32_IEEE_S 0 NO_COMPU_METHOD 0 3.402823e+38 ECU_ADDRESS_EXTENSION 0x80 /end CHARACTERISTIC
/begin CHARACTERISTIC CtApImageProcess_FreeRunning.PpDR_Merges_10ms.DeDR_List.DR_List[18].delta_yaw "" VALUE 0x25506a4 __FLOAT32_IEEE_S 0 NO_COMPU_METHOD 0 3.402823e+38 ECU_ADDRESS_EXTENSION 0x80 /end CHARACTERISTIC
/begin CHARACTERISTIC CtApImageProcess_FreeRunning.PpDR_Merges_10ms.DeDR_List.DR_List[18].belif "" VALUE 0x25506a8 __FLOAT32_IEEE_S 0 NO_COMPU_METHOD 0 3.402823e+38 ECU_ADDRESS_EXTENSION 0x80 /end CHARACTERISTIC
/begin CHARACTERISTIC CtApImageProcess_FreeRunning.PpDR_Merges_10ms.DeDR_List.DR_List[18].reserved_int "5 uint32 array" VAL_BLK 0x25506ac __ULONG_S 0 NO_COMPU_METHOD 0 4294967295 ECU_ADDRESS_EXTENSION 0x80 MATRIX_DIM 5 1 1 /end CHARACTERISTIC
/begin CHARACTERISTIC CtApImageProcess_FreeRunning.PpDR_Merges_10ms.DeDR_List.DR_List[19].stHeader.Counter "" VALUE 0x25506c0 __UWORD_S 0 NO_COMPU_METHOD 0 65535 ECU_ADDRESS_EXTENSION 0x80 /end CHARACTERISTIC
/begin CHARACTERISTIC CtApImageProcess_FreeRunning.PpDR_Merges_10ms.DeDR_List.DR_List[19].stHeader.FrameID "" VALUE 0x25506c2 __UBYTE_S 0 NO_COMPU_METHOD 0 255 ECU_ADDRESS_EXTENSION 0x80 /end CHARACTERISTIC
/begin COMPU_METHOD CtApImageProcess_FreeRunning.PpPdImageProcess_FreeRunningWrite.DeImageProcess_FreeRunning_Normal.DeStatus.Dt_ENUM_PdDatablockStatus.CONVERSION "" TAB_VERB "%10.10" "" COMPU_TAB_REF CtApImageProcess_FreeRunning.PpPdImageProcess_FreeRunningWrite.DeImageProcess_FreeRunning_Normal.DeStatus.Dt_ENUM_PdDatablockStatus /end COMPU_METHOD
/begin COMPU_METHOD CtApImageProcess_FreeRunning.PpPdImageProcess_FreeRunningWrite.DeImageProcess_Normal.DeStatus.Dt_ENUM_PdDatablockStatus.CONVERSION "" TAB_VERB "%10.10" "" COMPU_TAB_REF CtApImageProcess_FreeRunning.PpPdImageProcess_FreeRunningWrite.DeImageProcess_Normal.DeStatus.Dt_ENUM_PdDatablockStatus /end COMPU_METHOD
/begin COMPU_METHOD CtApImageProcess_FreeRunning.PpPdImageProcess_FreeRunningWrite.DeImageProcessSec_Normal.DeStatus.Dt_ENUM_PdDatablockStatus.CONVERSION "" TAB_VERB "%10.10" "" COMPU_TAB_REF CtApImageProcess_FreeRunning.PpPdImageProcess_FreeRunningWrite.DeImageProcessSec_Normal.DeStatus.Dt_ENUM_PdDatablockStatus /end COMPU_METHOD
/begin COMPU_METHOD CtApImageProcess_FreeRunning.PpBdImageProcessRead.BdSV_Normal.DeStatus.Dt_ENUM_PdDatablockStatus.CONVERSION "" TAB_VERB "%10.10" "" COMPU_TAB_REF CtApImageProcess_FreeRunning.PpBdImageProcessRead.BdSV_Normal.DeStatus.Dt_ENUM_PdDatablockStatus /end COMPU_METHOD
/begin COMPU_VTAB CtApImageProcess_FreeRunning.PpPdImageProcess_FreeRunningWrite.DeImageProcess_FreeRunning_Normal.DeStatus.Dt_ENUM_PdDatablockStatus "Conversion table for CtApImageProcess_FreeRunning.PpPdImageProcess_FreeRunningWrite.DeImageProcess_FreeRunning_Normal.DeStatus.Dt_ENUM_PdDatablockStatus.CONVERSION COMPU_METHOD" TAB_VERB 5 0 "DATABLOCK_INIT" 1 "DATABLOCK_OK" 2 "DATABLOCK_NOT_OK" 3 "DATABLOCK_WRONGCRC" 4 "DATABLOCK_ERASED" /end COMPU_VTAB
/begin COMPU_VTAB CtApImageProcess_FreeRunning.PpPdImageProcess_FreeRunningWrite.DeImageProcess_Normal.DeStatus.Dt_ENUM_PdDatablockStatus "Conversion table for CtApImageProcess_FreeRunning.PpPdImageProcess_FreeRunningWrite.DeImageProcess_Normal.DeStatus.Dt_ENUM_PdDatablockStatus.CONVERSION COMPU_METHOD" TAB_VERB 5 0 "DATABLOCK_INIT" 1 "DATABLOCK_OK" 2 "DATABLOCK_NOT_OK" 3 "DATABLOCK_WRONGCRC" 4 "DATABLOCK_ERASED" /end COMPU_VTAB
/begin COMPU_VTAB CtApImageProcess_FreeRunning.PpPdImageProcess_FreeRunningWrite.DeImageProcessSec_Normal.DeStatus.Dt_ENUM_PdDatablockStatus "Conversion table for CtApImageProcess_FreeRunning.PpPdImageProcess_FreeRunningWrite.DeImageProcessSec_Normal.DeStatus.Dt_ENUM_PdDatablockStatus.CONVERSION COMPU_METHOD" TAB_VERB 5 0 "DATABLOCK_INIT" 1 "DATABLOCK_OK" 2 "DATABLOCK_NOT_OK" 3 "DATABLOCK_WRONGCRC" 4 "DATABLOCK_ERASED" /end COMPU_VTAB
/begin COMPU_VTAB CtApImageProcess_FreeRunning.PpBdImageProcessRead.BdSV_Normal.DeStatus.Dt_ENUM_PdDatablockStatus "Conversion table for CtApImageProcess_FreeRunning.PpBdImageProcessRead.BdSV_Normal.DeStatus.Dt_ENUM_PdDatablockStatus.CONVERSION COMPU_METHOD" TAB_VERB 5 0 "DATABLOCK_INIT" 1 "DATABLOCK_OK" 2 "DATABLOCK_NOT_OK" 3 "DATABLOCK_WRONGCRC" 4 "DATABLOCK_ERASED" /end COMPU_VTAB
/begin GROUP CtApImageProcess_FreeRunning_xcp_kvs_group "MotinWise KVS characteristic group" ROOT
 /begin REF_CHARACTERISTIC CtApImageProcess_FreeRunning.PpImageProcess_ParkingLot_20ms.DeSVParkingSlot.gstSpaceLeft[1].fLineWith CtApImageProcess_FreeRunning.PpImageProcess_ParkingLot_20ms.DeSVParkingSlot.gstSpaceLeft[1].fSita CtApImageProcess_FreeRunning.PpImageProcess_ParkingLot_20ms.DeSVParkingSlot.gstSpaceLeft[1].fIdentifierNum CtApImageProcess_FreeRunning.PpImageProcess_ParkingLot_20ms.DeSVParkingSlot.gstSpaceLeft[1].fReserved CtApImageProcess_FreeRunning.PpImageProcess_ParkingLot_20ms.DeSVParkingSlot.gstSpaceLeft[2].nValid CtApImageProcess_FreeRunning.PpImageProcess_ParkingLot_20ms.DeSVParkingSlot.gstSpaceLeft[2].gfPos[0] CtApImageProcess_FreeRunning.PpImageProcess_ParkingLot_20ms.DeSVParkingSlot.gstSpaceLeft[2].gfPos[1] CtApImageProcess_FreeRunning.PpImageProcess_ParkingLot_20ms.DeSVParkingSlot.gstSpaceLeft[2].gfPos[2] CtApImageProcess_FreeRunning.PpImageProcess_ParkingLot_20ms.DeSVParkingSlot.gstSpaceLeft[2].gfPos[3] CtApImageProcess_FreeRunning.PpImageProcess_ParkingLot_20ms.DeSVParkingSlot.gstSpaceLeft[2].nQuality CtApImageProcess_FreeRunning.PpImageProcess_ParkingLot_20ms.DeSVParkingSlot.gstSpaceLeft[2].nType CtApImageProcess_FreeRunning.PpImageProcess_ParkingLot_20ms.DeSVParkingSlot.gstSpaceLeft[2].nParkingGarageID CtApImageProcess_FreeRunning.PpImageProcess_ParkingLot_20ms.DeSVParkingSlot.gstSpaceLeft[2].fLineWith CtApImageProcess_FreeRunning.PpImageProcess_ParkingLot_20ms.DeSVParkingSlot.gstSpaceLeft[2].fSita CtApImageProcess_FreeRunning.PpImageProcess_ParkingLot_20ms.DeSVParkingSlot.gstSpaceLeft[2].fIdentifierNum CtApImageProcess_FreeRunning.PpImageProcess_ParkingLot_20ms.DeSVParkingSlot.gstSpaceLeft[2].fReserved CtApImageProcess_FreeRunning.PpImageProcess_ParkingLot_20ms.DeSVParkingSlot.gstSpaceLeft[3].nValid CtApImageProcess_FreeRunning.PpImageProcess_ParkingLot_20ms.DeSVParkingSlot.gstSpaceLeft[3].gfPos[0] CtApImageProcess_FreeRunning.PpImageProcess_ParkingLot_20ms.DeSVParkingSlot.gstSpaceLeft[3].gfPos[1] CtApImageProcess_FreeRunning.PpImageProcess_ParkingLot_20ms.DeSVParkingSlot.gstSpaceLeft[3].gfPos[2] CtApImageProcess_FreeRunning.PpImageProcess_ParkingLot_20ms.DeSVParkingSlot.gstSpaceLeft[3].gfPos[3] CtApImageProcess_FreeRunning.PpImageProcess_ParkingLot_20ms.DeSVParkingSlot.gstSpaceLeft[3].nQuality CtApImageProcess_FreeRunning.PpImageProcess_ParkingLot_20ms.DeSVParkingSlot.gstSpaceLeft[3].nType CtApImageProcess_FreeRunning.PpImageProcess_ParkingLot_20ms.DeSVParkingSlot.gstSpaceLeft[3].nParkingGarageID CtApImageProcess_FreeRunning.PpImageProcess_ParkingLot_20ms.DeSVParkingSlot.gstSpaceLeft[3].fLineWith CtApImageProcess_FreeRunning.PpImageProcess_ParkingLot_20ms.DeSVParkingSlot.gstSpaceLeft[3].fSita CtApImageProcess_FreeRunning.PpImageProcess_ParkingLot_20ms.DeSVParkingSlot.gstSpaceLeft[3].fIdentifierNum CtApImageProcess_FreeRunning.PpImageProcess_ParkingLot_20ms.DeSVParkingSlot.gstSpaceLeft[3].fReserved CtApImageProcess_FreeRunning.PpImageProcess_ParkingLot_20ms.DeSVParkingSlot.gstSpaceLeft[4].nValid CtApImageProcess_FreeRunning.PpImageProcess_ParkingLot_20ms.DeSVParkingSlot.gstSpaceLeft[4].gfPos[0] CtApImageProcess_FreeRunning.PpImageProcess_ParkingLot_20ms.DeSVParkingSlot.gstSpaceLeft[4].gfPos[1] CtApImageProcess_FreeRunning.PpImageProcess_ParkingLot_20ms.DeSVParkingSlot.gstSpaceLeft[4].gfPos[2] CtApImageProcess_FreeRunning.PpImageProcess_ParkingLot_20ms.DeSVParkingSlot.gstSpaceLeft[4].gfPos[3] CtApImageProcess_FreeRunning.PpImageProcess_ParkingLot_20ms.DeSVParkingSlot.gstSpaceLeft[4].nQuality CtApImageProcess_FreeRunning.PpImageProcess_ParkingLot_20ms.DeSVParkingSlot.gstSpaceLeft[4].nType CtApImageProcess_FreeRunning.PpImageProcess_ParkingLot_20ms.DeSVParkingSlot.gstSpaceLeft[4].nParkingGarageID CtApImageProcess_FreeRunning.PpImageProcess_ParkingLot_20ms.DeSVParkingSlot.gstSpaceLeft[4].fLineWith CtApImageProcess_FreeRunning.PpImageProcess_ParkingLot_20ms.DeSVParkingSlot.gstSpaceLeft[4].fSita CtApImageProcess_FreeRunning.PpImageProcess_ParkingLot_20ms.DeSVParkingSlot.gstSpaceLeft[4].fIdentifierNum CtApImageProcess_FreeRunning.PpImageProcess_ParkingLot_20ms.DeSVParkingSlot.gstSpaceLeft[4].fReserved CtApImageProcess_FreeRunning.PpImageProcess_ParkingLot_20ms.DeSVParkingSlot.gstSpaceLeft[5].nValid CtApImageProcess_FreeRunning.PpImageProcess_ParkingLot_20ms.DeSVParkingSlot.gstSpaceLeft[5].gfPos[0] CtApImageProcess_FreeRunning.PpImageProcess_ParkingLot_20ms.DeSVParkingSlot.gstSpaceLeft[5].gfPos[1] CtApImageProcess_FreeRunning.PpImageProcess_ParkingLot_20ms.DeSVParkingSlot.gstSpaceLeft[5].gfPos[2] CtApImageProcess_FreeRunning.PpImageProcess_ParkingLot_20ms.DeSVParkingSlot.gstSpaceLeft[5].gfPos[3] CtApImageProcess_FreeRunning.PpImageProcess_ParkingLot_20ms.DeSVParkingSlot.gstSpaceLeft[5].nQuality CtApImageProcess_FreeRunning.PpImageProcess_ParkingLot_20ms.DeSVParkingSlot.gstSpaceLeft[5].nType CtApImageProcess_FreeRunning.PpImageProcess_ParkingLot_20ms.DeSVParkingSlot.gstSpaceLeft[5].nParkingGarageID CtApImageProcess_FreeRunning.PpImageProcess_ParkingLot_20ms.DeSVParkingSlot.gstSpaceLeft[5].fLineWith CtApImageProcess_FreeRunning.PpImageProcess_ParkingLot_20ms.DeSVParkingSlot.gstSpaceLeft[5].fSita CtApImageProcess_FreeRunning.PpImageProcess_ParkingLot_20ms.DeSVParkingSlot.gstSpaceLeft[5].fIdentifierNum CtApImageProcess_FreeRunning.PpImageProcess_ParkingLot_20ms.DeSVParkingSlot.gstSpaceLeft[5].fReserved CtApImageProcess_FreeRunning.PpImageProcess_ParkingLot_20ms.DeSVParkingSlot.gstSpaceLeft[6].nValid CtApImageProcess_FreeRunning.PpImageProcess_ParkingLot_20ms.DeSVParkingSlot.gstSpaceLeft[6].gfPos[0] CtApImageProcess_FreeRunning.PpImageProcess_ParkingLot_20ms.DeSVParkingSlot.gstSpaceLeft[6].gfPos[1] CtApImageProcess_FreeRunning.PpImageProcess_ParkingLot_20ms.DeSVParkingSlot.gstSpaceLeft[6].gfPos[2] CtApImageProcess_FreeRunning.PpImageProcess_ParkingLot_20ms.DeSVParkingSlot.gstSpaceLeft[6].gfPos[3] CtApImageProcess_FreeRunning.PpImageProcess_ParkingLot_20ms.DeSVParkingSlot.gstSpaceLeft[6].nQuality CtApImageProcess_FreeRunning.PpImageProcess_ParkingLot_20ms.DeSVParkingSlot.gstSpaceLeft[6].nType CtApImageProcess_FreeRunning.PpImageProcess_ParkingLot_20ms.DeSVParkingSlot.gstSpaceLeft[6].nParkingGarageID CtApImageProcess_FreeRunning.PpImageProcess_ParkingLot_20ms.DeSVParkingSlot.gstSpaceLeft[6].fLineWith CtApImageProcess_FreeRunning.PpImageProcess_ParkingLot_20ms.DeSVParkingSlot.gstSpaceLeft[6].fSita CtApImageProcess_FreeRunning.PpImageProcess_ParkingLot_20ms.DeSVParkingSlot.gstSpaceLeft[6].fIdentifierNum CtApImageProcess_FreeRunning.PpImageProcess_ParkingLot_20ms.DeSVParkingSlot.gstSpaceLeft[6].fReserved CtApImageProcess_FreeRunning.PpImageProcess_ParkingLot_20ms.DeSVParkingSlot.gstSpaceLeft[7].nValid CtApImageProcess_FreeRunning.PpImageProcess_ParkingLot_20ms.DeSVParkingSlot.gstSpaceLeft[7].gfPos[0] CtApImageProcess_FreeRunning.PpImageProcess_ParkingLot_20ms.DeSVParkingSlot.gstSpaceLeft[7].gfPos[1] CtApImageProcess_FreeRunning.PpImageProcess_ParkingLot_20ms.DeSVParkingSlot.gstSpaceLeft[7].gfPos[2] CtApImageProcess_FreeRunning.PpImageProcess_ParkingLot_20ms.DeSVParkingSlot.gstSpaceLeft[7].gfPos[3] CtApImageProcess_FreeRunning.PpImageProcess_ParkingLot_20ms.DeSVParkingSlot.gstSpaceLeft[7].nQuality CtApImageProcess_FreeRunning.PpImageProcess_ParkingLot_20ms.DeSVParkingSlot.gstSpaceLeft[7].nType CtApImageProcess_FreeRunning.PpImageProcess_ParkingLot_20ms.DeSVParkingSlot.gstSpaceLeft[7].nParkingGarageID CtApImageProcess_FreeRunning.PpImageProcess_ParkingLot_20ms.DeSVParkingSlot.gstSpaceLeft[7].fLineWith CtApImageProcess_FreeRunning.PpImageProcess_ParkingLot_20ms.DeSVParkingSlot.gstSpaceLeft[7].fSita CtApImageProcess_FreeRunning.PpImageProcess_ParkingLot_20ms.DeSVParkingSlot.gstSpaceLeft[7].fIdentifierNum CtApImageProcess_FreeRunning.PpImageProcess_ParkingLot_20ms.DeSVParkingSlot.gstSpaceLeft[7].fReserved CtApImageProcess_FreeRunning.PpImageProcess_ParkingLot_20ms.DeSVParkingSlot.gstSpaceRear[0].nValid CtApImageProcess_FreeRunning.PpImageProcess_ParkingLot_20ms.DeSVParkingSlot.gstSpaceRear[0].gfPos[0] CtApImageProcess_FreeRunning.PpImageProcess_ParkingLot_20ms.DeSVParkingSlot.gstSpaceRear[0].gfPos[1] CtApImageProcess_FreeRunning.PpImageProcess_ParkingLot_20ms.DeSVParkingSlot.gstSpaceRear[0].gfPos[2] CtApImageProcess_FreeRunning.PpImageProcess_ParkingLot_20ms.DeSVParkingSlot.gstSpaceRear[0].gfPos[3] CtApImageProcess_FreeRunning.PpImageProcess_ParkingLot_20ms.DeSVParkingSlot.gstSpaceRear[0].nQuality CtApImageProcess_FreeRunning.PpImageProcess_ParkingLot_20ms.DeSVParkingSlot.gstSpaceRear[0].nType CtApImageProcess_FreeRunning.PpImageProcess_ParkingLot_20ms.DeSVParkingSlot.gstSpaceRear[0].nParkingGarageID CtApImageProcess_FreeRunning.PpImageProcess_ParkingLot_20ms.DeSVParkingSlot.gstSpaceRear[0].fLineWith CtApImageProcess_FreeRunning.PpImageProcess_ParkingLot_20ms.DeSVParkingSlot.gstSpaceRear[0].fSita CtApImageProcess_FreeRunning.PpImageProcess_ParkingLot_20ms.DeSVParkingSlot.gstSpaceRear[0].fIdentifierNum CtApImageProcess_FreeRunning.PpImageProcess_ParkingLot_20ms.DeSVParkingSlot.gstSpaceRear[0].fReserved CtApImageProcess_FreeRunning.PpImageProcess_ParkingLot_20ms.DeSVParkingSlot.gstSpaceRear[1].nValid CtApImageProcess_FreeRunning.PpImageProcess_ParkingLot_20ms.DeSVParkingSlot.gstSpaceRear[1].gfPos[0] CtApImageProcess_FreeRunning.PpImageProcess_ParkingLot_20ms.DeSVParkingSlot.gstSpaceRear[1].gfPos[1] CtApImageProcess_FreeRunning.PpImageProcess_ParkingLot_20ms.DeSVParkingSlot.gstSpaceRear[1].gfPos[2] CtApImageProcess_FreeRunning.PpImageProcess_ParkingLot_20ms.DeSVParkingSlot.gstSpaceRear[1].gfPos[3] CtApImageProcess_FreeRunning.PpImageProcess_ParkingLot_20ms.DeSVParkingSlot.gstSpaceRear[1].nQuality CtApImageProcess_FreeRunning.PpImageProcess_ParkingLot_20ms.DeSVParkingSlot.gstSpaceRear[1].nType CtApImageProcess_FreeRunning.PpImageProcess_ParkingLot_20ms.DeSVParkingSlot.gstSpaceRear[1].nParkingGarageID CtApImageProcess_FreeRunning.PpImageProcess_ParkingLot_20ms.DeSVParkingSlot.gstSpaceRear[1].fLineWith CtApImageProcess_FreeRunning.PpImageProcess_ParkingLot_20ms.DeSVParkingSlot.gstSpaceRear[1].fSita CtApImageProcess_FreeRunning.PpImageProcess_ParkingLot_20ms.DeSVParkingSlot.gstSpaceRear[1].fIdentifierNum CtApImageProcess_FreeRunning.PpImageProcess_ParkingLot_20ms.DeSVParkingSlot.gstSpaceRear[1].fReserved CtApImageProcess_FreeRunning.PpImageProcess_ParkingLot_20ms.DeSVParkingSlot.gstSpaceRear[2].nValid CtApImageProcess_FreeRunning.PpImageProcess_ParkingLot_20ms.DeSVParkingSlot.gstSpaceRear[2].gfPos[0] CtApImageProcess_FreeRunning.PpImageProcess_ParkingLot_20ms.DeSVParkingSlot.gstSpaceRear[2].gfPos[1] CtApImageProcess_FreeRunning.PpImageProcess_ParkingLot_20ms.DeSVParkingSlot.gstSpaceRear[2].gfPos[2] CtApImageProcess_FreeRunning.PpImageProcess_ParkingLot_20ms.DeSVParkingSlot.gstSpaceRear[2].gfPos[3] CtApImageProcess_FreeRunning.PpImageProcess_ParkingLot_20ms.DeSVParkingSlot.gstSpaceRear[2].nQuality CtApImageProcess_FreeRunning.PpImageProcess_ParkingLot_20ms.DeSVParkingSlot.gstSpaceRear[2].nType CtApImageProcess_FreeRunning.PpImageProcess_ParkingLot_20ms.DeSVParkingSlot.gstSpaceRear[2].nParkingGarageID CtApImageProcess_FreeRunning.PpImageProcess_ParkingLot_20ms.DeSVParkingSlot.gstSpaceRear[2].fLineWith CtApImageProcess_FreeRunning.PpImageProcess_ParkingLot_20ms.DeSVParkingSlot.gstSpaceRear[2].fSita CtApImageProcess_FreeRunning.PpImageProcess_ParkingLot_20ms.DeSVParkingSlot.gstSpaceRear[2].fIdentifierNum CtApImageProcess_FreeRunning.PpImageProcess_ParkingLot_20ms.DeSVParkingSlot.gstSpaceRear[2].fReserved CtApImageProcess_FreeRunning.PpImageProcess_ParkingLot_20ms.DeSVParkingSlot.gstSpaceRear[3].nValid CtApImageProcess_FreeRunning.PpImageProcess_ParkingLot_20ms.DeSVParkingSlot.gstSpaceRear[3].gfPos[0] CtApImageProcess_FreeRunning.PpImageProcess_ParkingLot_20ms.DeSVParkingSlot.gstSpaceRear[3].gfPos[1] CtApImageProcess_FreeRunning.PpImageProcess_ParkingLot_20ms.DeSVParkingSlot.gstSpaceRear[3].gfPos[2] CtApImageProcess_FreeRunning.PpImageProcess_ParkingLot_20ms.DeSVParkingSlot.gstSpaceRear[3].gfPos[3] CtApImageProcess_FreeRunning.PpImageProcess_ParkingLot_20ms.DeSVParkingSlot.gstSpaceRear[3].nQuality CtApImageProcess_FreeRunning.PpImageProcess_ParkingLot_20ms.DeSVParkingSlot.gstSpaceRear[3].nType CtApImageProcess_FreeRunning.PpImageProcess_ParkingLot_20ms.DeSVParkingSlot.gstSpaceRear[3].nParkingGarageID CtApImageProcess_FreeRunning.PpImageProcess_ParkingLot_20ms.DeSVParkingSlot.gstSpaceRear[3].fLineWith CtApImageProcess_FreeRunning.PpImageProcess_ParkingLot_20ms.DeSVParkingSlot.gstSpaceRear[3].fSita CtApImageProcess_FreeRunning.PpImageProcess_ParkingLot_20ms.DeSVParkingSlot.gstSpaceRear[3].fIdentifierNum CtApImageProcess_FreeRunning.PpImageProcess_ParkingLot_20ms.DeSVParkingSlot.gstSpaceRear[3].fReserved CtApImageProcess_FreeRunning.PpImageProcess_ParkingLot_20ms.DeSVParkingSlot.gstSpaceRear[4].nValid CtApImageProcess_FreeRunning.PpImageProcess_ParkingLot_20ms.DeSVParkingSlot.gstSpaceRear[4].gfPos[0] CtApImageProcess_FreeRunning.PpImageProcess_ParkingLot_20ms.DeSVParkingSlot.gstSpaceRear[4].gfPos[1] CtApImageProcess_FreeRunning.PpImageProcess_ParkingLot_20ms.DeSVParkingSlot.gstSpaceRear[4].gfPos[2] CtApImageProcess_FreeRunning.PpImageProcess_ParkingLot_20ms.DeSVParkingSlot.gstSpaceRear[4].gfPos[3] CtApImageProcess_FreeRunning.PpImageProcess_ParkingLot_20ms.DeSVParkingSlot.gstSpaceRear[4].nQuality CtApImageProcess_FreeRunning.PpImageProcess_ParkingLot_20ms.DeSVParkingSlot.gstSpaceRear[4].nType CtApImageProcess_FreeRunning.PpImageProcess_ParkingLot_20ms.DeSVParkingSlot.gstSpaceRear[4].nParkingGarageID CtApImageProcess_FreeRunning.PpImageProcess_ParkingLot_20ms.DeSVParkingSlot.gstSpaceRear[4].fLineWith CtApImageProcess_FreeRunning.PpImageProcess_ParkingLot_20ms.DeSVParkingSlot.gstSpaceRear[4].fSita CtApImageProcess_FreeRunning.PpImageProcess_ParkingLot_20ms.DeSVParkingSlot.gstSpaceRear[4].fIdentifierNum CtApImageProcess_FreeRunning.PpImageProcess_ParkingLot_20ms.DeSVParkingSlot.gstSpaceRear[4].fReserved CtApImageProcess_FreeRunning.PpImageProcess_ParkingLot_20ms.DeSVParkingSlot.gstSpaceRear[5].nValid CtApImageProcess_FreeRunning.PpImageProcess_ParkingLot_20ms.DeSVParkingSlot.gstSpaceRear[5].gfPos[0] CtApImageProcess_FreeRunning.PpImageProcess_ParkingLot_20ms.DeSVParkingSlot.gstSpaceRear[5].gfPos[1] CtApImageProcess_FreeRunning.PpImageProcess_ParkingLot_20ms.DeSVParkingSlot.gstSpaceRear[5].gfPos[2] CtApImageProcess_FreeRunning.PpImageProcess_ParkingLot_20ms.DeSVParkingSlot.gstSpaceRear[5].gfPos[3] CtApImageProcess_FreeRunning.PpImageProcess_ParkingLot_20ms.DeSVParkingSlot.gstSpaceRear[5].nQuality CtApImageProcess_FreeRunning.PpImageProcess_ParkingLot_20ms.DeSVParkingSlot.gstSpaceRear[5].nType CtApImageProcess_FreeRunning.PpImageProcess_ParkingLot_20ms.DeSVParkingSlot.gstSpaceRear[5].nParkingGarageID CtApImageProcess_FreeRunning.PpImageProcess_ParkingLot_20ms.DeSVParkingSlot.gstSpaceRear[5].fLineWith CtApImageProcess_FreeRunning.PpImageProcess_ParkingLot_20ms.DeSVParkingSlot.gstSpaceRear[5].fSita CtApImageProcess_FreeRunning.PpImageProcess_ParkingLot_20ms.DeSVParkingSlot.gstSpaceRear[5].fIdentifierNum CtApImageProcess_FreeRunning.PpImageProcess_ParkingLot_20ms.DeSVParkingSlot.gstSpaceRear[5].fReserved CtApImageProcess_FreeRunning.PpImageProcess_ParkingLot_20ms.DeSVParkingSlot.gstSpaceRear[6].nValid CtApImageProcess_FreeRunning.PpImageProcess_ParkingLot_20ms.DeSVParkingSlot.gstSpaceRear[6].gfPos[0] CtApImageProcess_FreeRunning.PpImageProcess_ParkingLot_20ms.DeSVParkingSlot.gstSpaceRear[6].gfPos[1] CtApImageProcess_FreeRunning.PpImageProcess_ParkingLot_20ms.DeSVParkingSlot.gstSpaceRear[6].gfPos[2] CtApImageProcess_FreeRunning.PpImageProcess_ParkingLot_20ms.DeSVParkingSlot.gstSpaceRear[6].gfPos[3] CtApImageProcess_FreeRunning.PpImageProcess_ParkingLot_20ms.DeSVParkingSlot.gstSpaceRear[6].nQuality CtApImageProcess_FreeRunning.PpImageProcess_ParkingLot_20ms.DeSVParkingSlot.gstSpaceRear[6].nType CtApImageProcess_FreeRunning.PpImageProcess_ParkingLot_20ms.DeSVParkingSlot.gstSpaceRear[6].nParkingGarageID CtApImageProcess_FreeRunning.PpImageProcess_ParkingLot_20ms.DeSVParkingSlot.gstSpaceRear[6].fLineWith CtApImageProcess_FreeRunning.PpImageProcess_ParkingLot_20ms.DeSVParkingSlot.gstSpaceRear[6].fSita CtApImageProcess_FreeRunning.PpImageProcess_ParkingLot_20ms.DeSVParkingSlot.gstSpaceRear[6].fIdentifierNum CtApImageProcess_FreeRunning.PpImageProcess_ParkingLot_20ms.DeSVParkingSlot.gstSpaceRear[6].fReserved CtApImageProcess_FreeRunning.PpImageProcess_ParkingLot_20ms.DeSVParkingSlot.gstSpaceRear[7].nValid CtApImageProcess_FreeRunning.PpImageProcess_ParkingLot_20ms.DeSVParkingSlot.gstSpaceRear[7].gfPos[0] CtApImageProcess_FreeRunning.PpImageProcess_ParkingLot_20ms.DeSVParkingSlot.gstSpaceRear[7].gfPos[1] CtApImageProcess_FreeRunning.PpImageProcess_ParkingLot_20ms.DeSVParkingSlot.gstSpaceRear[7].gfPos[2] CtApImageProcess_FreeRunning.PpImageProcess_ParkingLot_20ms.DeSVParkingSlot.gstSpaceRear[7].gfPos[3] CtApImageProcess_FreeRunning.PpImageProcess_ParkingLot_20ms.DeSVParkingSlot.gstSpaceRear[7].nQuality CtApImageProcess_FreeRunning.PpImageProcess_ParkingLot_20ms.DeSVParkingSlot.gstSpaceRear[7].nType CtApImageProcess_FreeRunning.PpImageProcess_ParkingLot_20ms.DeSVParkingSlot.gstSpaceRear[7].nParkingGarageID CtApImageProcess_FreeRunning.PpImageProcess_ParkingLot_20ms.DeSVParkingSlot.gstSpaceRear[7].fLineWith CtApImageProcess_FreeRunning.PpImageProcess_ParkingLot_20ms.DeSVParkingSlot.gstSpaceRear[7].fSita CtApImageProcess_FreeRunning.PpImageProcess_ParkingLot_20ms.DeSVParkingSlot.gstSpaceRear[7].fIdentifierNum CtApImageProcess_FreeRunning.PpImageProcess_ParkingLot_20ms.DeSVParkingSlot.gstSpaceRear[7].fReserved CtApImageProcess_FreeRunning.PpImageProcess_ParkingLot_20ms.DeSVParkingSlot.fReserved CtApImageProcess_FreeRunning.PpImageProcess_ParkingLot_20ms.DeSVParkingSlot.t2 CtApImageProcess_FreeRunning.PpImageProcess_Position_init_status_60ms.DePosition_init_status.stHeader.Counter CtApImageProcess_FreeRunning.PpImageProcess_Position_init_status_60ms.DePosition_init_status.stHeader.FrameID CtApImageProcess_FreeRunning.PpImageProcess_Position_init_status_60ms.DePosition_init_status.stHeader.TimeStamp CtApImageProcess_FreeRunning.PpImageProcess_Position_init_status_60ms.DePosition_init_status.isPositionInitial CtApImageProcess_FreeRunning.PpImageProcess_ReswevedA2B_50ms.DeReservedA2B.nReserved1 CtApImageProcess_FreeRunning.PpImageProcess_ReswevedA2B_50ms.DeReservedA2B.nReserved2 CtApImageProcess_FreeRunning.PpImageProcess_ReswevedA2B_50ms.DeReservedA2B.fReserved CtApImageProcess_FreeRunning.PpImageProcess_Status_20ms.DeStatus.stHeader.Counter CtApImageProcess_FreeRunning.PpImageProcess_Status_20ms.DeStatus.stHeader.FrameID CtApImageProcess_FreeRunning.PpImageProcess_Status_20ms.DeStatus.stHeader.TimeStamp CtApImageProcess_FreeRunning.PpImageProcess_Status_20ms.DeStatus.t2 CtApImageProcess_FreeRunning.PpImageProcess_Status_20ms.DeStatus.AVM_Availability CtApImageProcess_FreeRunning.PpImageProcess_Status_20ms.DeStatus.PLD_Availability CtApImageProcess_FreeRunning.PpImageProcess_Status_20ms.DeStatus.FreeSpace_Availability CtApImageProcess_FreeRunning.PpImageProcess_Status_20ms.DeStatus.OD_Availability CtApImageProcess_FreeRunning.PpImageProcess_Status_20ms.DeStatus.RMD_Availability CtApImageProcess_FreeRunning.PpImageProcess_Status_20ms.DeStatus.Lane_Availability CtApImageProcess_FreeRunning.PpImageProcess_Status_20ms.DeStatus.fReserved CtApImageProcess_FreeRunning.PpImageProcess_SVCameraFail_60ms.DeSurroundCameraFail.stHeader.Counter CtApImageProcess_FreeRunning.PpImageProcess_SVCameraFail_60ms.DeSurroundCameraFail.stHeader.FrameID CtApImageProcess_FreeRunning.PpImageProcess_SVCameraFail_60ms.DeSurroundCameraFail.stHeader.TimeStamp CtApImageProcess_FreeRunning.PpImageProcess_SVCameraFail_60ms.DeSurroundCameraFail.Front_SV_Camera_Status CtApImageProcess_FreeRunning.PpImageProcess_SVCameraFail_60ms.DeSurroundCameraFail.Rear_SV_Camera_Status CtApImageProcess_FreeRunning.PpImageProcess_SVCameraFail_60ms.DeSurroundCameraFail.Left_SV_Camera_Status CtApImageProcess_FreeRunning.PpImageProcess_SVCameraFail_60ms.DeSurroundCameraFail.Right_SV_Camera_Status CtApImageProcess_FreeRunning.PpImageProcess_SVCameraFail_60ms.DeSurroundCameraFail.nReserved CtApImageProcess_FreeRunning.PpImageProcess_SVData_Upload_status_300ms.DeSVData_Upload_status.SVData_Upload_status CtApImageProcess_FreeRunning.PpImageProcess_SVData_Upload_status_300ms.DeSVData_Upload_status.nReserved CtApImageProcess_FreeRunning.PpPdImageProcess_FreeRunningWrite.DeImageProcess_FreeRunning_Normal.DeStatus CtApImageProcess_FreeRunning.PpPdImageProcess_FreeRunningWrite.DeImageProcess_FreeRunning_Normal.DeVersion.DeExpectedVersion.DeMajor CtApImageProcess_FreeRunning.PpPdImageProcess_FreeRunningWrite.DeImageProcess_FreeRunning_Normal.DeVersion.DeExpectedVersion.DeMinor CtApImageProcess_FreeRunning.PpPdImageProcess_FreeRunningWrite.DeImageProcess_FreeRunning_Normal.DeVersion.DeVersion.DeMajor CtApImageProcess_FreeRunning.PpPdImageProcess_FreeRunningWrite.DeImageProcess_FreeRunning_Normal.DeVersion.DeVersion.DeMinor CtApImageProcess_FreeRunning.PpPdImageProcess_FreeRunningWrite.DeImageProcess_FreeRunning_Normal.DeData.ngSignal CtApImageProcess_FreeRunning.PpPdImageProcess_FreeRunningWrite.DeImageProcess_FreeRunning_Normal.DeData.fgSignal CtApImageProcess_FreeRunning.PpPdImageProcess_FreeRunningWrite.DeImageProcess_Normal.DeStatus CtApImageProcess_FreeRunning.PpPdImageProcess_FreeRunningWrite.DeImageProcess_Normal.DeVersion.DeExpectedVersion.DeMajor CtApImageProcess_FreeRunning.PpPdImageProcess_FreeRunningWrite.DeImageProcess_Normal.DeVersion.DeExpectedVersion.DeMinor CtApImageProcess_FreeRunning.PpPdImageProcess_FreeRunningWrite.DeImageProcess_Normal.DeVersion.DeVersion.DeMajor CtApImageProcess_FreeRunning.PpPdImageProcess_FreeRunningWrite.DeImageProcess_Normal.DeVersion.DeVersion.DeMinor CtApImageProcess_FreeRunning.PpPdImageProcess_FreeRunningWrite.DeImageProcess_Normal.DeData.stHeader_Counter CtApImageProcess_FreeRunning.PpPdImageProcess_FreeRunningWrite.DeImageProcess_Normal.DeData.stHeader_FrameID CtApImageProcess_FreeRunning.PpPdImageProcess_FreeRunningWrite.DeImageProcess_Normal.DeData.stHeader_TimeStamp CtApImageProcess_FreeRunning.PpPdImageProcess_FreeRunningWrite.DeImageProcess_Normal.DeData.stCamInt_w CtApImageProcess_FreeRunning.PpPdImageProcess_FreeRunningWrite.DeImageProcess_Normal.DeData.stCamInt_h CtApImageProcess_FreeRunning.PpPdImageProcess_FreeRunningWrite.DeImageProcess_Normal.DeData.stCamInt_cu CtApImageProcess_FreeRunning.PpPdImageProcess_FreeRunningWrite.DeImageProcess_Normal.DeData.stCamInt_cv CtApImageProcess_FreeRunning.PpPdImageProcess_FreeRunningWrite.DeImageProcess_Normal.DeData.stCamInt_skew_c CtApImageProcess_FreeRunning.PpPdImageProcess_FreeRunningWrite.DeImageProcess_Normal.DeData.stCamInt_skew_d CtApImageProcess_FreeRunning.PpPdImageProcess_FreeRunningWrite.DeImageProcess_Normal.DeData.stCamInt_skew_e CtApImageProcess_FreeRunning.PpPdImageProcess_FreeRunningWrite.DeImageProcess_Normal.DeData.stCamInt_fu_or_hfov_at_cu CtApImageProcess_FreeRunning.PpPdImageProcess_FreeRunningWrite.DeImageProcess_Normal.DeData.stCamInt_fu_or_hfov_at_cv CtApImageProcess_FreeRunning.PpPdImageProcess_FreeRunningWrite.DeImageProcess_Normal.DeData.stCamInt_use_fov CtApImageProcess_FreeRunning.PpPdImageProcess_FreeRunningWrite.DeImageProcess_Normal.DeData.stCamInt_lut CtApImageProcess_FreeRunning.PpPdImageProcess_FreeRunningWrite.DeImageProcess_Normal.DeData.stCamExt_rx CtApImageProcess_FreeRunning.PpPdImageProcess_FreeRunningWrite.DeImageProcess_Normal.DeData.stCamExt_ry CtApImageProcess_FreeRunning.PpPdImageProcess_FreeRunningWrite.DeImageProcess_Normal.DeData.stCamExt_rz CtApImageProcess_FreeRunning.PpPdImageProcess_FreeRunningWrite.DeImageProcess_Normal.DeData.stCamExt_tx CtApImageProcess_FreeRunning.PpPdImageProcess_FreeRunningWrite.DeImageProcess_Normal.DeData.stCamExt_ty CtApImageProcess_FreeRunning.PpPdImageProcess_FreeRunningWrite.DeImageProcess_Normal.DeData.stCamExt_tz CtApImageProcess_FreeRunning.PpPdImageProcess_FreeRunningWrite.DeImageProcess_Normal.DeData.stCarParam_eachPulseDist CtApImageProcess_FreeRunning.PpPdImageProcess_FreeRunningWrite.DeImageProcess_Normal.DeData.stCarParam_frontWheelDriven CtApImageProcess_FreeRunning.PpPdImageProcess_FreeRunningWrite.DeImageProcess_Normal.DeData.stCarParam_reserved CtApImageProcess_FreeRunning.PpPdImageProcess_FreeRunningWrite.DeImageProcess_Normal.DeData.stCarParam_gnMotionModelCalib_01 CtApImageProcess_FreeRunning.PpPdImageProcess_FreeRunningWrite.DeImageProcess_Normal.DeData.stCarParam_gnMotionModelCalib_02 CtApImageProcess_FreeRunning.PpPdImageProcess_FreeRunningWrite.DeImageProcess_Normal.DeData.stCarParam_gnMotionModelCalib_03 CtApImageProcess_FreeRunning.PpPdImageProcess_FreeRunningWrite.DeImageProcess_Normal.DeData.stCarParam_gnMotionModelCalib_04 CtApImageProcess_FreeRunning.PpPdImageProcess_FreeRunningWrite.DeImageProcess_Normal.DeData.stCarParam_gnMotionModelCalib_05 CtApImageProcess_FreeRunning.PpPdImageProcess_FreeRunningWrite.DeImageProcess_Normal.DeData.stCarParam_gnMotionModelCalib_06 CtApImageProcess_FreeRunning.PpPdImageProcess_FreeRunningWrite.DeImageProcessSec_Normal.DeStatus CtApImageProcess_FreeRunning.PpPdImageProcess_FreeRunningWrite.DeImageProcessSec_Normal.DeVersion.DeExpectedVersion.DeMajor CtApImageProcess_FreeRunning.PpPdImageProcess_FreeRunningWrite.DeImageProcessSec_Normal.DeVersion.DeExpectedVersion.DeMinor CtApImageProcess_FreeRunning.PpPdImageProcess_FreeRunningWrite.DeImageProcessSec_Normal.DeVersion.DeVersion.DeMajor CtApImageProcess_FreeRunning.PpPdImageProcess_FreeRunningWrite.DeImageProcessSec_Normal.DeVersion.DeVersion.DeMinor CtApImageProcess_FreeRunning.PpPdImageProcess_FreeRunningWrite.DeImageProcessSec_Normal.DeData CtApImageProcess_FreeRunning.PpBdImageProcessRead.BdSV_Normal.DeStatus CtApImageProcess_FreeRunning.PpBdImageProcessRead.BdSV_Normal.DeVersion.DeExpectedVersion.DeMajor CtApImageProcess_FreeRunning.PpBdImageProcessRead.BdSV_Normal.DeVersion.DeExpectedVersion.DeMinor CtApImageProcess_FreeRunning.PpBdImageProcessRead.BdSV_Normal.DeVersion.DeVersion.DeMajor CtApImageProcess_FreeRunning.PpBdImageProcessRead.BdSV_Normal.DeVersion.DeVersion.DeMinor CtApImageProcess_FreeRunning.PpBdImageProcessRead.BdSV_Normal.DeData CtApImageProcess_FreeRunning.PpCOM_BMS_HSC1_100ms.DeBMS_HSC1_FrP11.BMSOnbdChrgrPlugOn_h1HSC1 CtApImageProcess_FreeRunning.PpCOM_BMS_HSC1_100ms.DeBMS_HSC1_FrP11.BMSOfbdChrgrPlugOn_h1HSC1 CtApImageProcess_FreeRunning.PpCOM_FICM_HSC4_50ms.DeFICM_HSC4_FrP13.CMDMODHSC4 CtApImageProcess_FreeRunning.PpCOM_FICM_HSC4_50ms.DeFICM_HSC4_FrP13.AlisysrdyHSC4 CtApImageProcess_FreeRunning.PpCOM_FICM_HSC4_AVM_100ms.DeFICM_HSC4_FrP18_FrP35_AVM.SurndViewSelnVHSC4 CtApImageProcess_FreeRunning.PpCOM_FICM_HSC4_AVM_100ms.DeFICM_HSC4_FrP18_FrP35_AVM.SurndViewSeln_oldHSC4 CtApImageProcess_FreeRunning.PpCOM_FICM_HSC4_AVM_100ms.DeFICM_HSC4_FrP18_FrP35_AVM.SurVwSlcHSC4 CtApImageProcess_FreeRunning.PpCOM_FICM_HSC4_AVM_100ms.DeFICM_HSC4_FrP19.AutoViewChgHSC4 CtApImageProcess_FreeRunning.PpCOM_FICM_HSC4_AVM_10ms.DeFICM_HSC4_FrP32.SurndViewSelnHSC4 CtApImageProcess_FreeRunning.PpCOM_FICM_HSC4_AVM_10ms.DeFICM_HSC4_FrP32.SCREEN_COORD_AXHSC4 CtApImageProcess_FreeRunning.PpCOM_FICM_HSC4_AVM_10ms.DeFICM_HSC4_FrP32.TOUCH_SCREEN_ACMDHSC4 CtApImageProcess_FreeRunning.PpCOM_FICM_HSC4_AVM_10ms.DeFICM_HSC4_FrP32.SCREEN_COORD_AYHSC4 CtApImageProcess_FreeRunning.PpCOM_FICM_HSC4_AVM_10ms.DeFICM_HSC4_FrP32.TOUCH_SCREEN_STATUSHSC4 CtApImageProcess_FreeRunning.PpCOM_FICM_HSC4_AVM_10ms.DeFICM_HSC4_FrP32.SCREEN_COORD_BXHSC4 CtApImageProcess_FreeRunning.PpCOM_FICM_HSC4_AVM_10ms.DeFICM_HSC4_FrP32.TOUCH_SCREEN_BCMDHSC4 CtApImageProcess_FreeRunning.PpCOM_FICM_HSC4_AVM_10ms.DeFICM_HSC4_FrP32.SCREEN_COORD_BYHSC4 CtApImageProcess_FreeRunning.PpCOM_TPMS_HSC3_400ms.DeTPMS_HSC3_FrP01.RRTireTemVHSC4 CtApImageProcess_FreeRunning.PpCOM_TPMS_HSC3_400ms.DeTPMS_HSC3_FrP01.RRTireTemHSC4 CtApImageProcess_FreeRunning.PpCOM_TPMS_HSC3_400ms.DeTPMS_HSC3_FrP01.RRTirePrsVHSC4 CtApImageProcess_FreeRunning.PpCOM_TPMS_HSC3_400ms.DeTPMS_HSC3_FrP01.RRTirePrsHSC4 CtApImageProcess_FreeRunning.PpCOM_TPMS_HSC3_400ms.DeTPMS_HSC3_FrP01.RLTireTemVHSC4 CtApImageProcess_FreeRunning.PpCOM_TPMS_HSC3_400ms.DeTPMS_HSC3_FrP01.RLTireTemHSC4 CtApImageProcess_FreeRunning.PpCOM_TPMS_HSC3_400ms.DeTPMS_HSC3_FrP01.RLTirePrsVHSC4 CtApImageProcess_FreeRunning.PpCOM_TPMS_HSC3_400ms.DeTPMS_HSC3_FrP01.RLTirePrsHSC4 CtApImageProcess_FreeRunning.PpCOM_TPMS_HSC3_400ms.DeTPMS_HSC3_FrP01.FRTireTemVHSC4 CtApImageProcess_FreeRunning.PpCOM_TPMS_HSC3_400ms.DeTPMS_HSC3_FrP01.FRTireTemHSC4 CtApImageProcess_FreeRunning.PpCOM_TPMS_HSC3_400ms.DeTPMS_HSC3_FrP01.FRTirePrsVHSC4 CtApImageProcess_FreeRunning.PpCOM_TPMS_HSC3_400ms.DeTPMS_HSC3_FrP01.FRTirePrsHSC4 CtApImageProcess_FreeRunning.PpCOM_TPMS_HSC3_400ms.DeTPMS_HSC3_FrP01.FLTireTemVHSC4 CtApImageProcess_FreeRunning.PpCOM_TPMS_HSC3_400ms.DeTPMS_HSC3_FrP01.FLTireTemHSC4 CtApImageProcess_FreeRunning.PpCOM_TPMS_HSC3_400ms.DeTPMS_HSC3_FrP01.FLTirePrsVHSC4 CtApImageProcess_FreeRunning.PpCOM_TPMS_HSC3_400ms.DeTPMS_HSC3_FrP01.FLTirePrsHSC4 CtApImageProcess_FreeRunning.PpCOM_TPMS_HSC3_400ms.DeTPMS_HSC3_FrP02.DeStatus_TPMS_HSC3_FrP02 CtApImageProcess_FreeRunning.PpCOM_TPMS_HSC3_400ms.DeTPMS_HSC3_FrP02.FLTireStsHSC4 CtApImageProcess_FreeRunning.PpCOM_TPMS_HSC3_400ms.DeTPMS_HSC3_FrP02.FRTireStsHSC4 CtApImageProcess_FreeRunning.PpCOM_TPMS_HSC3_400ms.DeTPMS_HSC3_FrP02.RLTireStsHSC4 CtApImageProcess_FreeRunning.PpCOM_TPMS_HSC3_400ms.DeTPMS_HSC3_FrP02.RRTireStsHSC4 CtApImageProcess_FreeRunning.PpCOM_TPMS_HSC3_400ms.DeTPMS_HSC3_FrP02.DeTimestamp.DeTimestampEGT.DeTimestampHigh CtApImageProcess_FreeRunning.PpCOM_TPMS_HSC3_400ms.DeTPMS_HSC3_FrP02.DeTimestamp.DeTimestampEGT.DeTimestampLow CtApImageProcess_FreeRunning.PpCOM_TPMS_HSC3_400ms.DeTPMS_HSC3_FrP02.DeTimestamp.DeTimestampMW_RX.DeTimestampHigh CtApImageProcess_FreeRunning.PpCOM_TPMS_HSC3_400ms.DeTPMS_HSC3_FrP02.DeTimestamp.DeTimestampMW_RX.DeTimestampLow CtApImageProcess_FreeRunning.PpCOM_TPMS_HSC3_400ms.DeTPMS_HSC3_FrP02.DeTimestamp.DeTimestampMW_TX.DeTimestampHigh CtApImageProcess_FreeRunning.PpCOM_TPMS_HSC3_400ms.DeTPMS_HSC3_FrP02.DeTimestamp.DeTimestampMW_TX.DeTimestampLow CtApImageProcess_FreeRunning.PpDiagCoding.DeCoding.FW_Dummy CtApImageProcess_FreeRunning.PpDR_Merges_10ms.DeDR_List.stHeader.Counter CtApImageProcess_FreeRunning.PpDR_Merges_10ms.DeDR_List.stHeader.FrameID CtApImageProcess_FreeRunning.PpDR_Merges_10ms.DeDR_List.stHeader.TimeStamp CtApImageProcess_FreeRunning.PpDR_Merges_10ms.DeDR_List.Origin_time CtApImageProcess_FreeRunning.PpDR_Merges_10ms.DeDR_List.Origin_utm_x CtApImageProcess_FreeRunning.PpDR_Merges_10ms.DeDR_List.Origin_utm_y CtApImageProcess_FreeRunning.PpDR_Merges_10ms.DeDR_List.Origin_utm_z CtApImageProcess_FreeRunning.PpDR_Merges_10ms.DeDR_List.Origin_utm_heading CtApImageProcess_FreeRunning.PpDR_Merges_10ms.DeDR_List.DR_List[0].stHeader.Counter CtApImageProcess_FreeRunning.PpDR_Merges_10ms.DeDR_List.DR_List[0].stHeader.FrameID CtApImageProcess_FreeRunning.PpDR_Merges_10ms.DeDR_List.DR_List[0].stHeader.TimeStamp CtApImageProcess_FreeRunning.PpDR_Merges_10ms.DeDR_List.DR_List[0].count CtApImageProcess_FreeRunning.PpDR_Merges_10ms.DeDR_List.DR_List[0].time_sec CtApImageProcess_FreeRunning.PpDR_Merges_10ms.DeDR_List.DR_List[0].utm_x CtApImageProcess_FreeRunning.PpDR_Merges_10ms.DeDR_List.DR_List[0].utm_y CtApImageProcess_FreeRunning.PpDR_Merges_10ms.DeDR_List.DR_List[0].utm_z CtApImageProcess_FreeRunning.PpDR_Merges_10ms.DeDR_List.DR_List[0].heading CtApImageProcess_FreeRunning.PpDR_Merges_10ms.DeDR_List.DR_List[0].delta_x CtApImageProcess_FreeRunning.PpDR_Merges_10ms.DeDR_List.DR_List[0].delta_y CtApImageProcess_FreeRunning.PpDR_Merges_10ms.DeDR_List.DR_List[0].delta_z CtApImageProcess_FreeRunning.PpDR_Merges_10ms.DeDR_List.DR_List[0].delta_yaw CtApImageProcess_FreeRunning.PpDR_Merges_10ms.DeDR_List.DR_List[0].belif CtApImageProcess_FreeRunning.PpDR_Merges_10ms.DeDR_List.DR_List[0].reserved_int CtApImageProcess_FreeRunning.PpDR_Merges_10ms.DeDR_List.DR_List[1].stHeader.Counter CtApImageProcess_FreeRunning.PpDR_Merges_10ms.DeDR_List.DR_List[1].stHeader.FrameID CtApImageProcess_FreeRunning.PpDR_Merges_10ms.DeDR_List.DR_List[1].stHeader.TimeStamp CtApImageProcess_FreeRunning.PpDR_Merges_10ms.DeDR_List.DR_List[1].count CtApImageProcess_FreeRunning.PpDR_Merges_10ms.DeDR_List.DR_List[1].time_sec CtApImageProcess_FreeRunning.PpDR_Merges_10ms.DeDR_List.DR_List[1].utm_x CtApImageProcess_FreeRunning.PpDR_Merges_10ms.DeDR_List.DR_List[1].utm_y CtApImageProcess_FreeRunning.PpDR_Merges_10ms.DeDR_List.DR_List[1].utm_z CtApImageProcess_FreeRunning.PpDR_Merges_10ms.DeDR_List.DR_List[1].heading CtApImageProcess_FreeRunning.PpDR_Merges_10ms.DeDR_List.DR_List[1].delta_x CtApImageProcess_FreeRunning.PpDR_Merges_10ms.DeDR_List.DR_List[1].delta_y CtApImageProcess_FreeRunning.PpDR_Merges_10ms.DeDR_List.DR_List[1].delta_z CtApImageProcess_FreeRunning.PpDR_Merges_10ms.DeDR_List.DR_List[1].delta_yaw CtApImageProcess_FreeRunning.PpDR_Merges_10ms.DeDR_List.DR_List[1].belif CtApImageProcess_FreeRunning.PpDR_Merges_10ms.DeDR_List.DR_List[1].reserved_int CtApImageProcess_FreeRunning.PpDR_Merges_10ms.DeDR_List.DR_List[2].stHeader.Counter CtApImageProcess_FreeRunning.PpDR_Merges_10ms.DeDR_List.DR_List[2].stHeader.FrameID CtApImageProcess_FreeRunning.PpDR_Merges_10ms.DeDR_List.DR_List[2].stHeader.TimeStamp CtApImageProcess_FreeRunning.PpDR_Merges_10ms.DeDR_List.DR_List[2].count CtApImageProcess_FreeRunning.PpDR_Merges_10ms.DeDR_List.DR_List[2].time_sec CtApImageProcess_FreeRunning.PpDR_Merges_10ms.DeDR_List.DR_List[2].utm_x CtApImageProcess_FreeRunning.PpDR_Merges_10ms.DeDR_List.DR_List[2].utm_y CtApImageProcess_FreeRunning.PpDR_Merges_10ms.DeDR_List.DR_List[2].utm_z CtApImageProcess_FreeRunning.PpDR_Merges_10ms.DeDR_List.DR_List[2].heading CtApImageProcess_FreeRunning.PpDR_Merges_10ms.DeDR_List.DR_List[2].delta_x CtApImageProcess_FreeRunning.PpDR_Merges_10ms.DeDR_List.DR_List[2].delta_y CtApImageProcess_FreeRunning.PpDR_Merges_10ms.DeDR_List.DR_List[2].delta_z CtApImageProcess_FreeRunning.PpDR_Merges_10ms.DeDR_List.DR_List[2].delta_yaw CtApImageProcess_FreeRunning.PpDR_Merges_10ms.DeDR_List.DR_List[2].belif CtApImageProcess_FreeRunning.PpDR_Merges_10ms.DeDR_List.DR_List[2].reserved_int CtApImageProcess_FreeRunning.PpDR_Merges_10ms.DeDR_List.DR_List[3].stHeader.Counter CtApImageProcess_FreeRunning.PpDR_Merges_10ms.DeDR_List.DR_List[3].stHeader.FrameID CtApImageProcess_FreeRunning.PpDR_Merges_10ms.DeDR_List.DR_List[3].stHeader.TimeStamp CtApImageProcess_FreeRunning.PpDR_Merges_10ms.DeDR_List.DR_List[3].count CtApImageProcess_FreeRunning.PpDR_Merges_10ms.DeDR_List.DR_List[3].time_sec CtApImageProcess_FreeRunning.PpDR_Merges_10ms.DeDR_List.DR_List[3].utm_x CtApImageProcess_FreeRunning.PpDR_Merges_10ms.DeDR_List.DR_List[3].utm_y CtApImageProcess_FreeRunning.PpDR_Merges_10ms.DeDR_List.DR_List[3].utm_z CtApImageProcess_FreeRunning.PpDR_Merges_10ms.DeDR_List.DR_List[3].heading CtApImageProcess_FreeRunning.PpDR_Merges_10ms.DeDR_List.DR_List[3].delta_x CtApImageProcess_FreeRunning.PpDR_Merges_10ms.DeDR_List.DR_List[3].delta_y CtApImageProcess_FreeRunning.PpDR_Merges_10ms.DeDR_List.DR_List[3].delta_z CtApImageProcess_FreeRunning.PpDR_Merges_10ms.DeDR_List.DR_List[3].delta_yaw CtApImageProcess_FreeRunning.PpDR_Merges_10ms.DeDR_List.DR_List[3].belif CtApImageProcess_FreeRunning.PpDR_Merges_10ms.DeDR_List.DR_List[3].reserved_int CtApImageProcess_FreeRunning.PpDR_Merges_10ms.DeDR_List.DR_List[4].stHeader.Counter CtApImageProcess_FreeRunning.PpDR_Merges_10ms.DeDR_List.DR_List[4].stHeader.FrameID CtApImageProcess_FreeRunning.PpDR_Merges_10ms.DeDR_List.DR_List[4].stHeader.TimeStamp CtApImageProcess_FreeRunning.PpDR_Merges_10ms.DeDR_List.DR_List[4].count CtApImageProcess_FreeRunning.PpDR_Merges_10ms.DeDR_List.DR_List[4].time_sec CtApImageProcess_FreeRunning.PpDR_Merges_10ms.DeDR_List.DR_List[4].utm_x CtApImageProcess_FreeRunning.PpDR_Merges_10ms.DeDR_List.DR_List[4].utm_y CtApImageProcess_FreeRunning.PpDR_Merges_10ms.DeDR_List.DR_List[4].utm_z CtApImageProcess_FreeRunning.PpDR_Merges_10ms.DeDR_List.DR_List[4].heading CtApImageProcess_FreeRunning.PpDR_Merges_10ms.DeDR_List.DR_List[4].delta_x CtApImageProcess_FreeRunning.PpDR_Merges_10ms.DeDR_List.DR_List[4].delta_y CtApImageProcess_FreeRunning.PpDR_Merges_10ms.DeDR_List.DR_List[4].delta_z CtApImageProcess_FreeRunning.PpDR_Merges_10ms.DeDR_List.DR_List[4].delta_yaw CtApImageProcess_FreeRunning.PpDR_Merges_10ms.DeDR_List.DR_List[4].belif CtApImageProcess_FreeRunning.PpDR_Merges_10ms.DeDR_List.DR_List[4].reserved_int CtApImageProcess_FreeRunning.PpDR_Merges_10ms.DeDR_List.DR_List[5].stHeader.Counter CtApImageProcess_FreeRunning.PpDR_Merges_10ms.DeDR_List.DR_List[5].stHeader.FrameID CtApImageProcess_FreeRunning.PpDR_Merges_10ms.DeDR_List.DR_List[5].stHeader.TimeStamp CtApImageProcess_FreeRunning.PpDR_Merges_10ms.DeDR_List.DR_List[5].count CtApImageProcess_FreeRunning.PpDR_Merges_10ms.DeDR_List.DR_List[5].time_sec CtApImageProcess_FreeRunning.PpDR_Merges_10ms.DeDR_List.DR_List[5].utm_x CtApImageProcess_FreeRunning.PpDR_Merges_10ms.DeDR_List.DR_List[5].utm_y CtApImageProcess_FreeRunning.PpDR_Merges_10ms.DeDR_List.DR_List[5].utm_z CtApImageProcess_FreeRunning.PpDR_Merges_10ms.DeDR_List.DR_List[5].heading CtApImageProcess_FreeRunning.PpDR_Merges_10ms.DeDR_List.DR_List[5].delta_x CtApImageProcess_FreeRunning.PpDR_Merges_10ms.DeDR_List.DR_List[5].delta_y CtApImageProcess_FreeRunning.PpDR_Merges_10ms.DeDR_List.DR_List[5].delta_z CtApImageProcess_FreeRunning.PpDR_Merges_10ms.DeDR_List.DR_List[5].delta_yaw CtApImageProcess_FreeRunning.PpDR_Merges_10ms.DeDR_List.DR_List[5].belif CtApImageProcess_FreeRunning.PpDR_Merges_10ms.DeDR_List.DR_List[5].reserved_int CtApImageProcess_FreeRunning.PpDR_Merges_10ms.DeDR_List.DR_List[6].stHeader.Counter CtApImageProcess_FreeRunning.PpDR_Merges_10ms.DeDR_List.DR_List[6].stHeader.FrameID CtApImageProcess_FreeRunning.PpDR_Merges_10ms.DeDR_List.DR_List[6].stHeader.TimeStamp CtApImageProcess_FreeRunning.PpDR_Merges_10ms.DeDR_List.DR_List[6].count CtApImageProcess_FreeRunning.PpDR_Merges_10ms.DeDR_List.DR_List[6].time_sec CtApImageProcess_FreeRunning.PpDR_Merges_10ms.DeDR_List.DR_List[6].utm_x CtApImageProcess_FreeRunning.PpDR_Merges_10ms.DeDR_List.DR_List[6].utm_y CtApImageProcess_FreeRunning.PpDR_Merges_10ms.DeDR_List.DR_List[6].utm_z CtApImageProcess_FreeRunning.PpDR_Merges_10ms.DeDR_List.DR_List[6].heading CtApImageProcess_FreeRunning.PpDR_Merges_10ms.DeDR_List.DR_List[6].delta_x CtApImageProcess_FreeRunning.PpDR_Merges_10ms.DeDR_List.DR_List[6].delta_y CtApImageProcess_FreeRunning.PpDR_Merges_10ms.DeDR_List.DR_List[6].delta_z CtApImageProcess_FreeRunning.PpDR_Merges_10ms.DeDR_List.DR_List[6].delta_yaw CtApImageProcess_FreeRunning.PpDR_Merges_10ms.DeDR_List.DR_List[6].belif CtApImageProcess_FreeRunning.PpDR_Merges_10ms.DeDR_List.DR_List[6].reserved_int CtApImageProcess_FreeRunning.PpDR_Merges_10ms.DeDR_List.DR_List[7].stHeader.Counter CtApImageProcess_FreeRunning.PpDR_Merges_10ms.DeDR_List.DR_List[7].stHeader.FrameID CtApImageProcess_FreeRunning.PpDR_Merges_10ms.DeDR_List.DR_List[7].stHeader.TimeStamp CtApImageProcess_FreeRunning.PpDR_Merges_10ms.DeDR_List.DR_List[7].count CtApImageProcess_FreeRunning.PpDR_Merges_10ms.DeDR_List.DR_List[7].time_sec CtApImageProcess_FreeRunning.PpDR_Merges_10ms.DeDR_List.DR_List[7].utm_x CtApImageProcess_FreeRunning.PpDR_Merges_10ms.DeDR_List.DR_List[7].utm_y CtApImageProcess_FreeRunning.PpDR_Merges_10ms.DeDR_List.DR_List[7].utm_z CtApImageProcess_FreeRunning.PpDR_Merges_10ms.DeDR_List.DR_List[7].heading CtApImageProcess_FreeRunning.PpDR_Merges_10ms.DeDR_List.DR_List[7].delta_x CtApImageProcess_FreeRunning.PpDR_Merges_10ms.DeDR_List.DR_List[7].delta_y CtApImageProcess_FreeRunning.PpDR_Merges_10ms.DeDR_List.DR_List[7].delta_z CtApImageProcess_FreeRunning.PpDR_Merges_10ms.DeDR_List.DR_List[7].delta_yaw CtApImageProcess_FreeRunning.PpDR_Merges_10ms.DeDR_List.DR_List[7].belif CtApImageProcess_FreeRunning.PpDR_Merges_10ms.DeDR_List.DR_List[7].reserved_int CtApImageProcess_FreeRunning.PpDR_Merges_10ms.DeDR_List.DR_List[8].stHeader.Counter CtApImageProcess_FreeRunning.PpDR_Merges_10ms.DeDR_List.DR_List[8].stHeader.FrameID CtApImageProcess_FreeRunning.PpDR_Merges_10ms.DeDR_List.DR_List[8].stHeader.TimeStamp CtApImageProcess_FreeRunning.PpDR_Merges_10ms.DeDR_List.DR_List[8].count CtApImageProcess_FreeRunning.PpDR_Merges_10ms.DeDR_List.DR_List[8].time_sec CtApImageProcess_FreeRunning.PpDR_Merges_10ms.DeDR_List.DR_List[8].utm_x CtApImageProcess_FreeRunning.PpDR_Merges_10ms.DeDR_List.DR_List[8].utm_y CtApImageProcess_FreeRunning.PpDR_Merges_10ms.DeDR_List.DR_List[8].utm_z CtApImageProcess_FreeRunning.PpDR_Merges_10ms.DeDR_List.DR_List[8].heading CtApImageProcess_FreeRunning.PpDR_Merges_10ms.DeDR_List.DR_List[8].delta_x CtApImageProcess_FreeRunning.PpDR_Merges_10ms.DeDR_List.DR_List[8].delta_y CtApImageProcess_FreeRunning.PpDR_Merges_10ms.DeDR_List.DR_List[8].delta_z CtApImageProcess_FreeRunning.PpDR_Merges_10ms.DeDR_List.DR_List[8].delta_yaw CtApImageProcess_FreeRunning.PpDR_Merges_10ms.DeDR_List.DR_List[8].belif CtApImageProcess_FreeRunning.PpDR_Merges_10ms.DeDR_List.DR_List[8].reserved_int CtApImageProcess_FreeRunning.PpDR_Merges_10ms.DeDR_List.DR_List[9].stHeader.Counter CtApImageProcess_FreeRunning.PpDR_Merges_10ms.DeDR_List.DR_List[9].stHeader.FrameID CtApImageProcess_FreeRunning.PpDR_Merges_10ms.DeDR_List.DR_List[9].stHeader.TimeStamp CtApImageProcess_FreeRunning.PpDR_Merges_10ms.DeDR_List.DR_List[9].count CtApImageProcess_FreeRunning.PpDR_Merges_10ms.DeDR_List.DR_List[9].time_sec CtApImageProcess_FreeRunning.PpDR_Merges_10ms.DeDR_List.DR_List[9].utm_x CtApImageProcess_FreeRunning.PpDR_Merges_10ms.DeDR_List.DR_List[9].utm_y CtApImageProcess_FreeRunning.PpDR_Merges_10ms.DeDR_List.DR_List[9].utm_z CtApImageProcess_FreeRunning.PpDR_Merges_10ms.DeDR_List.DR_List[9].heading CtApImageProcess_FreeRunning.PpDR_Merges_10ms.DeDR_List.DR_List[9].delta_x CtApImageProcess_FreeRunning.PpDR_Merges_10ms.DeDR_List.DR_List[9].delta_y CtApImageProcess_FreeRunning.PpDR_Merges_10ms.DeDR_List.DR_List[9].delta_z CtApImageProcess_FreeRunning.PpDR_Merges_10ms.DeDR_List.DR_List[9].delta_yaw CtApImageProcess_FreeRunning.PpDR_Merges_10ms.DeDR_List.DR_List[9].belif CtApImageProcess_FreeRunning.PpDR_Merges_10ms.DeDR_List.DR_List[9].reserved_int CtApImageProcess_FreeRunning.PpDR_Merges_10ms.DeDR_List.DR_List[10].stHeader.Counter CtApImageProcess_FreeRunning.PpDR_Merges_10ms.DeDR_List.DR_List[10].stHeader.FrameID CtApImageProcess_FreeRunning.PpDR_Merges_10ms.DeDR_List.DR_List[10].stHeader.TimeStamp CtApImageProcess_FreeRunning.PpDR_Merges_10ms.DeDR_List.DR_List[10].count CtApImageProcess_FreeRunning.PpDR_Merges_10ms.DeDR_List.DR_List[10].time_sec CtApImageProcess_FreeRunning.PpDR_Merges_10ms.DeDR_List.DR_List[10].utm_x CtApImageProcess_FreeRunning.PpDR_Merges_10ms.DeDR_List.DR_List[10].utm_y CtApImageProcess_FreeRunning.PpDR_Merges_10ms.DeDR_List.DR_List[10].utm_z CtApImageProcess_FreeRunning.PpDR_Merges_10ms.DeDR_List.DR_List[10].heading CtApImageProcess_FreeRunning.PpDR_Merges_10ms.DeDR_List.DR_List[10].delta_x CtApImageProcess_FreeRunning.PpDR_Merges_10ms.DeDR_List.DR_List[10].delta_y CtApImageProcess_FreeRunning.PpDR_Merges_10ms.DeDR_List.DR_List[10].delta_z CtApImageProcess_FreeRunning.PpDR_Merges_10ms.DeDR_List.DR_List[10].delta_yaw CtApImageProcess_FreeRunning.PpDR_Merges_10ms.DeDR_List.DR_List[10].belif CtApImageProcess_FreeRunning.PpDR_Merges_10ms.DeDR_List.DR_List[10].reserved_int CtApImageProcess_FreeRunning.PpDR_Merges_10ms.DeDR_List.DR_List[11].stHeader.Counter CtApImageProcess_FreeRunning.PpDR_Merges_10ms.DeDR_List.DR_List[11].stHeader.FrameID CtApImageProcess_FreeRunning.PpDR_Merges_10ms.DeDR_List.DR_List[11].stHeader.TimeStamp CtApImageProcess_FreeRunning.PpDR_Merges_10ms.DeDR_List.DR_List[11].count CtApImageProcess_FreeRunning.PpDR_Merges_10ms.DeDR_List.DR_List[11].time_sec CtApImageProcess_FreeRunning.PpDR_Merges_10ms.DeDR_List.DR_List[11].utm_x CtApImageProcess_FreeRunning.PpDR_Merges_10ms.DeDR_List.DR_List[11].utm_y CtApImageProcess_FreeRunning.PpDR_Merges_10ms.DeDR_List.DR_List[11].utm_z CtApImageProcess_FreeRunning.PpDR_Merges_10ms.DeDR_List.DR_List[11].heading CtApImageProcess_FreeRunning.PpDR_Merges_10ms.DeDR_List.DR_List[11].delta_x CtApImageProcess_FreeRunning.PpDR_Merges_10ms.DeDR_List.DR_List[11].delta_y CtApImageProcess_FreeRunning.PpDR_Merges_10ms.DeDR_List.DR_List[11].delta_z CtApImageProcess_FreeRunning.PpDR_Merges_10ms.DeDR_List.DR_List[11].delta_yaw CtApImageProcess_FreeRunning.PpDR_Merges_10ms.DeDR_List.DR_List[11].belif CtApImageProcess_FreeRunning.PpDR_Merges_10ms.DeDR_List.DR_List[11].reserved_int CtApImageProcess_FreeRunning.PpDR_Merges_10ms.DeDR_List.DR_List[12].stHeader.Counter CtApImageProcess_FreeRunning.PpDR_Merges_10ms.DeDR_List.DR_List[12].stHeader.FrameID CtApImageProcess_FreeRunning.PpDR_Merges_10ms.DeDR_List.DR_List[12].stHeader.TimeStamp CtApImageProcess_FreeRunning.PpDR_Merges_10ms.DeDR_List.DR_List[12].count CtApImageProcess_FreeRunning.PpDR_Merges_10ms.DeDR_List.DR_List[12].time_sec CtApImageProcess_FreeRunning.PpDR_Merges_10ms.DeDR_List.DR_List[12].utm_x CtApImageProcess_FreeRunning.PpDR_Merges_10ms.DeDR_List.DR_List[12].utm_y CtApImageProcess_FreeRunning.PpDR_Merges_10ms.DeDR_List.DR_List[12].utm_z CtApImageProcess_FreeRunning.PpDR_Merges_10ms.DeDR_List.DR_List[12].heading CtApImageProcess_FreeRunning.PpDR_Merges_10ms.DeDR_List.DR_List[12].delta_x CtApImageProcess_FreeRunning.PpDR_Merges_10ms.DeDR_List.DR_List[12].delta_y CtApImageProcess_FreeRunning.PpDR_Merges_10ms.DeDR_List.DR_List[12].delta_z CtApImageProcess_FreeRunning.PpDR_Merges_10ms.DeDR_List.DR_List[12].delta_yaw CtApImageProcess_FreeRunning.PpDR_Merges_10ms.DeDR_List.DR_List[12].belif CtApImageProcess_FreeRunning.PpDR_Merges_10ms.DeDR_List.DR_List[12].reserved_int CtApImageProcess_FreeRunning.PpDR_Merges_10ms.DeDR_List.DR_List[13].stHeader.Counter CtApImageProcess_FreeRunning.PpDR_Merges_10ms.DeDR_List.DR_List[13].stHeader.FrameID CtApImageProcess_FreeRunning.PpDR_Merges_10ms.DeDR_List.DR_List[13].stHeader.TimeStamp CtApImageProcess_FreeRunning.PpDR_Merges_10ms.DeDR_List.DR_List[13].count CtApImageProcess_FreeRunning.PpDR_Merges_10ms.DeDR_List.DR_List[13].time_sec CtApImageProcess_FreeRunning.PpDR_Merges_10ms.DeDR_List.DR_List[13].utm_x CtApImageProcess_FreeRunning.PpDR_Merges_10ms.DeDR_List.DR_List[13].utm_y CtApImageProcess_FreeRunning.PpDR_Merges_10ms.DeDR_List.DR_List[13].utm_z CtApImageProcess_FreeRunning.PpDR_Merges_10ms.DeDR_List.DR_List[13].heading CtApImageProcess_FreeRunning.PpDR_Merges_10ms.DeDR_List.DR_List[13].delta_x CtApImageProcess_FreeRunning.PpDR_Merges_10ms.DeDR_List.DR_List[13].delta_y CtApImageProcess_FreeRunning.PpDR_Merges_10ms.DeDR_List.DR_List[13].delta_z CtApImageProcess_FreeRunning.PpDR_Merges_10ms.DeDR_List.DR_List[13].delta_yaw CtApImageProcess_FreeRunning.PpDR_Merges_10ms.DeDR_List.DR_List[13].belif CtApImageProcess_FreeRunning.PpDR_Merges_10ms.DeDR_List.DR_List[13].reserved_int CtApImageProcess_FreeRunning.PpDR_Merges_10ms.DeDR_List.DR_List[14].stHeader.Counter CtApImageProcess_FreeRunning.PpDR_Merges_10ms.DeDR_List.DR_List[14].stHeader.FrameID CtApImageProcess_FreeRunning.PpDR_Merges_10ms.DeDR_List.DR_List[14].stHeader.TimeStamp CtApImageProcess_FreeRunning.PpDR_Merges_10ms.DeDR_List.DR_List[14].count CtApImageProcess_FreeRunning.PpDR_Merges_10ms.DeDR_List.DR_List[14].time_sec CtApImageProcess_FreeRunning.PpDR_Merges_10ms.DeDR_List.DR_List[14].utm_x CtApImageProcess_FreeRunning.PpDR_Merges_10ms.DeDR_List.DR_List[14].utm_y CtApImageProcess_FreeRunning.PpDR_Merges_10ms.DeDR_List.DR_List[14].utm_z CtApImageProcess_FreeRunning.PpDR_Merges_10ms.DeDR_List.DR_List[14].heading CtApImageProcess_FreeRunning.PpDR_Merges_10ms.DeDR_List.DR_List[14].delta_x CtApImageProcess_FreeRunning.PpDR_Merges_10ms.DeDR_List.DR_List[14].delta_y CtApImageProcess_FreeRunning.PpDR_Merges_10ms.DeDR_List.DR_List[14].delta_z CtApImageProcess_FreeRunning.PpDR_Merges_10ms.DeDR_List.DR_List[14].delta_yaw CtApImageProcess_FreeRunning.PpDR_Merges_10ms.DeDR_List.DR_List[14].belif CtApImageProcess_FreeRunning.PpDR_Merges_10ms.DeDR_List.DR_List[14].reserved_int CtApImageProcess_FreeRunning.PpDR_Merges_10ms.DeDR_List.DR_List[15].stHeader.Counter CtApImageProcess_FreeRunning.PpDR_Merges_10ms.DeDR_List.DR_List[15].stHeader.FrameID CtApImageProcess_FreeRunning.PpDR_Merges_10ms.DeDR_List.DR_List[15].stHeader.TimeStamp CtApImageProcess_FreeRunning.PpDR_Merges_10ms.DeDR_List.DR_List[15].count CtApImageProcess_FreeRunning.PpDR_Merges_10ms.DeDR_List.DR_List[15].time_sec CtApImageProcess_FreeRunning.PpDR_Merges_10ms.DeDR_List.DR_List[15].utm_x CtApImageProcess_FreeRunning.PpDR_Merges_10ms.DeDR_List.DR_List[15].utm_y CtApImageProcess_FreeRunning.PpDR_Merges_10ms.DeDR_List.DR_List[15].utm_z CtApImageProcess_FreeRunning.PpDR_Merges_10ms.DeDR_List.DR_List[15].heading CtApImageProcess_FreeRunning.PpDR_Merges_10ms.DeDR_List.DR_List[15].delta_x CtApImageProcess_FreeRunning.PpDR_Merges_10ms.DeDR_List.DR_List[15].delta_y CtApImageProcess_FreeRunning.PpDR_Merges_10ms.DeDR_List.DR_List[15].delta_z CtApImageProcess_FreeRunning.PpDR_Merges_10ms.DeDR_List.DR_List[15].delta_yaw CtApImageProcess_FreeRunning.PpDR_Merges_10ms.DeDR_List.DR_List[15].belif CtApImageProcess_FreeRunning.PpDR_Merges_10ms.DeDR_List.DR_List[15].reserved_int CtApImageProcess_FreeRunning.PpDR_Merges_10ms.DeDR_List.DR_List[16].stHeader.Counter CtApImageProcess_FreeRunning.PpDR_Merges_10ms.DeDR_List.DR_List[16].stHeader.FrameID CtApImageProcess_FreeRunning.PpDR_Merges_10ms.DeDR_List.DR_List[16].stHeader.TimeStamp CtApImageProcess_FreeRunning.PpDR_Merges_10ms.DeDR_List.DR_List[16].count CtApImageProcess_FreeRunning.PpDR_Merges_10ms.DeDR_List.DR_List[16].time_sec CtApImageProcess_FreeRunning.PpDR_Merges_10ms.DeDR_List.DR_List[16].utm_x CtApImageProcess_FreeRunning.PpDR_Merges_10ms.DeDR_List.DR_List[16].utm_y CtApImageProcess_FreeRunning.PpDR_Merges_10ms.DeDR_List.DR_List[16].utm_z CtApImageProcess_FreeRunning.PpDR_Merges_10ms.DeDR_List.DR_List[16].heading CtApImageProcess_FreeRunning.PpDR_Merges_10ms.DeDR_List.DR_List[16].delta_x CtApImageProcess_FreeRunning.PpDR_Merges_10ms.DeDR_List.DR_List[16].delta_y CtApImageProcess_FreeRunning.PpDR_Merges_10ms.DeDR_List.DR_List[16].delta_z CtApImageProcess_FreeRunning.PpDR_Merges_10ms.DeDR_List.DR_List[16].delta_yaw CtApImageProcess_FreeRunning.PpDR_Merges_10ms.DeDR_List.DR_List[16].belif CtApImageProcess_FreeRunning.PpDR_Merges_10ms.DeDR_List.DR_List[16].reserved_int CtApImageProcess_FreeRunning.PpDR_Merges_10ms.DeDR_List.DR_List[17].stHeader.Counter CtApImageProcess_FreeRunning.PpDR_Merges_10ms.DeDR_List.DR_List[17].stHeader.FrameID CtApImageProcess_FreeRunning.PpDR_Merges_10ms.DeDR_List.DR_List[17].stHeader.TimeStamp CtApImageProcess_FreeRunning.PpDR_Merges_10ms.DeDR_List.DR_List[17].count CtApImageProcess_FreeRunning.PpDR_Merges_10ms.DeDR_List.DR_List[17].time_sec CtApImageProcess_FreeRunning.PpDR_Merges_10ms.DeDR_List.DR_List[17].utm_x CtApImageProcess_FreeRunning.PpDR_Merges_10ms.DeDR_List.DR_List[17].utm_y CtApImageProcess_FreeRunning.PpDR_Merges_10ms.DeDR_List.DR_List[17].utm_z CtApImageProcess_FreeRunning.PpDR_Merges_10ms.DeDR_List.DR_List[17].heading CtApImageProcess_FreeRunning.PpDR_Merges_10ms.DeDR_List.DR_List[17].delta_x CtApImageProcess_FreeRunning.PpDR_Merges_10ms.DeDR_List.DR_List[17].delta_y CtApImageProcess_FreeRunning.PpDR_Merges_10ms.DeDR_List.DR_List[17].delta_z CtApImageProcess_FreeRunning.PpDR_Merges_10ms.DeDR_List.DR_List[17].delta_yaw CtApImageProcess_FreeRunning.PpDR_Merges_10ms.DeDR_List.DR_List[17].belif CtApImageProcess_FreeRunning.PpDR_Merges_10ms.DeDR_List.DR_List[17].reserved_int CtApImageProcess_FreeRunning.PpDR_Merges_10ms.DeDR_List.DR_List[18].stHeader.Counter CtApImageProcess_FreeRunning.PpDR_Merges_10ms.DeDR_List.DR_List[18].stHeader.FrameID CtApImageProcess_FreeRunning.PpDR_Merges_10ms.DeDR_List.DR_List[18].stHeader.TimeStamp CtApImageProcess_FreeRunning.PpDR_Merges_10ms.DeDR_List.DR_List[18].count CtApImageProcess_FreeRunning.PpDR_Merges_10ms.DeDR_List.DR_List[18].time_sec CtApImageProcess_FreeRunning.PpDR_Merges_10ms.DeDR_List.DR_List[18].utm_x CtApImageProcess_FreeRunning.PpDR_Merges_10ms.DeDR_List.DR_List[18].utm_y CtApImageProcess_FreeRunning.PpDR_Merges_10ms.DeDR_List.DR_List[18].utm_z CtApImageProcess_FreeRunning.PpDR_Merges_10ms.DeDR_List.DR_List[18].heading CtApImageProcess_FreeRunning.PpDR_Merges_10ms.DeDR_List.DR_List[18].delta_x CtApImageProcess_FreeRunning.PpDR_Merges_10ms.DeDR_List.DR_List[18].delta_y CtApImageProcess_FreeRunning.PpDR_Merges_10ms.DeDR_List.DR_List[18].delta_z CtApImageProcess_FreeRunning.PpDR_Merges_10ms.DeDR_List.DR_List[18].delta_yaw CtApImageProcess_FreeRunning.PpDR_Merges_10ms.DeDR_List.DR_List[18].belif CtApImageProcess_FreeRunning.PpDR_Merges_10ms.DeDR_List.DR_List[18].reserved_int CtApImageProcess_FreeRunning.PpDR_Merges_10ms.DeDR_List.DR_List[19].stHeader.Counter CtApImageProcess_FreeRunning.PpDR_Merges_10ms.DeDR_List.DR_List[19].stHeader.FrameID /end REF_CHARACTERISTIC
/end GROUP
/begin RECORD_LAYOUT __UBYTE_S FNC_VALUES 1 UBYTE COLUMN_DIR DIRECT /end RECORD_LAYOUT
/begin RECORD_LAYOUT __UWORD_S FNC_VALUES 1 UWORD COLUMN_DIR DIRECT /end RECORD_LAYOUT
/begin RECORD_LAYOUT __ULONG_S FNC_VALUES 1 ULONG COLUMN_DIR DIRECT /end RECORD_LAYOUT
/begin RECORD_LAYOUT __SWORD_S FNC_VALUES 1 SWORD COLUMN_DIR DIRECT /end RECORD_LAYOUT
/begin RECORD_LAYOUT __SLONG_S FNC_VALUES 1 SLONG COLUMN_DIR DIRECT /end RECORD_LAYOUT
/begin RECORD_LAYOUT __FLOAT32_IEEE_S FNC_VALUES 1 FLOAT32_IEEE COLUMN_DIR DIRECT /end RECORD_LAYOUT
/begin RECORD_LAYOUT __FLOAT64_IEEE_S FNC_VALUES 1 FLOAT64_IEEE COLUMN_DIR DIRECT /end RECORD_LAYOUT
/end MODULE
/end PROJECT
