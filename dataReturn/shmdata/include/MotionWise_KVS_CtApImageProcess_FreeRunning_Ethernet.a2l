ASAP2_VERSION 1 61
/begin PROJECT MotionWise_PerformanceHost00_XCPonEthernet ""
/begin MODULE CPP ""
/begin MOD_COMMON "" BYTE_ORDER MSB_LAST ALIGNMENT_BYTE 1 ALIGNMENT_WORD 2 ALIGNMENT_LONG 4 ALIGNMENT_INT64 1 ALIGNMENT_FLOAT32_IEEE 4 ALIGNMENT_FLOAT64_IEEE 8 /end MOD_COMMON
/begin CHARACTERISTIC CtApImageProcess_FreeRunning.PpDR_Merges_10ms.DeDR_List.DR_List[106].time_sec "" VALUE 0x25524b8 __FLOAT64_IEEE_S 0 NO_COMPU_METHOD 0 3.402823e+38 ECU_ADDRESS_EXTENSION 0x80 /end CHARACTERISTIC
/begin CHARACTERISTIC CtApImageProcess_FreeRunning.PpDR_Merges_10ms.DeDR_List.DR_List[106].utm_x "" VALUE 0x25524c0 __FLOAT64_IEEE_S 0 NO_COMPU_METHOD 0 3.402823e+38 ECU_ADDRESS_EXTENSION 0x80 /end CHARACTERISTIC
/begin CHARACTERISTIC CtApImageProcess_FreeRunning.PpDR_Merges_10ms.DeDR_List.DR_List[106].utm_y "" VALUE 0x25524c8 __FLOAT64_IEEE_S 0 NO_COMPU_METHOD 0 3.402823e+38 ECU_ADDRESS_EXTENSION 0x80 /end CHARACTERISTIC
/begin CHARACTERISTIC CtApImageProcess_FreeRunning.PpDR_Merges_10ms.DeDR_List.DR_List[106].utm_z "" VALUE 0x25524d0 __FLOAT32_IEEE_S 0 NO_COMPU_METHOD 0 3.402823e+38 ECU_ADDRESS_EXTENSION 0x80 /end CHARACTERISTIC
/begin CHARACTERISTIC CtApImageProcess_FreeRunning.PpDR_Merges_10ms.DeDR_List.DR_List[106].heading "" VALUE 0x25524d4 __FLOAT32_IEEE_S 0 NO_COMPU_METHOD 0 3.402823e+38 ECU_ADDRESS_EXTENSION 0x80 /end CHARACTERISTIC
/begin CHARACTERISTIC CtApImageProcess_FreeRunning.PpDR_Merges_10ms.DeDR_List.DR_List[106].delta_x "" VALUE 0x25524d8 __FLOAT32_IEEE_S 0 NO_COMPU_METHOD 0 3.402823e+38 ECU_ADDRESS_EXTENSION 0x80 /end CHARACTERISTIC
/begin CHARACTERISTIC CtApImageProcess_FreeRunning.PpDR_Merges_10ms.DeDR_List.DR_List[106].delta_y "" VALUE 0x25524dc __FLOAT32_IEEE_S 0 NO_COMPU_METHOD 0 3.402823e+38 ECU_ADDRESS_EXTENSION 0x80 /end CHARACTERISTIC
/begin CHARACTERISTIC CtApImageProcess_FreeRunning.PpDR_Merges_10ms.DeDR_List.DR_List[106].delta_z "" VALUE 0x25524e0 __FLOAT32_IEEE_S 0 NO_COMPU_METHOD 0 3.402823e+38 ECU_ADDRESS_EXTENSION 0x80 /end CHARACTERISTIC
/begin CHARACTERISTIC CtApImageProcess_FreeRunning.PpDR_Merges_10ms.DeDR_List.DR_List[106].delta_yaw "" VALUE 0x25524e4 __FLOAT32_IEEE_S 0 NO_COMPU_METHOD 0 3.402823e+38 ECU_ADDRESS_EXTENSION 0x80 /end CHARACTERISTIC
/begin CHARACTERISTIC CtApImageProcess_FreeRunning.PpDR_Merges_10ms.DeDR_List.DR_List[106].belif "" VALUE 0x25524e8 __FLOAT32_IEEE_S 0 NO_COMPU_METHOD 0 3.402823e+38 ECU_ADDRESS_EXTENSION 0x80 /end CHARACTERISTIC
/begin CHARACTERISTIC CtApImageProcess_FreeRunning.PpDR_Merges_10ms.DeDR_List.DR_List[106].reserved_int "5 uint32 array" VAL_BLK 0x25524ec __ULONG_S 0 NO_COMPU_METHOD 0 4294967295 ECU_ADDRESS_EXTENSION 0x80 MATRIX_DIM 5 1 1 /end CHARACTERISTIC
/begin CHARACTERISTIC CtApImageProcess_FreeRunning.PpDR_Merges_10ms.DeDR_List.DR_List[107].stHeader.Counter "" VALUE 0x2552500 __UWORD_S 0 NO_COMPU_METHOD 0 65535 ECU_ADDRESS_EXTENSION 0x80 /end CHARACTERISTIC
/begin CHARACTERISTIC CtApImageProcess_FreeRunning.PpDR_Merges_10ms.DeDR_List.DR_List[107].stHeader.FrameID "" VALUE 0x2552502 __UBYTE_S 0 NO_COMPU_METHOD 0 255 ECU_ADDRESS_EXTENSION 0x80 /end CHARACTERISTIC
/begin CHARACTERISTIC CtApImageProcess_FreeRunning.PpDR_Merges_10ms.DeDR_List.DR_List[107].stHeader.TimeStamp "2 uint32 array" VAL_BLK 0x2552504 __ULONG_S 0 NO_COMPU_METHOD 0 4294967295 ECU_ADDRESS_EXTENSION 0x80 MATRIX_DIM 2 1 1 /end CHARACTERISTIC
/begin CHARACTERISTIC CtApImageProcess_FreeRunning.PpDR_Merges_10ms.DeDR_List.DR_List[107].count "" VALUE 0x255250c __UBYTE_S 0 NO_COMPU_METHOD 0 255 ECU_ADDRESS_EXTENSION 0x80 /end CHARACTERISTIC
/begin CHARACTERISTIC CtApImageProcess_FreeRunning.PpDR_Merges_10ms.DeDR_List.DR_List[107].time_sec "" VALUE 0x2552510 __FLOAT64_IEEE_S 0 NO_COMPU_METHOD 0 3.402823e+38 ECU_ADDRESS_EXTENSION 0x80 /end CHARACTERISTIC
/begin CHARACTERISTIC CtApImageProcess_FreeRunning.PpDR_Merges_10ms.DeDR_List.DR_List[107].utm_x "" VALUE 0x2552518 __FLOAT64_IEEE_S 0 NO_COMPU_METHOD 0 3.402823e+38 ECU_ADDRESS_EXTENSION 0x80 /end CHARACTERISTIC
/begin CHARACTERISTIC CtApImageProcess_FreeRunning.PpDR_Merges_10ms.DeDR_List.DR_List[107].utm_y "" VALUE 0x2552520 __FLOAT64_IEEE_S 0 NO_COMPU_METHOD 0 3.402823e+38 ECU_ADDRESS_EXTENSION 0x80 /end CHARACTERISTIC
/begin CHARACTERISTIC CtApImageProcess_FreeRunning.PpDR_Merges_10ms.DeDR_List.DR_List[107].utm_z "" VALUE 0x2552528 __FLOAT32_IEEE_S 0 NO_COMPU_METHOD 0 3.402823e+38 ECU_ADDRESS_EXTENSION 0x80 /end CHARACTERISTIC
/begin CHARACTERISTIC CtApImageProcess_FreeRunning.PpDR_Merges_10ms.DeDR_List.DR_List[107].heading "" VALUE 0x255252c __FLOAT32_IEEE_S 0 NO_COMPU_METHOD 0 3.402823e+38 ECU_ADDRESS_EXTENSION 0x80 /end CHARACTERISTIC
/begin CHARACTERISTIC CtApImageProcess_FreeRunning.PpDR_Merges_10ms.DeDR_List.DR_List[107].delta_x "" VALUE 0x2552530 __FLOAT32_IEEE_S 0 NO_COMPU_METHOD 0 3.402823e+38 ECU_ADDRESS_EXTENSION 0x80 /end CHARACTERISTIC
/begin CHARACTERISTIC CtApImageProcess_FreeRunning.PpDR_Merges_10ms.DeDR_List.DR_List[107].delta_y "" VALUE 0x2552534 __FLOAT32_IEEE_S 0 NO_COMPU_METHOD 0 3.402823e+38 ECU_ADDRESS_EXTENSION 0x80 /end CHARACTERISTIC
/begin CHARACTERISTIC CtApImageProcess_FreeRunning.PpDR_Merges_10ms.DeDR_List.DR_List[107].delta_z "" VALUE 0x2552538 __FLOAT32_IEEE_S 0 NO_COMPU_METHOD 0 3.402823e+38 ECU_ADDRESS_EXTENSION 0x80 /end CHARACTERISTIC
/begin CHARACTERISTIC CtApImageProcess_FreeRunning.PpDR_Merges_10ms.DeDR_List.DR_List[107].delta_yaw "" VALUE 0x255253c __FLOAT32_IEEE_S 0 NO_COMPU_METHOD 0 3.402823e+38 ECU_ADDRESS_EXTENSION 0x80 /end CHARACTERISTIC
/begin CHARACTERISTIC CtApImageProcess_FreeRunning.PpDR_Merges_10ms.DeDR_List.DR_List[107].belif "" VALUE 0x2552540 __FLOAT32_IEEE_S 0 NO_COMPU_METHOD 0 3.402823e+38 ECU_ADDRESS_EXTENSION 0x80 /end CHARACTERISTIC
/begin CHARACTERISTIC CtApImageProcess_FreeRunning.PpDR_Merges_10ms.DeDR_List.DR_List[107].reserved_int "5 uint32 array" VAL_BLK 0x2552544 __ULONG_S 0 NO_COMPU_METHOD 0 4294967295 ECU_ADDRESS_EXTENSION 0x80 MATRIX_DIM 5 1 1 /end CHARACTERISTIC
/begin CHARACTERISTIC CtApImageProcess_FreeRunning.PpDR_Merges_10ms.DeDR_List.DR_List[108].stHeader.Counter "" VALUE 0x2552558 __UWORD_S 0 NO_COMPU_METHOD 0 65535 ECU_ADDRESS_EXTENSION 0x80 /end CHARACTERISTIC
/begin CHARACTERISTIC CtApImageProcess_FreeRunning.PpDR_Merges_10ms.DeDR_List.DR_List[108].stHeader.FrameID "" VALUE 0x255255a __UBYTE_S 0 NO_COMPU_METHOD 0 255 ECU_ADDRESS_EXTENSION 0x80 /end CHARACTERISTIC
/begin CHARACTERISTIC CtApImageProcess_FreeRunning.PpDR_Merges_10ms.DeDR_List.DR_List[108].stHeader.TimeStamp "2 uint32 array" VAL_BLK 0x255255c __ULONG_S 0 NO_COMPU_METHOD 0 4294967295 ECU_ADDRESS_EXTENSION 0x80 MATRIX_DIM 2 1 1 /end CHARACTERISTIC
/begin CHARACTERISTIC CtApImageProcess_FreeRunning.PpDR_Merges_10ms.DeDR_List.DR_List[108].count "" VALUE 0x2552564 __UBYTE_S 0 NO_COMPU_METHOD 0 255 ECU_ADDRESS_EXTENSION 0x80 /end CHARACTERISTIC
/begin CHARACTERISTIC CtApImageProcess_FreeRunning.PpDR_Merges_10ms.DeDR_List.DR_List[108].time_sec "" VALUE 0x2552568 __FLOAT64_IEEE_S 0 NO_COMPU_METHOD 0 3.402823e+38 ECU_ADDRESS_EXTENSION 0x80 /end CHARACTERISTIC
/begin CHARACTERISTIC CtApImageProcess_FreeRunning.PpDR_Merges_10ms.DeDR_List.DR_List[108].utm_x "" VALUE 0x2552570 __FLOAT64_IEEE_S 0 NO_COMPU_METHOD 0 3.402823e+38 ECU_ADDRESS_EXTENSION 0x80 /end CHARACTERISTIC
/begin CHARACTERISTIC CtApImageProcess_FreeRunning.PpDR_Merges_10ms.DeDR_List.DR_List[108].utm_y "" VALUE 0x2552578 __FLOAT64_IEEE_S 0 NO_COMPU_METHOD 0 3.402823e+38 ECU_ADDRESS_EXTENSION 0x80 /end CHARACTERISTIC
/begin CHARACTERISTIC CtApImageProcess_FreeRunning.PpDR_Merges_10ms.DeDR_List.DR_List[108].utm_z "" VALUE 0x2552580 __FLOAT32_IEEE_S 0 NO_COMPU_METHOD 0 3.402823e+38 ECU_ADDRESS_EXTENSION 0x80 /end CHARACTERISTIC
/begin CHARACTERISTIC CtApImageProcess_FreeRunning.PpDR_Merges_10ms.DeDR_List.DR_List[108].heading "" VALUE 0x2552584 __FLOAT32_IEEE_S 0 NO_COMPU_METHOD 0 3.402823e+38 ECU_ADDRESS_EXTENSION 0x80 /end CHARACTERISTIC
/begin CHARACTERISTIC CtApImageProcess_FreeRunning.PpDR_Merges_10ms.DeDR_List.DR_List[108].delta_x "" VALUE 0x2552588 __FLOAT32_IEEE_S 0 NO_COMPU_METHOD 0 3.402823e+38 ECU_ADDRESS_EXTENSION 0x80 /end CHARACTERISTIC
/begin CHARACTERISTIC CtApImageProcess_FreeRunning.PpDR_Merges_10ms.DeDR_List.DR_List[108].delta_y "" VALUE 0x255258c __FLOAT32_IEEE_S 0 NO_COMPU_METHOD 0 3.402823e+38 ECU_ADDRESS_EXTENSION 0x80 /end CHARACTERISTIC
/begin CHARACTERISTIC CtApImageProcess_FreeRunning.PpDR_Merges_10ms.DeDR_List.DR_List[108].delta_z "" VALUE 0x2552590 __FLOAT32_IEEE_S 0 NO_COMPU_METHOD 0 3.402823e+38 ECU_ADDRESS_EXTENSION 0x80 /end CHARACTERISTIC
/begin CHARACTERISTIC CtApImageProcess_FreeRunning.PpDR_Merges_10ms.DeDR_List.DR_List[108].delta_yaw "" VALUE 0x2552594 __FLOAT32_IEEE_S 0 NO_COMPU_METHOD 0 3.402823e+38 ECU_ADDRESS_EXTENSION 0x80 /end CHARACTERISTIC
/begin CHARACTERISTIC CtApImageProcess_FreeRunning.PpDR_Merges_10ms.DeDR_List.DR_List[108].belif "" VALUE 0x2552598 __FLOAT32_IEEE_S 0 NO_COMPU_METHOD 0 3.402823e+38 ECU_ADDRESS_EXTENSION 0x80 /end CHARACTERISTIC
/begin CHARACTERISTIC CtApImageProcess_FreeRunning.PpDR_Merges_10ms.DeDR_List.DR_List[108].reserved_int "5 uint32 array" VAL_BLK 0x255259c __ULONG_S 0 NO_COMPU_METHOD 0 4294967295 ECU_ADDRESS_EXTENSION 0x80 MATRIX_DIM 5 1 1 /end CHARACTERISTIC
/begin CHARACTERISTIC CtApImageProcess_FreeRunning.PpDR_Merges_10ms.DeDR_List.DR_List[109].stHeader.Counter "" VALUE 0x25525b0 __UWORD_S 0 NO_COMPU_METHOD 0 65535 ECU_ADDRESS_EXTENSION 0x80 /end CHARACTERISTIC
/begin CHARACTERISTIC CtApImageProcess_FreeRunning.PpDR_Merges_10ms.DeDR_List.DR_List[109].stHeader.FrameID "" VALUE 0x25525b2 __UBYTE_S 0 NO_COMPU_METHOD 0 255 ECU_ADDRESS_EXTENSION 0x80 /end CHARACTERISTIC
/begin CHARACTERISTIC CtApImageProcess_FreeRunning.PpDR_Merges_10ms.DeDR_List.DR_List[109].stHeader.TimeStamp "2 uint32 array" VAL_BLK 0x25525b4 __ULONG_S 0 NO_COMPU_METHOD 0 4294967295 ECU_ADDRESS_EXTENSION 0x80 MATRIX_DIM 2 1 1 /end CHARACTERISTIC
/begin CHARACTERISTIC CtApImageProcess_FreeRunning.PpDR_Merges_10ms.DeDR_List.DR_List[109].count "" VALUE 0x25525bc __UBYTE_S 0 NO_COMPU_METHOD 0 255 ECU_ADDRESS_EXTENSION 0x80 /end CHARACTERISTIC
/begin CHARACTERISTIC CtApImageProcess_FreeRunning.PpDR_Merges_10ms.DeDR_List.DR_List[109].time_sec "" VALUE 0x25525c0 __FLOAT64_IEEE_S 0 NO_COMPU_METHOD 0 3.402823e+38 ECU_ADDRESS_EXTENSION 0x80 /end CHARACTERISTIC
/begin CHARACTERISTIC CtApImageProcess_FreeRunning.PpDR_Merges_10ms.DeDR_List.DR_List[109].utm_x "" VALUE 0x25525c8 __FLOAT64_IEEE_S 0 NO_COMPU_METHOD 0 3.402823e+38 ECU_ADDRESS_EXTENSION 0x80 /end CHARACTERISTIC
/begin CHARACTERISTIC CtApImageProcess_FreeRunning.PpDR_Merges_10ms.DeDR_List.DR_List[109].utm_y "" VALUE 0x25525d0 __FLOAT64_IEEE_S 0 NO_COMPU_METHOD 0 3.402823e+38 ECU_ADDRESS_EXTENSION 0x80 /end CHARACTERISTIC
/begin CHARACTERISTIC CtApImageProcess_FreeRunning.PpDR_Merges_10ms.DeDR_List.DR_List[109].utm_z "" VALUE 0x25525d8 __FLOAT32_IEEE_S 0 NO_COMPU_METHOD 0 3.402823e+38 ECU_ADDRESS_EXTENSION 0x80 /end CHARACTERISTIC
/begin CHARACTERISTIC CtApImageProcess_FreeRunning.PpDR_Merges_10ms.DeDR_List.DR_List[109].heading "" VALUE 0x25525dc __FLOAT32_IEEE_S 0 NO_COMPU_METHOD 0 3.402823e+38 ECU_ADDRESS_EXTENSION 0x80 /end CHARACTERISTIC
/begin CHARACTERISTIC CtApImageProcess_FreeRunning.PpDR_Merges_10ms.DeDR_List.DR_List[109].delta_x "" VALUE 0x25525e0 __FLOAT32_IEEE_S 0 NO_COMPU_METHOD 0 3.402823e+38 ECU_ADDRESS_EXTENSION 0x80 /end CHARACTERISTIC
/begin CHARACTERISTIC CtApImageProcess_FreeRunning.PpDR_Merges_10ms.DeDR_List.DR_List[109].delta_y "" VALUE 0x25525e4 __FLOAT32_IEEE_S 0 NO_COMPU_METHOD 0 3.402823e+38 ECU_ADDRESS_EXTENSION 0x80 /end CHARACTERISTIC
/begin CHARACTERISTIC CtApImageProcess_FreeRunning.PpDR_Merges_10ms.DeDR_List.DR_List[109].delta_z "" VALUE 0x25525e8 __FLOAT32_IEEE_S 0 NO_COMPU_METHOD 0 3.402823e+38 ECU_ADDRESS_EXTENSION 0x80 /end CHARACTERISTIC
/begin CHARACTERISTIC CtApImageProcess_FreeRunning.PpDR_Merges_10ms.DeDR_List.DR_List[109].delta_yaw "" VALUE 0x25525ec __FLOAT32_IEEE_S 0 NO_COMPU_METHOD 0 3.402823e+38 ECU_ADDRESS_EXTENSION 0x80 /end CHARACTERISTIC
/begin CHARACTERISTIC CtApImageProcess_FreeRunning.PpDR_Merges_10ms.DeDR_List.DR_List[109].belif "" VALUE 0x25525f0 __FLOAT32_IEEE_S 0 NO_COMPU_METHOD 0 3.402823e+38 ECU_ADDRESS_EXTENSION 0x80 /end CHARACTERISTIC
/begin CHARACTERISTIC CtApImageProcess_FreeRunning.PpDR_Merges_10ms.DeDR_List.DR_List[109].reserved_int "5 uint32 array" VAL_BLK 0x25525f4 __ULONG_S 0 NO_COMPU_METHOD 0 4294967295 ECU_ADDRESS_EXTENSION 0x80 MATRIX_DIM 5 1 1 /end CHARACTERISTIC
/begin CHARACTERISTIC CtApImageProcess_FreeRunning.PpDsImageProcessDataSet.DeADASDecisionDS.DeStatus "" VALUE 0x2560000 __UWORD_S 0 CtApImageProcess_FreeRunning.PpDsImageProcessDataSet.DeADASDecisionDS.DeStatus.Dt_ENUM_PdDatablockStatus.CONVERSION 0 65535 ECU_ADDRESS_EXTENSION 0x80 /end CHARACTERISTIC
/begin CHARACTERISTIC CtApImageProcess_FreeRunning.PpDsImageProcessDataSet.DeADASDecisionDS.DeVersion.DeExpectedVersion.DeMajor "" VALUE 0x2560004 __UBYTE_S 0 NO_COMPU_METHOD 0 255 ECU_ADDRESS_EXTENSION 0x80 /end CHARACTERISTIC
/begin CHARACTERISTIC CtApImageProcess_FreeRunning.PpDsImageProcessDataSet.DeADASDecisionDS.DeVersion.DeExpectedVersion.DeMinor "" VALUE 0x2560005 __UBYTE_S 0 NO_COMPU_METHOD 0 255 ECU_ADDRESS_EXTENSION 0x80 /end CHARACTERISTIC
/begin CHARACTERISTIC CtApImageProcess_FreeRunning.PpDsImageProcessDataSet.DeADASDecisionDS.DeVersion.DeVersion.DeMajor "" VALUE 0x2560008 __UBYTE_S 0 NO_COMPU_METHOD 0 255 ECU_ADDRESS_EXTENSION 0x80 /end CHARACTERISTIC
/begin CHARACTERISTIC CtApImageProcess_FreeRunning.PpDsImageProcessDataSet.DeADASDecisionDS.DeVersion.DeVersion.DeMinor "" VALUE 0x2560009 __UBYTE_S 0 NO_COMPU_METHOD 0 255 ECU_ADDRESS_EXTENSION 0x80 /end CHARACTERISTIC
/begin CHARACTERISTIC CtApImageProcess_FreeRunning.PpDsImageProcessDataSet.DeADASDecisionDS.DeData.data "128 uint8 array" VAL_BLK 0x256000c __UBYTE_S 0 NO_COMPU_METHOD 0 255 ECU_ADDRESS_EXTENSION 0x80 MATRIX_DIM 128 1 1 /end CHARACTERISTIC
/begin CHARACTERISTIC CtApImageProcess_FreeRunning.PpEcuSerialNumber.DeEcuSerialNumber "16 uint8 array" VAL_BLK 0x2570000 __UBYTE_S 0 NO_COMPU_METHOD 0 255 ECU_ADDRESS_EXTENSION 0x80 MATRIX_DIM 16 1 1 /end CHARACTERISTIC
/begin CHARACTERISTIC CtApImageProcess_FreeRunning.PpEthernetCom_AVCameraDirt_100ms.DeAVCameraDirt.stHeader.Counter "" VALUE 0x2580000 __UWORD_S 0 NO_COMPU_METHOD 0 65535 ECU_ADDRESS_EXTENSION 0x80 /end CHARACTERISTIC
/begin CHARACTERISTIC CtApImageProcess_FreeRunning.PpEthernetCom_AVCameraDirt_100ms.DeAVCameraDirt.stHeader.FrameID "" VALUE 0x2580002 __UBYTE_S 0 NO_COMPU_METHOD 0 255 ECU_ADDRESS_EXTENSION 0x80 /end CHARACTERISTIC
/begin CHARACTERISTIC CtApImageProcess_FreeRunning.PpEthernetCom_AVCameraDirt_100ms.DeAVCameraDirt.stHeader.TimeStamp "2 uint32 array" VAL_BLK 0x2580004 __ULONG_S 0 NO_COMPU_METHOD 0 4294967295 ECU_ADDRESS_EXTENSION 0x80 MATRIX_DIM 2 1 1 /end CHARACTERISTIC
/begin CHARACTERISTIC CtApImageProcess_FreeRunning.PpEthernetCom_AVCameraDirt_100ms.DeAVCameraDirt.AVCameraDirt "" VALUE 0x258000c __UBYTE_S 0 NO_COMPU_METHOD 0 255 ECU_ADDRESS_EXTENSION 0x80 /end CHARACTERISTIC
/begin CHARACTERISTIC CtApImageProcess_FreeRunning.PpEthernetCom_AVData_Upload_Status_300ms.DeAVData_Upload_Status.stHeader.Counter "" VALUE 0x2590000 __UWORD_S 0 NO_COMPU_METHOD 0 65535 ECU_ADDRESS_EXTENSION 0x80 /end CHARACTERISTIC
/begin CHARACTERISTIC CtApImageProcess_FreeRunning.PpEthernetCom_AVData_Upload_Status_300ms.DeAVData_Upload_Status.stHeader.FrameID "" VALUE 0x2590002 __UBYTE_S 0 NO_COMPU_METHOD 0 255 ECU_ADDRESS_EXTENSION 0x80 /end CHARACTERISTIC
/begin CHARACTERISTIC CtApImageProcess_FreeRunning.PpEthernetCom_AVData_Upload_Status_300ms.DeAVData_Upload_Status.stHeader.TimeStamp "2 uint32 array" VAL_BLK 0x2590004 __ULONG_S 0 NO_COMPU_METHOD 0 4294967295 ECU_ADDRESS_EXTENSION 0x80 MATRIX_DIM 2 1 1 /end CHARACTERISTIC
/begin CHARACTERISTIC CtApImageProcess_FreeRunning.PpEthernetCom_AVData_Upload_Status_300ms.DeAVData_Upload_Status.AVData_Upload_Status "" VALUE 0x259000c __UBYTE_S 0 NO_COMPU_METHOD 0 255 ECU_ADDRESS_EXTENSION 0x80 /end CHARACTERISTIC
/begin CHARACTERISTIC CtApImageProcess_FreeRunning.PpEyeQCom2ImageProcess_FreeRunning_300ms.DeEyeQ2ImageProcess.RSD_Message_reserved "" VALUE 0x25a0000 __UBYTE_S 0 NO_COMPU_METHOD 0 255 ECU_ADDRESS_EXTENSION 0x80 /end CHARACTERISTIC
/begin CHARACTERISTIC CtApImageProcess_FreeRunning.PpEyeQCom2ImageProcess_FreeRunning_300ms.DeEyeQ2ImageProcess.Zero_byte "" VALUE 0x25a0001 __UBYTE_S 0 NO_COMPU_METHOD 0 255 ECU_ADDRESS_EXTENSION 0x80 /end CHARACTERISTIC
/begin CHARACTERISTIC CtApImageProcess_FreeRunning.PpEyeQCom2ImageProcess_FreeRunning_300ms.DeEyeQ2ImageProcess.RSD_message_Version "" VALUE 0x25a0002 __UBYTE_S 0 NO_COMPU_METHOD 0 255 ECU_ADDRESS_EXTENSION 0x80 /end CHARACTERISTIC
/begin CHARACTERISTIC CtApImageProcess_FreeRunning.PpEyeQCom2ImageProcess_FreeRunning_300ms.DeEyeQ2ImageProcess.RSD_Sync_ID "" VALUE 0x25a0003 __UBYTE_S 0 NO_COMPU_METHOD 0 255 ECU_ADDRESS_EXTENSION 0x80 /end CHARACTERISTIC
/begin CHARACTERISTIC CtApImageProcess_FreeRunning.PpEyeQCom2ImageProcess_FreeRunning_300ms.DeEyeQ2ImageProcess.RSD_Payload_Byte_0 "" VALUE 0x25a0004 __UBYTE_S 0 NO_COMPU_METHOD 0 255 ECU_ADDRESS_EXTENSION 0x80 /end CHARACTERISTIC
/begin CHARACTERISTIC CtApImageProcess_FreeRunning.PpEyeQCom2ImageProcess_FreeRunning_300ms.DeEyeQ2ImageProcess.RSD_Payload_Byte_1 "" VALUE 0x25a0005 __UBYTE_S 0 NO_COMPU_METHOD 0 255 ECU_ADDRESS_EXTENSION 0x80 /end CHARACTERISTIC
/begin CHARACTERISTIC CtApImageProcess_FreeRunning.PpEyeQCom2ImageProcess_FreeRunning_300ms.DeEyeQ2ImageProcess.RSD_Payload_Byte_2 "" VALUE 0x25a0006 __UBYTE_S 0 NO_COMPU_METHOD 0 255 ECU_ADDRESS_EXTENSION 0x80 /end CHARACTERISTIC
/begin CHARACTERISTIC CtApImageProcess_FreeRunning.PpEyeQCom2ImageProcess_FreeRunning_300ms.DeEyeQ2ImageProcess.RSD_Payload_Byte_3 "" VALUE 0x25a0007 __UBYTE_S 0 NO_COMPU_METHOD 0 255 ECU_ADDRESS_EXTENSION 0x80 /end CHARACTERISTIC
/begin CHARACTERISTIC CtApImageProcess_FreeRunning.PpEyeQCom2ImageProcess_FreeRunning_300ms.DeEyeQ2ImageProcess.RSD_Payload_Byte_4 "" VALUE 0x25a0008 __UBYTE_S 0 NO_COMPU_METHOD 0 255 ECU_ADDRESS_EXTENSION 0x80 /end CHARACTERISTIC
/begin CHARACTERISTIC CtApImageProcess_FreeRunning.PpEyeQCom2ImageProcess_FreeRunning_300ms.DeEyeQ2ImageProcess.RSD_Payload_Byte_5 "" VALUE 0x25a0009 __UBYTE_S 0 NO_COMPU_METHOD 0 255 ECU_ADDRESS_EXTENSION 0x80 /end CHARACTERISTIC
/begin CHARACTERISTIC CtApImageProcess_FreeRunning.PpEyeQCom2ImageProcess_FreeRunning_300ms.DeEyeQ2ImageProcess.RSD_Payload_Byte_6 "" VALUE 0x25a000a __UBYTE_S 0 NO_COMPU_METHOD 0 255 ECU_ADDRESS_EXTENSION 0x80 /end CHARACTERISTIC
/begin CHARACTERISTIC CtApImageProcess_FreeRunning.PpEyeQCom2ImageProcess_FreeRunning_300ms.DeEyeQ2ImageProcess.RSD_Payload_Byte_7 "" VALUE 0x25a000b __UBYTE_S 0 NO_COMPU_METHOD 0 255 ECU_ADDRESS_EXTENSION 0x80 /end CHARACTERISTIC
/begin CHARACTERISTIC CtApImageProcess_FreeRunning.PpEyeQCom2ImageProcess_FreeRunning_300ms.DeEyeQ2ImageProcess.RSD_Payload_Byte_8 "" VALUE 0x25a000c __UBYTE_S 0 NO_COMPU_METHOD 0 255 ECU_ADDRESS_EXTENSION 0x80 /end CHARACTERISTIC
/begin CHARACTERISTIC CtApImageProcess_FreeRunning.PpEyeQCom2ImageProcess_FreeRunning_300ms.DeEyeQ2ImageProcess.RSD_Payload_Byte_9 "" VALUE 0x25a000d __UBYTE_S 0 NO_COMPU_METHOD 0 255 ECU_ADDRESS_EXTENSION 0x80 /end CHARACTERISTIC
/begin CHARACTERISTIC CtApImageProcess_FreeRunning.PpEyeQCom2ImageProcess_FreeRunning_300ms.DeEyeQ2ImageProcess.RSD_Payload_Byte_10 "" VALUE 0x25a000e __UBYTE_S 0 NO_COMPU_METHOD 0 255 ECU_ADDRESS_EXTENSION 0x80 /end CHARACTERISTIC
/begin CHARACTERISTIC CtApImageProcess_FreeRunning.PpEyeQCom2ImageProcess_FreeRunning_300ms.DeEyeQ2ImageProcess.RSD_Payload_Byte_11 "" VALUE 0x25a000f __UBYTE_S 0 NO_COMPU_METHOD 0 255 ECU_ADDRESS_EXTENSION 0x80 /end CHARACTERISTIC
/begin CHARACTERISTIC CtApImageProcess_FreeRunning.PpEyeQCom2ImageProcess_FreeRunning_300ms.DeEyeQ2ImageProcess.RSD_Payload_Byte_12 "" VALUE 0x25a0010 __UBYTE_S 0 NO_COMPU_METHOD 0 255 ECU_ADDRESS_EXTENSION 0x80 /end CHARACTERISTIC
/begin CHARACTERISTIC CtApImageProcess_FreeRunning.PpEyeQCom2ImageProcess_FreeRunning_300ms.DeEyeQ2ImageProcess.RSD_Payload_Byte_13 "" VALUE 0x25a0011 __UBYTE_S 0 NO_COMPU_METHOD 0 255 ECU_ADDRESS_EXTENSION 0x80 /end CHARACTERISTIC
/begin CHARACTERISTIC CtApImageProcess_FreeRunning.PpEyeQCom2ImageProcess_FreeRunning_300ms.DeEyeQ2ImageProcess.RSD_Payload_Byte_14 "" VALUE 0x25a0012 __UBYTE_S 0 NO_COMPU_METHOD 0 255 ECU_ADDRESS_EXTENSION 0x80 /end CHARACTERISTIC
/begin CHARACTERISTIC CtApImageProcess_FreeRunning.PpEyeQCom2ImageProcess_FreeRunning_300ms.DeEyeQ2ImageProcess.RSD_Payload_Byte_15 "" VALUE 0x25a0013 __UBYTE_S 0 NO_COMPU_METHOD 0 255 ECU_ADDRESS_EXTENSION 0x80 /end CHARACTERISTIC
/begin CHARACTERISTIC CtApImageProcess_FreeRunning.PpEyeQCom2ImageProcess_FreeRunning_300ms.DeEyeQ2ImageProcess.RSD_Payload_Byte_16 "" VALUE 0x25a0014 __UBYTE_S 0 NO_COMPU_METHOD 0 255 ECU_ADDRESS_EXTENSION 0x80 /end CHARACTERISTIC
/begin CHARACTERISTIC CtApImageProcess_FreeRunning.PpEyeQCom2ImageProcess_FreeRunning_300ms.DeEyeQ2ImageProcess.RSD_Payload_Byte_17 "" VALUE 0x25a0015 __UBYTE_S 0 NO_COMPU_METHOD 0 255 ECU_ADDRESS_EXTENSION 0x80 /end CHARACTERISTIC
/begin CHARACTERISTIC CtApImageProcess_FreeRunning.PpEyeQCom2ImageProcess_FreeRunning_300ms.DeEyeQ2ImageProcess.RSD_Payload_Byte_18 "" VALUE 0x25a0016 __UBYTE_S 0 NO_COMPU_METHOD 0 255 ECU_ADDRESS_EXTENSION 0x80 /end CHARACTERISTIC
/begin CHARACTERISTIC CtApImageProcess_FreeRunning.PpEyeQCom2ImageProcess_FreeRunning_300ms.DeEyeQ2ImageProcess.RSD_Payload_Byte_19 "" VALUE 0x25a0017 __UBYTE_S 0 NO_COMPU_METHOD 0 255 ECU_ADDRESS_EXTENSION 0x80 /end CHARACTERISTIC
/begin CHARACTERISTIC CtApImageProcess_FreeRunning.PpEyeQCom2ImageProcess_FreeRunning_300ms.DeEyeQ2ImageProcess.RSD_Payload_Byte_20 "" VALUE 0x25a0018 __UBYTE_S 0 NO_COMPU_METHOD 0 255 ECU_ADDRESS_EXTENSION 0x80 /end CHARACTERISTIC
/begin CHARACTERISTIC CtApImageProcess_FreeRunning.PpEyeQCom2ImageProcess_FreeRunning_300ms.DeEyeQ2ImageProcess.RSD_Payload_Byte_21 "" VALUE 0x25a0019 __UBYTE_S 0 NO_COMPU_METHOD 0 255 ECU_ADDRESS_EXTENSION 0x80 /end CHARACTERISTIC
/begin CHARACTERISTIC CtApImageProcess_FreeRunning.PpEyeQCom2ImageProcess_FreeRunning_300ms.DeEyeQ2ImageProcess.RSD_Payload_Byte_22 "" VALUE 0x25a001a __UBYTE_S 0 NO_COMPU_METHOD 0 255 ECU_ADDRESS_EXTENSION 0x80 /end CHARACTERISTIC
/begin CHARACTERISTIC CtApImageProcess_FreeRunning.PpEyeQCom2ImageProcess_FreeRunning_300ms.DeEyeQ2ImageProcess.RSD_Payload_Byte_23 "" VALUE 0x25a001b __UBYTE_S 0 NO_COMPU_METHOD 0 255 ECU_ADDRESS_EXTENSION 0x80 /end CHARACTERISTIC
/begin CHARACTERISTIC CtApImageProcess_FreeRunning.PpEyeQCom2ImageProcess_FreeRunning_300ms.DeEyeQ2ImageProcess.RSD_Payload_Byte_24 "" VALUE 0x25a001c __UBYTE_S 0 NO_COMPU_METHOD 0 255 ECU_ADDRESS_EXTENSION 0x80 /end CHARACTERISTIC
/begin CHARACTERISTIC CtApImageProcess_FreeRunning.PpEyeQCom2ImageProcess_FreeRunning_300ms.DeEyeQ2ImageProcess.RSD_Payload_Byte_25 "" VALUE 0x25a001d __UBYTE_S 0 NO_COMPU_METHOD 0 255 ECU_ADDRESS_EXTENSION 0x80 /end CHARACTERISTIC
/begin CHARACTERISTIC CtApImageProcess_FreeRunning.PpEyeQCom2ImageProcess_FreeRunning_300ms.DeEyeQ2ImageProcess.RSD_Payload_Byte_26 "" VALUE 0x25a001e __UBYTE_S 0 NO_COMPU_METHOD 0 255 ECU_ADDRESS_EXTENSION 0x80 /end CHARACTERISTIC
/begin CHARACTERISTIC CtApImageProcess_FreeRunning.PpEyeQCom2ImageProcess_FreeRunning_300ms.DeEyeQ2ImageProcess.RSD_Payload_Byte_27 "" VALUE 0x25a001f __UBYTE_S 0 NO_COMPU_METHOD 0 255 ECU_ADDRESS_EXTENSION 0x80 /end CHARACTERISTIC
/begin CHARACTERISTIC CtApImageProcess_FreeRunning.PpEyeQCom2ImageProcess_FreeRunning_300ms.DeEyeQ2ImageProcess.RSD_Payload_Byte_28 "" VALUE 0x25a0020 __UBYTE_S 0 NO_COMPU_METHOD 0 255 ECU_ADDRESS_EXTENSION 0x80 /end CHARACTERISTIC
/begin CHARACTERISTIC CtApImageProcess_FreeRunning.PpEyeQCom2ImageProcess_FreeRunning_300ms.DeEyeQ2ImageProcess.RSD_Payload_Byte_29 "" VALUE 0x25a0021 __UBYTE_S 0 NO_COMPU_METHOD 0 255 ECU_ADDRESS_EXTENSION 0x80 /end CHARACTERISTIC
/begin CHARACTERISTIC CtApImageProcess_FreeRunning.PpEyeQCom2ImageProcess_FreeRunning_300ms.DeEyeQ2ImageProcess.RSD_Payload_Byte_30 "" VALUE 0x25a0022 __UBYTE_S 0 NO_COMPU_METHOD 0 255 ECU_ADDRESS_EXTENSION 0x80 /end CHARACTERISTIC
/begin CHARACTERISTIC CtApImageProcess_FreeRunning.PpEyeQCom2ImageProcess_FreeRunning_300ms.DeEyeQ2ImageProcess.RSD_Payload_Byte_31 "" VALUE 0x25a0023 __UBYTE_S 0 NO_COMPU_METHOD 0 255 ECU_ADDRESS_EXTENSION 0x80 /end CHARACTERISTIC
/begin CHARACTERISTIC CtApImageProcess_FreeRunning.PpEyeQCom2ImageProcess_FreeRunning_300ms.DeEyeQ2ImageProcess.RSD_Payload_Byte_32 "" VALUE 0x25a0024 __UBYTE_S 0 NO_COMPU_METHOD 0 255 ECU_ADDRESS_EXTENSION 0x80 /end CHARACTERISTIC
/begin CHARACTERISTIC CtApImageProcess_FreeRunning.PpEyeQCom2ImageProcess_FreeRunning_300ms.DeEyeQ2ImageProcess.RSD_Payload_Byte_33 "" VALUE 0x25a0025 __UBYTE_S 0 NO_COMPU_METHOD 0 255 ECU_ADDRESS_EXTENSION 0x80 /end CHARACTERISTIC
/begin CHARACTERISTIC CtApImageProcess_FreeRunning.PpEyeQCom2ImageProcess_FreeRunning_300ms.DeEyeQ2ImageProcess.RSD_Payload_Byte_34 "" VALUE 0x25a0026 __UBYTE_S 0 NO_COMPU_METHOD 0 255 ECU_ADDRESS_EXTENSION 0x80 /end CHARACTERISTIC
/begin CHARACTERISTIC CtApImageProcess_FreeRunning.PpEyeQCom2ImageProcess_FreeRunning_300ms.DeEyeQ2ImageProcess.RSD_Payload_Byte_35 "" VALUE 0x25a0027 __UBYTE_S 0 NO_COMPU_METHOD 0 255 ECU_ADDRESS_EXTENSION 0x80 /end CHARACTERISTIC
/begin CHARACTERISTIC CtApImageProcess_FreeRunning.PpEyeQCom2ImageProcess_FreeRunning_300ms.DeEyeQ2ImageProcess.RSD_Payload_Byte_36 "" VALUE 0x25a0028 __UBYTE_S 0 NO_COMPU_METHOD 0 255 ECU_ADDRESS_EXTENSION 0x80 /end CHARACTERISTIC
/begin CHARACTERISTIC CtApImageProcess_FreeRunning.PpEyeQCom2ImageProcess_FreeRunning_300ms.DeEyeQ2ImageProcess.RSD_Payload_Byte_37 "" VALUE 0x25a0029 __UBYTE_S 0 NO_COMPU_METHOD 0 255 ECU_ADDRESS_EXTENSION 0x80 /end CHARACTERISTIC
/begin CHARACTERISTIC CtApImageProcess_FreeRunning.PpEyeQCom2ImageProcess_FreeRunning_300ms.DeEyeQ2ImageProcess.RSD_Payload_Byte_38 "" VALUE 0x25a002a __UBYTE_S 0 NO_COMPU_METHOD 0 255 ECU_ADDRESS_EXTENSION 0x80 /end CHARACTERISTIC
/begin CHARACTERISTIC CtApImageProcess_FreeRunning.PpEyeQCom2ImageProcess_FreeRunning_300ms.DeEyeQ2ImageProcess.RSD_Payload_Byte_39 "" VALUE 0x25a002b __UBYTE_S 0 NO_COMPU_METHOD 0 255 ECU_ADDRESS_EXTENSION 0x80 /end CHARACTERISTIC
/begin CHARACTERISTIC CtApImageProcess_FreeRunning.PpEyeQCom2ImageProcess_FreeRunning_300ms.DeEyeQ2ImageProcess.RSD_Payload_Byte_40 "" VALUE 0x25a002c __UBYTE_S 0 NO_COMPU_METHOD 0 255 ECU_ADDRESS_EXTENSION 0x80 /end CHARACTERISTIC
/begin CHARACTERISTIC CtApImageProcess_FreeRunning.PpEyeQCom2ImageProcess_FreeRunning_300ms.DeEyeQ2ImageProcess.RSD_Payload_Byte_41 "" VALUE 0x25a002d __UBYTE_S 0 NO_COMPU_METHOD 0 255 ECU_ADDRESS_EXTENSION 0x80 /end CHARACTERISTIC
/begin CHARACTERISTIC CtApImageProcess_FreeRunning.PpEyeQCom2ImageProcess_FreeRunning_300ms.DeEyeQ2ImageProcess.RSD_Payload_Byte_42 "" VALUE 0x25a002e __UBYTE_S 0 NO_COMPU_METHOD 0 255 ECU_ADDRESS_EXTENSION 0x80 /end CHARACTERISTIC
/begin CHARACTERISTIC CtApImageProcess_FreeRunning.PpEyeQCom2ImageProcess_FreeRunning_300ms.DeEyeQ2ImageProcess.RSD_Payload_Byte_43 "" VALUE 0x25a002f __UBYTE_S 0 NO_COMPU_METHOD 0 255 ECU_ADDRESS_EXTENSION 0x80 /end CHARACTERISTIC
/begin CHARACTERISTIC CtApImageProcess_FreeRunning.PpEyeQCom2ImageProcess_FreeRunning_300ms.DeEyeQ2ImageProcess.RSD_Payload_Byte_44 "" VALUE 0x25a0030 __UBYTE_S 0 NO_COMPU_METHOD 0 255 ECU_ADDRESS_EXTENSION 0x80 /end CHARACTERISTIC
/begin CHARACTERISTIC CtApImageProcess_FreeRunning.PpEyeQCom2ImageProcess_FreeRunning_300ms.DeEyeQ2ImageProcess.RSD_Payload_Byte_45 "" VALUE 0x25a0031 __UBYTE_S 0 NO_COMPU_METHOD 0 255 ECU_ADDRESS_EXTENSION 0x80 /end CHARACTERISTIC
/begin CHARACTERISTIC CtApImageProcess_FreeRunning.PpEyeQCom2ImageProcess_FreeRunning_300ms.DeEyeQ2ImageProcess.RSD_Payload_Byte_46 "" VALUE 0x25a0032 __UBYTE_S 0 NO_COMPU_METHOD 0 255 ECU_ADDRESS_EXTENSION 0x80 /end CHARACTERISTIC
/begin CHARACTERISTIC CtApImageProcess_FreeRunning.PpEyeQCom2ImageProcess_FreeRunning_300ms.DeEyeQ2ImageProcess.RSD_Payload_Byte_47 "" VALUE 0x25a0033 __UBYTE_S 0 NO_COMPU_METHOD 0 255 ECU_ADDRESS_EXTENSION 0x80 /end CHARACTERISTIC
/begin CHARACTERISTIC CtApImageProcess_FreeRunning.PpEyeQCom2ImageProcess_FreeRunning_300ms.DeEyeQ2ImageProcess.RSD_Payload_Byte_48 "" VALUE 0x25a0034 __UBYTE_S 0 NO_COMPU_METHOD 0 255 ECU_ADDRESS_EXTENSION 0x80 /end CHARACTERISTIC
/begin CHARACTERISTIC CtApImageProcess_FreeRunning.PpEyeQCom2ImageProcess_FreeRunning_300ms.DeEyeQ2ImageProcess.RSD_Payload_Byte_49 "" VALUE 0x25a0035 __UBYTE_S 0 NO_COMPU_METHOD 0 255 ECU_ADDRESS_EXTENSION 0x80 /end CHARACTERISTIC
/begin CHARACTERISTIC CtApImageProcess_FreeRunning.PpEyeQCom2ImageProcess_FreeRunning_300ms.DeEyeQ2ImageProcess.RSD_Payload_Byte_50 "" VALUE 0x25a0036 __UBYTE_S 0 NO_COMPU_METHOD 0 255 ECU_ADDRESS_EXTENSION 0x80 /end CHARACTERISTIC
/begin CHARACTERISTIC CtApImageProcess_FreeRunning.PpEyeQCom2ImageProcess_FreeRunning_300ms.DeEyeQ2ImageProcess.RSD_Payload_Byte_51 "" VALUE 0x25a0037 __UBYTE_S 0 NO_COMPU_METHOD 0 255 ECU_ADDRESS_EXTENSION 0x80 /end CHARACTERISTIC
/begin CHARACTERISTIC CtApImageProcess_FreeRunning.PpEyeQCom2ImageProcess_FreeRunning_300ms.DeEyeQ2ImageProcess.RSD_Payload_Byte_52 "" VALUE 0x25a0038 __UBYTE_S 0 NO_COMPU_METHOD 0 255 ECU_ADDRESS_EXTENSION 0x80 /end CHARACTERISTIC
/begin CHARACTERISTIC CtApImageProcess_FreeRunning.PpEyeQCom2ImageProcess_FreeRunning_300ms.DeEyeQ2ImageProcess.RSD_Payload_Byte_53 "" VALUE 0x25a0039 __UBYTE_S 0 NO_COMPU_METHOD 0 255 ECU_ADDRESS_EXTENSION 0x80 /end CHARACTERISTIC
/begin CHARACTERISTIC CtApImageProcess_FreeRunning.PpEyeQCom2ImageProcess_FreeRunning_300ms.DeEyeQ2ImageProcess.RSD_Payload_Byte_54 "" VALUE 0x25a003a __UBYTE_S 0 NO_COMPU_METHOD 0 255 ECU_ADDRESS_EXTENSION 0x80 /end CHARACTERISTIC
/begin CHARACTERISTIC CtApImageProcess_FreeRunning.PpEyeQCom2ImageProcess_FreeRunning_300ms.DeEyeQ2ImageProcess.RSD_Payload_Byte_55 "" VALUE 0x25a003b __UBYTE_S 0 NO_COMPU_METHOD 0 255 ECU_ADDRESS_EXTENSION 0x80 /end CHARACTERISTIC
/begin CHARACTERISTIC CtApImageProcess_FreeRunning.PpEyeQCom2ImageProcess_FreeRunning_300ms.DeEyeQ2ImageProcess.RSD_Payload_Byte_56 "" VALUE 0x25a003c __UBYTE_S 0 NO_COMPU_METHOD 0 255 ECU_ADDRESS_EXTENSION 0x80 /end CHARACTERISTIC
/begin CHARACTERISTIC CtApImageProcess_FreeRunning.PpEyeQCom2ImageProcess_FreeRunning_300ms.DeEyeQ2ImageProcess.RSD_Payload_Byte_57 "" VALUE 0x25a003d __UBYTE_S 0 NO_COMPU_METHOD 0 255 ECU_ADDRESS_EXTENSION 0x80 /end CHARACTERISTIC
/begin CHARACTERISTIC CtApImageProcess_FreeRunning.PpEyeQCom2ImageProcess_FreeRunning_300ms.DeEyeQ2ImageProcess.RSD_Payload_Byte_58 "" VALUE 0x25a003e __UBYTE_S 0 NO_COMPU_METHOD 0 255 ECU_ADDRESS_EXTENSION 0x80 /end CHARACTERISTIC
/begin CHARACTERISTIC CtApImageProcess_FreeRunning.PpEyeQCom2ImageProcess_FreeRunning_300ms.DeEyeQ2ImageProcess.RSD_Payload_Byte_59 "" VALUE 0x25a003f __UBYTE_S 0 NO_COMPU_METHOD 0 255 ECU_ADDRESS_EXTENSION 0x80 /end CHARACTERISTIC
/begin CHARACTERISTIC CtApImageProcess_FreeRunning.PpEyeQCom2ImageProcess_FreeRunning_300ms.DeEyeQ2ImageProcess.RSD_Payload_Byte_60 "" VALUE 0x25a0040 __UBYTE_S 0 NO_COMPU_METHOD 0 255 ECU_ADDRESS_EXTENSION 0x80 /end CHARACTERISTIC
/begin CHARACTERISTIC CtApImageProcess_FreeRunning.PpEyeQCom2ImageProcess_FreeRunning_300ms.DeEyeQ2ImageProcess.RSD_Payload_Byte_61 "" VALUE 0x25a0041 __UBYTE_S 0 NO_COMPU_METHOD 0 255 ECU_ADDRESS_EXTENSION 0x80 /end CHARACTERISTIC
/begin CHARACTERISTIC CtApImageProcess_FreeRunning.PpEyeQCom2ImageProcess_FreeRunning_300ms.DeEyeQ2ImageProcess.RSD_Payload_Byte_62 "" VALUE 0x25a0042 __UBYTE_S 0 NO_COMPU_METHOD 0 255 ECU_ADDRESS_EXTENSION 0x80 /end CHARACTERISTIC
/begin CHARACTERISTIC CtApImageProcess_FreeRunning.PpEyeQCom2ImageProcess_FreeRunning_300ms.DeEyeQ2ImageProcess.RSD_Payload_Byte_63 "" VALUE 0x25a0043 __UBYTE_S 0 NO_COMPU_METHOD 0 255 ECU_ADDRESS_EXTENSION 0x80 /end CHARACTERISTIC
/begin CHARACTERISTIC CtApImageProcess_FreeRunning.PpEyeQCom2ImageProcess_FreeRunning_300ms.DeEyeQ2ImageProcess.RSD_Payload_Byte_64 "" VALUE 0x25a0044 __UBYTE_S 0 NO_COMPU_METHOD 0 255 ECU_ADDRESS_EXTENSION 0x80 /end CHARACTERISTIC
/begin CHARACTERISTIC CtApImageProcess_FreeRunning.PpEyeQCom2ImageProcess_FreeRunning_300ms.DeEyeQ2ImageProcess.RSD_Payload_Byte_65 "" VALUE 0x25a0045 __UBYTE_S 0 NO_COMPU_METHOD 0 255 ECU_ADDRESS_EXTENSION 0x80 /end CHARACTERISTIC
/begin CHARACTERISTIC CtApImageProcess_FreeRunning.PpEyeQCom2ImageProcess_FreeRunning_300ms.DeEyeQ2ImageProcess.RSD_Payload_Byte_66 "" VALUE 0x25a0046 __UBYTE_S 0 NO_COMPU_METHOD 0 255 ECU_ADDRESS_EXTENSION 0x80 /end CHARACTERISTIC
/begin CHARACTERISTIC CtApImageProcess_FreeRunning.PpEyeQCom2ImageProcess_FreeRunning_300ms.DeEyeQ2ImageProcess.RSD_Payload_Byte_67 "" VALUE 0x25a0047 __UBYTE_S 0 NO_COMPU_METHOD 0 255 ECU_ADDRESS_EXTENSION 0x80 /end CHARACTERISTIC
/begin CHARACTERISTIC CtApImageProcess_FreeRunning.PpEyeQCom2ImageProcess_FreeRunning_300ms.DeEyeQ2ImageProcess.RSD_Payload_Byte_68 "" VALUE 0x25a0048 __UBYTE_S 0 NO_COMPU_METHOD 0 255 ECU_ADDRESS_EXTENSION 0x80 /end CHARACTERISTIC
/begin CHARACTERISTIC CtApImageProcess_FreeRunning.PpEyeQCom2ImageProcess_FreeRunning_300ms.DeEyeQ2ImageProcess.RSD_Payload_Byte_69 "" VALUE 0x25a0049 __UBYTE_S 0 NO_COMPU_METHOD 0 255 ECU_ADDRESS_EXTENSION 0x80 /end CHARACTERISTIC
/begin CHARACTERISTIC CtApImageProcess_FreeRunning.PpEyeQCom2ImageProcess_FreeRunning_300ms.DeEyeQ2ImageProcess.RSD_Payload_Byte_70 "" VALUE 0x25a004a __UBYTE_S 0 NO_COMPU_METHOD 0 255 ECU_ADDRESS_EXTENSION 0x80 /end CHARACTERISTIC
/begin CHARACTERISTIC CtApImageProcess_FreeRunning.PpEyeQCom2ImageProcess_FreeRunning_300ms.DeEyeQ2ImageProcess.RSD_Payload_Byte_71 "" VALUE 0x25a004b __UBYTE_S 0 NO_COMPU_METHOD 0 255 ECU_ADDRESS_EXTENSION 0x80 /end CHARACTERISTIC
/begin CHARACTERISTIC CtApImageProcess_FreeRunning.PpEyeQCom2ImageProcess_FreeRunning_300ms.DeEyeQ2ImageProcess.RSD_Payload_Byte_72 "" VALUE 0x25a004c __UBYTE_S 0 NO_COMPU_METHOD 0 255 ECU_ADDRESS_EXTENSION 0x80 /end CHARACTERISTIC
/begin CHARACTERISTIC CtApImageProcess_FreeRunning.PpEyeQCom2ImageProcess_FreeRunning_300ms.DeEyeQ2ImageProcess.RSD_Payload_Byte_73 "" VALUE 0x25a004d __UBYTE_S 0 NO_COMPU_METHOD 0 255 ECU_ADDRESS_EXTENSION 0x80 /end CHARACTERISTIC
/begin CHARACTERISTIC CtApImageProcess_FreeRunning.PpEyeQCom2ImageProcess_FreeRunning_300ms.DeEyeQ2ImageProcess.RSD_Payload_Byte_74 "" VALUE 0x25a004e __UBYTE_S 0 NO_COMPU_METHOD 0 255 ECU_ADDRESS_EXTENSION 0x80 /end CHARACTERISTIC
/begin CHARACTERISTIC CtApImageProcess_FreeRunning.PpEyeQCom2ImageProcess_FreeRunning_300ms.DeEyeQ2ImageProcess.RSD_Payload_Byte_75 "" VALUE 0x25a004f __UBYTE_S 0 NO_COMPU_METHOD 0 255 ECU_ADDRESS_EXTENSION 0x80 /end CHARACTERISTIC
/begin CHARACTERISTIC CtApImageProcess_FreeRunning.PpEyeQCom2ImageProcess_FreeRunning_300ms.DeEyeQ2ImageProcess.RSD_Payload_Byte_76 "" VALUE 0x25a0050 __UBYTE_S 0 NO_COMPU_METHOD 0 255 ECU_ADDRESS_EXTENSION 0x80 /end CHARACTERISTIC
/begin CHARACTERISTIC CtApImageProcess_FreeRunning.PpEyeQCom2ImageProcess_FreeRunning_300ms.DeEyeQ2ImageProcess.RSD_Payload_Byte_77 "" VALUE 0x25a0051 __UBYTE_S 0 NO_COMPU_METHOD 0 255 ECU_ADDRESS_EXTENSION 0x80 /end CHARACTERISTIC
/begin CHARACTERISTIC CtApImageProcess_FreeRunning.PpEyeQCom2ImageProcess_FreeRunning_300ms.DeEyeQ2ImageProcess.RSD_Payload_Byte_78 "" VALUE 0x25a0052 __UBYTE_S 0 NO_COMPU_METHOD 0 255 ECU_ADDRESS_EXTENSION 0x80 /end CHARACTERISTIC
/begin CHARACTERISTIC CtApImageProcess_FreeRunning.PpEyeQCom2ImageProcess_FreeRunning_300ms.DeEyeQ2ImageProcess.RSD_Payload_Byte_79 "" VALUE 0x25a0053 __UBYTE_S 0 NO_COMPU_METHOD 0 255 ECU_ADDRESS_EXTENSION 0x80 /end CHARACTERISTIC
/begin CHARACTERISTIC CtApImageProcess_FreeRunning.PpEyeQCom2ImageProcess_FreeRunning_300ms.DeEyeQ2ImageProcess.RSD_Payload_Byte_80 "" VALUE 0x25a0054 __UBYTE_S 0 NO_COMPU_METHOD 0 255 ECU_ADDRESS_EXTENSION 0x80 /end CHARACTERISTIC
/begin CHARACTERISTIC CtApImageProcess_FreeRunning.PpEyeQCom2ImageProcess_FreeRunning_300ms.DeEyeQ2ImageProcess.RSD_Payload_Byte_81 "" VALUE 0x25a0055 __UBYTE_S 0 NO_COMPU_METHOD 0 255 ECU_ADDRESS_EXTENSION 0x80 /end CHARACTERISTIC
/begin CHARACTERISTIC CtApImageProcess_FreeRunning.PpEyeQCom2ImageProcess_FreeRunning_300ms.DeEyeQ2ImageProcess.RSD_Payload_Byte_82 "" VALUE 0x25a0056 __UBYTE_S 0 NO_COMPU_METHOD 0 255 ECU_ADDRESS_EXTENSION 0x80 /end CHARACTERISTIC
/begin CHARACTERISTIC CtApImageProcess_FreeRunning.PpEyeQCom2ImageProcess_FreeRunning_300ms.DeEyeQ2ImageProcess.RSD_Payload_Byte_83 "" VALUE 0x25a0057 __UBYTE_S 0 NO_COMPU_METHOD 0 255 ECU_ADDRESS_EXTENSION 0x80 /end CHARACTERISTIC
/begin CHARACTERISTIC CtApImageProcess_FreeRunning.PpEyeQCom2ImageProcess_FreeRunning_300ms.DeEyeQ2ImageProcess.RSD_Payload_Byte_84 "" VALUE 0x25a0058 __UBYTE_S 0 NO_COMPU_METHOD 0 255 ECU_ADDRESS_EXTENSION 0x80 /end CHARACTERISTIC
/begin CHARACTERISTIC CtApImageProcess_FreeRunning.PpEyeQCom2ImageProcess_FreeRunning_300ms.DeEyeQ2ImageProcess.RSD_Payload_Byte_85 "" VALUE 0x25a0059 __UBYTE_S 0 NO_COMPU_METHOD 0 255 ECU_ADDRESS_EXTENSION 0x80 /end CHARACTERISTIC
/begin CHARACTERISTIC CtApImageProcess_FreeRunning.PpEyeQCom2ImageProcess_FreeRunning_300ms.DeEyeQ2ImageProcess.RSD_Payload_Byte_86 "" VALUE 0x25a005a __UBYTE_S 0 NO_COMPU_METHOD 0 255 ECU_ADDRESS_EXTENSION 0x80 /end CHARACTERISTIC
/begin CHARACTERISTIC CtApImageProcess_FreeRunning.PpEyeQCom2ImageProcess_FreeRunning_300ms.DeEyeQ2ImageProcess.RSD_Payload_Byte_87 "" VALUE 0x25a005b __UBYTE_S 0 NO_COMPU_METHOD 0 255 ECU_ADDRESS_EXTENSION 0x80 /end CHARACTERISTIC
/begin CHARACTERISTIC CtApImageProcess_FreeRunning.PpEyeQCom2ImageProcess_FreeRunning_300ms.DeEyeQ2ImageProcess.RSD_Payload_Byte_88 "" VALUE 0x25a005c __UBYTE_S 0 NO_COMPU_METHOD 0 255 ECU_ADDRESS_EXTENSION 0x80 /end CHARACTERISTIC
/begin CHARACTERISTIC CtApImageProcess_FreeRunning.PpEyeQCom2ImageProcess_FreeRunning_300ms.DeEyeQ2ImageProcess.RSD_Payload_Byte_89 "" VALUE 0x25a005d __UBYTE_S 0 NO_COMPU_METHOD 0 255 ECU_ADDRESS_EXTENSION 0x80 /end CHARACTERISTIC
/begin CHARACTERISTIC CtApImageProcess_FreeRunning.PpEyeQCom2ImageProcess_FreeRunning_300ms.DeEyeQ2ImageProcess.RSD_Payload_Byte_90 "" VALUE 0x25a005e __UBYTE_S 0 NO_COMPU_METHOD 0 255 ECU_ADDRESS_EXTENSION 0x80 /end CHARACTERISTIC
/begin CHARACTERISTIC CtApImageProcess_FreeRunning.PpEyeQCom2ImageProcess_FreeRunning_300ms.DeEyeQ2ImageProcess.RSD_Payload_Byte_91 "" VALUE 0x25a005f __UBYTE_S 0 NO_COMPU_METHOD 0 255 ECU_ADDRESS_EXTENSION 0x80 /end CHARACTERISTIC
/begin CHARACTERISTIC CtApImageProcess_FreeRunning.PpEyeQCom2ImageProcess_FreeRunning_300ms.DeEyeQ2ImageProcess.RSD_Payload_Byte_92 "" VALUE 0x25a0060 __UBYTE_S 0 NO_COMPU_METHOD 0 255 ECU_ADDRESS_EXTENSION 0x80 /end CHARACTERISTIC
/begin CHARACTERISTIC CtApImageProcess_FreeRunning.PpEyeQCom2ImageProcess_FreeRunning_300ms.DeEyeQ2ImageProcess.RSD_Payload_Byte_93 "" VALUE 0x25a0061 __UBYTE_S 0 NO_COMPU_METHOD 0 255 ECU_ADDRESS_EXTENSION 0x80 /end CHARACTERISTIC
/begin CHARACTERISTIC CtApImageProcess_FreeRunning.PpEyeQCom2ImageProcess_FreeRunning_300ms.DeEyeQ2ImageProcess.RSD_Payload_Byte_94 "" VALUE 0x25a0062 __UBYTE_S 0 NO_COMPU_METHOD 0 255 ECU_ADDRESS_EXTENSION 0x80 /end CHARACTERISTIC
/begin CHARACTERISTIC CtApImageProcess_FreeRunning.PpEyeQCom2ImageProcess_FreeRunning_300ms.DeEyeQ2ImageProcess.RSD_Payload_Byte_95 "" VALUE 0x25a0063 __UBYTE_S 0 NO_COMPU_METHOD 0 255 ECU_ADDRESS_EXTENSION 0x80 /end CHARACTERISTIC
/begin CHARACTERISTIC CtApImageProcess_FreeRunning.PpEyeQCom2ImageProcess_FreeRunning_300ms.DeEyeQ2ImageProcess.RSD_Payload_Byte_96 "" VALUE 0x25a0064 __UBYTE_S 0 NO_COMPU_METHOD 0 255 ECU_ADDRESS_EXTENSION 0x80 /end CHARACTERISTIC
/begin CHARACTERISTIC CtApImageProcess_FreeRunning.PpEyeQCom2ImageProcess_FreeRunning_300ms.DeEyeQ2ImageProcess.RSD_Payload_Byte_97 "" VALUE 0x25a0065 __UBYTE_S 0 NO_COMPU_METHOD 0 255 ECU_ADDRESS_EXTENSION 0x80 /end CHARACTERISTIC
/begin CHARACTERISTIC CtApImageProcess_FreeRunning.PpEyeQCom2ImageProcess_FreeRunning_300ms.DeEyeQ2ImageProcess.RSD_Payload_Byte_98 "" VALUE 0x25a0066 __UBYTE_S 0 NO_COMPU_METHOD 0 255 ECU_ADDRESS_EXTENSION 0x80 /end CHARACTERISTIC
/begin CHARACTERISTIC CtApImageProcess_FreeRunning.PpEyeQCom2ImageProcess_FreeRunning_300ms.DeEyeQ2ImageProcess.RSD_Payload_Byte_99 "" VALUE 0x25a0067 __UBYTE_S 0 NO_COMPU_METHOD 0 255 ECU_ADDRESS_EXTENSION 0x80 /end CHARACTERISTIC
/begin CHARACTERISTIC CtApImageProcess_FreeRunning.PpEyeQCom2ImageProcess_FreeRunning_300ms.DeEyeQ2ImageProcess.RSD_Payload_Byte_100 "" VALUE 0x25a0068 __UBYTE_S 0 NO_COMPU_METHOD 0 255 ECU_ADDRESS_EXTENSION 0x80 /end CHARACTERISTIC
/begin CHARACTERISTIC CtApImageProcess_FreeRunning.PpEyeQCom2ImageProcess_FreeRunning_300ms.DeEyeQ2ImageProcess.RSD_Payload_Byte_101 "" VALUE 0x25a0069 __UBYTE_S 0 NO_COMPU_METHOD 0 255 ECU_ADDRESS_EXTENSION 0x80 /end CHARACTERISTIC
/begin CHARACTERISTIC CtApImageProcess_FreeRunning.PpEyeQCom2ImageProcess_FreeRunning_300ms.DeEyeQ2ImageProcess.RSD_Payload_Byte_102 "" VALUE 0x25a006a __UBYTE_S 0 NO_COMPU_METHOD 0 255 ECU_ADDRESS_EXTENSION 0x80 /end CHARACTERISTIC
/begin CHARACTERISTIC CtApImageProcess_FreeRunning.PpEyeQCom2ImageProcess_FreeRunning_300ms.DeEyeQ2ImageProcess.RSD_Payload_Byte_103 "" VALUE 0x25a006b __UBYTE_S 0 NO_COMPU_METHOD 0 255 ECU_ADDRESS_EXTENSION 0x80 /end CHARACTERISTIC
/begin CHARACTERISTIC CtApImageProcess_FreeRunning.PpEyeQCom2ImageProcess_FreeRunning_300ms.DeEyeQ2ImageProcess.RSD_Payload_Byte_104 "" VALUE 0x25a006c __UBYTE_S 0 NO_COMPU_METHOD 0 255 ECU_ADDRESS_EXTENSION 0x80 /end CHARACTERISTIC
/begin CHARACTERISTIC CtApImageProcess_FreeRunning.PpEyeQCom2ImageProcess_FreeRunning_300ms.DeEyeQ2ImageProcess.RSD_Payload_Byte_105 "" VALUE 0x25a006d __UBYTE_S 0 NO_COMPU_METHOD 0 255 ECU_ADDRESS_EXTENSION 0x80 /end CHARACTERISTIC
/begin CHARACTERISTIC CtApImageProcess_FreeRunning.PpEyeQCom2ImageProcess_FreeRunning_300ms.DeEyeQ2ImageProcess.RSD_Payload_Byte_106 "" VALUE 0x25a006e __UBYTE_S 0 NO_COMPU_METHOD 0 255 ECU_ADDRESS_EXTENSION 0x80 /end CHARACTERISTIC
/begin CHARACTERISTIC CtApImageProcess_FreeRunning.PpEyeQCom2ImageProcess_FreeRunning_300ms.DeEyeQ2ImageProcess.RSD_Payload_Byte_107 "" VALUE 0x25a006f __UBYTE_S 0 NO_COMPU_METHOD 0 255 ECU_ADDRESS_EXTENSION 0x80 /end CHARACTERISTIC
/begin CHARACTERISTIC CtApImageProcess_FreeRunning.PpEyeQCom2ImageProcess_FreeRunning_300ms.DeEyeQ2ImageProcess.RSD_Payload_Byte_108 "" VALUE 0x25a0070 __UBYTE_S 0 NO_COMPU_METHOD 0 255 ECU_ADDRESS_EXTENSION 0x80 /end CHARACTERISTIC
/begin CHARACTERISTIC CtApImageProcess_FreeRunning.PpEyeQCom2ImageProcess_FreeRunning_300ms.DeEyeQ2ImageProcess.RSD_Payload_Byte_109 "" VALUE 0x25a0071 __UBYTE_S 0 NO_COMPU_METHOD 0 255 ECU_ADDRESS_EXTENSION 0x80 /end CHARACTERISTIC
/begin CHARACTERISTIC CtApImageProcess_FreeRunning.PpEyeQCom2ImageProcess_FreeRunning_300ms.DeEyeQ2ImageProcess.RSD_Payload_Byte_110 "" VALUE 0x25a0072 __UBYTE_S 0 NO_COMPU_METHOD 0 255 ECU_ADDRESS_EXTENSION 0x80 /end CHARACTERISTIC
/begin CHARACTERISTIC CtApImageProcess_FreeRunning.PpEyeQCom2ImageProcess_FreeRunning_300ms.DeEyeQ2ImageProcess.RSD_Payload_Byte_111 "" VALUE 0x25a0073 __UBYTE_S 0 NO_COMPU_METHOD 0 255 ECU_ADDRESS_EXTENSION 0x80 /end CHARACTERISTIC
/begin CHARACTERISTIC CtApImageProcess_FreeRunning.PpEyeQCom2ImageProcess_FreeRunning_300ms.DeEyeQ2ImageProcess.RSD_Payload_Byte_112 "" VALUE 0x25a0074 __UBYTE_S 0 NO_COMPU_METHOD 0 255 ECU_ADDRESS_EXTENSION 0x80 /end CHARACTERISTIC
/begin CHARACTERISTIC CtApImageProcess_FreeRunning.PpInertialProcess_IMUInfo2ImageProcess_10ms.DeInertialProcess_Info.stHeader.Counter "" VALUE 0x25b0000 __UWORD_S 0 NO_COMPU_METHOD 0 65535 ECU_ADDRESS_EXTENSION 0x80 /end CHARACTERISTIC
/begin CHARACTERISTIC CtApImageProcess_FreeRunning.PpInertialProcess_IMUInfo2ImageProcess_10ms.DeInertialProcess_Info.stHeader.FrameID "" VALUE 0x25b0002 __UBYTE_S 0 NO_COMPU_METHOD 0 255 ECU_ADDRESS_EXTENSION 0x80 /end CHARACTERISTIC
/begin CHARACTERISTIC CtApImageProcess_FreeRunning.PpInertialProcess_IMUInfo2ImageProcess_10ms.DeInertialProcess_Info.stHeader.TimeStamp "2 uint32 array" VAL_BLK 0x25b0004 __ULONG_S 0 NO_COMPU_METHOD 0 4294967295 ECU_ADDRESS_EXTENSION 0x80 MATRIX_DIM 2 1 1 /end CHARACTERISTIC
/begin CHARACTERISTIC CtApImageProcess_FreeRunning.PpInertialProcess_IMUInfo2ImageProcess_10ms.DeInertialProcess_Info.fLatitude "" VALUE 0x25b0010 __FLOAT64_IEEE_S 0 NO_COMPU_METHOD 0 3.402823e+38 ECU_ADDRESS_EXTENSION 0x80 /end CHARACTERISTIC
/begin CHARACTERISTIC CtApImageProcess_FreeRunning.PpInertialProcess_IMUInfo2ImageProcess_10ms.DeInertialProcess_Info.fLongitude "" VALUE 0x25b0018 __FLOAT64_IEEE_S 0 NO_COMPU_METHOD 0 3.402823e+38 ECU_ADDRESS_EXTENSION 0x80 /end CHARACTERISTIC
/begin CHARACTERISTIC CtApImageProcess_FreeRunning.PpInertialProcess_IMUInfo2ImageProcess_10ms.DeInertialProcess_Info.fAltitude "" VALUE 0x25b0020 __FLOAT32_IEEE_S 0 NO_COMPU_METHOD 0 3.402823e+38 ECU_ADDRESS_EXTENSION 0x80 /end CHARACTERISTIC
/begin CHARACTERISTIC CtApImageProcess_FreeRunning.PpInertialProcess_IMUInfo2ImageProcess_10ms.DeInertialProcess_Info.fAccX "" VALUE 0x25b0024 __FLOAT32_IEEE_S 0 NO_COMPU_METHOD 0 3.402823e+38 ECU_ADDRESS_EXTENSION 0x80 /end CHARACTERISTIC
/begin CHARACTERISTIC CtApImageProcess_FreeRunning.PpInertialProcess_IMUInfo2ImageProcess_10ms.DeInertialProcess_Info.fAccY "" VALUE 0x25b0028 __FLOAT32_IEEE_S 0 NO_COMPU_METHOD 0 3.402823e+38 ECU_ADDRESS_EXTENSION 0x80 /end CHARACTERISTIC
/begin CHARACTERISTIC CtApImageProcess_FreeRunning.PpInertialProcess_IMUInfo2ImageProcess_10ms.DeInertialProcess_Info.fAccZ "" VALUE 0x25b002c __FLOAT32_IEEE_S 0 NO_COMPU_METHOD 0 3.402823e+38 ECU_ADDRESS_EXTENSION 0x80 /end CHARACTERISTIC
/begin CHARACTERISTIC CtApImageProcess_FreeRunning.PpInertialProcess_IMUInfo2ImageProcess_10ms.DeInertialProcess_Info.fAngRateX "" VALUE 0x25b0030 __FLOAT32_IEEE_S 0 NO_COMPU_METHOD 0 3.402823e+38 ECU_ADDRESS_EXTENSION 0x80 /end CHARACTERISTIC
/begin CHARACTERISTIC CtApImageProcess_FreeRunning.PpInertialProcess_IMUInfo2ImageProcess_10ms.DeInertialProcess_Info.fAngRateY "" VALUE 0x25b0034 __FLOAT32_IEEE_S 0 NO_COMPU_METHOD 0 3.402823e+38 ECU_ADDRESS_EXTENSION 0x80 /end CHARACTERISTIC
/begin CHARACTERISTIC CtApImageProcess_FreeRunning.PpInertialProcess_IMUInfo2ImageProcess_10ms.DeInertialProcess_Info.fAngRateZ "" VALUE 0x25b0038 __FLOAT32_IEEE_S 0 NO_COMPU_METHOD 0 3.402823e+38 ECU_ADDRESS_EXTENSION 0x80 /end CHARACTERISTIC
/begin CHARACTERISTIC CtApImageProcess_FreeRunning.PpInertialProcess_IMUInfo2ImageProcess_10ms.DeInertialProcess_Info.fVelNorth "" VALUE 0x25b003c __FLOAT32_IEEE_S 0 NO_COMPU_METHOD 0 3.402823e+38 ECU_ADDRESS_EXTENSION 0x80 /end CHARACTERISTIC
/begin CHARACTERISTIC CtApImageProcess_FreeRunning.PpInertialProcess_IMUInfo2ImageProcess_10ms.DeInertialProcess_Info.fVelWest "" VALUE 0x25b0040 __FLOAT32_IEEE_S 0 NO_COMPU_METHOD 0 3.402823e+38 ECU_ADDRESS_EXTENSION 0x80 /end CHARACTERISTIC
/begin CHARACTERISTIC CtApImageProcess_FreeRunning.PpInertialProcess_IMUInfo2ImageProcess_10ms.DeInertialProcess_Info.fVelUp "" VALUE 0x25b0044 __FLOAT32_IEEE_S 0 NO_COMPU_METHOD 0 3.402823e+38 ECU_ADDRESS_EXTENSION 0x80 /end CHARACTERISTIC
/begin CHARACTERISTIC CtApImageProcess_FreeRunning.PpInertialProcess_IMUInfo2ImageProcess_10ms.DeInertialProcess_Info.fHeading "" VALUE 0x25b0048 __FLOAT32_IEEE_S 0 NO_COMPU_METHOD 0 3.402823e+38 ECU_ADDRESS_EXTENSION 0x80 /end CHARACTERISTIC
/begin CHARACTERISTIC CtApImageProcess_FreeRunning.PpInertialProcess_IMUInfo2ImageProcess_10ms.DeInertialProcess_Info.fPitch "" VALUE 0x25b004c __FLOAT32_IEEE_S 0 NO_COMPU_METHOD 0 3.402823e+38 ECU_ADDRESS_EXTENSION 0x80 /end CHARACTERISTIC
/begin CHARACTERISTIC CtApImageProcess_FreeRunning.PpInertialProcess_IMUInfo2ImageProcess_10ms.DeInertialProcess_Info.fRoll "" VALUE 0x25b0050 __FLOAT32_IEEE_S 0 NO_COMPU_METHOD 0 3.402823e+38 ECU_ADDRESS_EXTENSION 0x80 /end CHARACTERISTIC
/begin CHARACTERISTIC CtApImageProcess_FreeRunning.PpInertialProcess_IMUInfo2ImageProcess_10ms.DeInertialProcess_Info.nNavStatus "" VALUE 0x25b0054 __UBYTE_S 0 NO_COMPU_METHOD 0 255 ECU_ADDRESS_EXTENSION 0x80 /end CHARACTERISTIC
/begin CHARACTERISTIC CtApImageProcess_FreeRunning.PpInertialProcess_IMUInfo2ImageProcess_10ms.DeInertialProcess_Info.nInitStatusPosition "" VALUE 0x25b0055 __SBYTE_S 0 NO_COMPU_METHOD -128 127 ECU_ADDRESS_EXTENSION 0x80 /end CHARACTERISTIC
/begin CHARACTERISTIC CtApImageProcess_FreeRunning.PpInertialProcess_IMUInfo2ImageProcess_10ms.DeInertialProcess_Info.nInitstatusVel "" VALUE 0x25b0056 __SBYTE_S 0 NO_COMPU_METHOD -128 127 ECU_ADDRESS_EXTENSION 0x80 /end CHARACTERISTIC
/begin CHARACTERISTIC CtApImageProcess_FreeRunning.PpInertialProcess_IMUInfo2ImageProcess_10ms.DeInertialProcess_Info.nInitstatusRP "" VALUE 0x25b0057 __SBYTE_S 0 NO_COMPU_METHOD -128 127 ECU_ADDRESS_EXTENSION 0x80 /end CHARACTERISTIC
/begin CHARACTERISTIC CtApImageProcess_FreeRunning.PpInertialProcess_IMUInfo2ImageProcess_10ms.DeInertialProcess_Info.nInitstatusH "" VALUE 0x25b0058 __SBYTE_S 0 NO_COMPU_METHOD -128 127 ECU_ADDRESS_EXTENSION 0x80 /end CHARACTERISTIC
/begin CHARACTERISTIC CtApImageProcess_FreeRunning.PpInertialProcess_IMUInfo2ImageProcess_10ms.DeInertialProcess_Info.dGPSTime "" VALUE 0x25b0060 __FLOAT64_IEEE_S 0 NO_COMPU_METHOD 0 3.402823e+38 ECU_ADDRESS_EXTENSION 0x80 /end CHARACTERISTIC
/begin CHARACTERISTIC CtApImageProcess_FreeRunning.PpInertialProcess_IMUInfo2ImageProcess_10ms.DeInertialProcess_Info.stdstd "9 float64 array" VAL_BLK 0x25b0068 __FLOAT64_IEEE_S 0 NO_COMPU_METHOD 0 3.402823e+38 ECU_ADDRESS_EXTENSION 0x80 MATRIX_DIM 9 1 1 /end CHARACTERISTIC
/begin CHARACTERISTIC CtApImageProcess_FreeRunning.PpInertialProcess_IMUInfo2ImageProcess_10ms.DeInertialProcess_Info.iGPSPositionMode "" VALUE 0x25b00b0 __UBYTE_S 0 NO_COMPU_METHOD 0 255 ECU_ADDRESS_EXTENSION 0x80 /end CHARACTERISTIC
/begin CHARACTERISTIC CtApImageProcess_FreeRunning.PpInertialProcess_IMUInfo2ImageProcess_10ms.DeInertialProcess_Info.iGPSVelMode "" VALUE 0x25b00b1 __UBYTE_S 0 NO_COMPU_METHOD 0 255 ECU_ADDRESS_EXTENSION 0x80 /end CHARACTERISTIC
/begin CHARACTERISTIC CtApImageProcess_FreeRunning.PpInertialProcess_IMUInfo2ImageProcess_10ms.DeInertialProcess_Info.iDaulAntennaOrientationMode "" VALUE 0x25b00b2 __UBYTE_S 0 NO_COMPU_METHOD 0 255 ECU_ADDRESS_EXTENSION 0x80 /end CHARACTERISTIC
/begin CHARACTERISTIC CtApImageProcess_FreeRunning.PpInertialProcess_IMUInfo2ImageProcess_10ms.DeInertialProcess_Info.iSINSMode "" VALUE 0x25b00b3 __UBYTE_S 0 NO_COMPU_METHOD 0 255 ECU_ADDRESS_EXTENSION 0x80 /end CHARACTERISTIC
/begin CHARACTERISTIC CtApImageProcess_FreeRunning.PpInertialProcess_IMUInfo2ImageProcess_10ms.DeInertialProcess_Info.bkp "16 uint8 array" VAL_BLK 0x25b00b4 __UBYTE_S 0 NO_COMPU_METHOD 0 255 ECU_ADDRESS_EXTENSION 0x80 MATRIX_DIM 16 1 1 /end CHARACTERISTIC
/begin CHARACTERISTIC CtApImageProcess_FreeRunning.PpParkingLot_Ctrl_40ms.DeSVCtrl.stHeader.Counter "" VALUE 0x25c0000 __UWORD_S 0 NO_COMPU_METHOD 0 65535 ECU_ADDRESS_EXTENSION 0x80 /end CHARACTERISTIC
/begin CHARACTERISTIC CtApImageProcess_FreeRunning.PpParkingLot_Ctrl_40ms.DeSVCtrl.stHeader.FrameID "" VALUE 0x25c0002 __UBYTE_S 0 NO_COMPU_METHOD 0 255 ECU_ADDRESS_EXTENSION 0x80 /end CHARACTERISTIC
/begin CHARACTERISTIC CtApImageProcess_FreeRunning.PpParkingLot_Ctrl_40ms.DeSVCtrl.stHeader.TimeStamp "2 uint32 array" VAL_BLK 0x25c0004 __ULONG_S 0 NO_COMPU_METHOD 0 4294967295 ECU_ADDRESS_EXTENSION 0x80 MATRIX_DIM 2 1 1 /end CHARACTERISTIC
/begin CHARACTERISTIC CtApImageProcess_FreeRunning.PpParkingLot_Ctrl_40ms.DeSVCtrl.isParkingSearchFuncEnable "" VALUE 0x25c000c __UBYTE_S 0 NO_COMPU_METHOD 0 255 ECU_ADDRESS_EXTENSION 0x80 /end CHARACTERISTIC
/begin CHARACTERISTIC CtApImageProcess_FreeRunning.PpParkingLot_Ctrl_40ms.DeSVCtrl.isParkinglotTrackingFuncEnable "" VALUE 0x25c000d __UBYTE_S 0 NO_COMPU_METHOD 0 255 ECU_ADDRESS_EXTENSION 0x80 /end CHARACTERISTIC
/begin CHARACTERISTIC CtApImageProcess_FreeRunning.PpParkingLot_Ctrl_40ms.DeSVCtrl.isOfilmParkinglotTrackingID "" VALUE 0x25c000e __UBYTE_S 0 NO_COMPU_METHOD 0 255 ECU_ADDRESS_EXTENSION 0x80 /end CHARACTERISTIC
/begin CHARACTERISTIC CtApImageProcess_FreeRunning.PpParkingLot_Ctrl_40ms.DeSVCtrl.isParkinglotTrackingID "" VALUE 0x25c000f __UBYTE_S 0 NO_COMPU_METHOD 0 255 ECU_ADDRESS_EXTENSION 0x80 /end CHARACTERISTIC
/begin CHARACTERISTIC CtApImageProcess_FreeRunning.PpParkingLot_Ctrl_40ms.DeSVCtrl.isParkingFuncEnable "" VALUE 0x25c0010 __UBYTE_S 0 NO_COMPU_METHOD 0 255 ECU_ADDRESS_EXTENSION 0x80 /end CHARACTERISTIC
/begin CHARACTERISTIC CtApImageProcess_FreeRunning.PpParkingLot_Ctrl_40ms.DeSVCtrl.fReserved "21 uint8 array" VAL_BLK 0x25c0011 __UBYTE_S 0 NO_COMPU_METHOD 0 255 ECU_ADDRESS_EXTENSION 0x80 MATRIX_DIM 21 1 1 /end CHARACTERISTIC
/begin CHARACTERISTIC CtApImageProcess_FreeRunning.PpPathPlanner_Planner2AllModules_100ms.DePlanner_PlannerEnvirInfo.stHeader.Counter "" VALUE 0x25d0000 __UWORD_S 0 NO_COMPU_METHOD 0 65535 ECU_ADDRESS_EXTENSION 0x80 /end CHARACTERISTIC
/begin CHARACTERISTIC CtApImageProcess_FreeRunning.PpPathPlanner_Planner2AllModules_100ms.DePlanner_PlannerEnvirInfo.stHeader.FrameID "" VALUE 0x25d0002 __UBYTE_S 0 NO_COMPU_METHOD 0 255 ECU_ADDRESS_EXTENSION 0x80 /end CHARACTERISTIC
/begin CHARACTERISTIC CtApImageProcess_FreeRunning.PpPathPlanner_Planner2AllModules_100ms.DePlanner_PlannerEnvirInfo.stHeader.TimeStamp "2 uint32 array" VAL_BLK 0x25d0004 __ULONG_S 0 NO_COMPU_METHOD 0 4294967295 ECU_ADDRESS_EXTENSION 0x80 MATRIX_DIM 2 1 1 /end CHARACTERISTIC
/begin CHARACTERISTIC CtApImageProcess_FreeRunning.PpPathPlanner_Planner2AllModules_100ms.DePlanner_PlannerEnvirInfo.nDriveEnviorment "" VALUE 0x25d000c __UWORD_S 0 NO_COMPU_METHOD 0 65535 ECU_ADDRESS_EXTENSION 0x80 /end CHARACTERISTIC
/begin CHARACTERISTIC CtApImageProcess_FreeRunning.PpPathPlanner_Planner2AllModules_100ms.DePlanner_PlannerEnvirInfo.nCurrentBehavior "" VALUE 0x25d000e __UWORD_S 0 NO_COMPU_METHOD 0 65535 ECU_ADDRESS_EXTENSION 0x80 /end CHARACTERISTIC
/begin CHARACTERISTIC CtApImageProcess_FreeRunning.PpPathPlanner_Planner2AllModules_100ms.DePlanner_PlannerEnvirInfo.APACtlCmd "" VALUE 0x25d0010 __UBYTE_S 0 NO_COMPU_METHOD 0 255 ECU_ADDRESS_EXTENSION 0x80 /end CHARACTERISTIC
/begin CHARACTERISTIC CtApImageProcess_FreeRunning.PpPathPlanner_Planner2AllModules_100ms.DePlanner_PlannerEnvirInfo.fSpeed "" VALUE 0x25d0014 __FLOAT32_IEEE_S 0 NO_COMPU_METHOD 0 3.402823e+38 ECU_ADDRESS_EXTENSION 0x80 /end CHARACTERISTIC
/begin CHARACTERISTIC CtApImageProcess_FreeRunning.PpPathPlanner_Planner2AllModules_100ms.DePlanner_PlannerEnvirInfo.bScanningEnable "" VALUE 0x25d0018 __UBYTE_S 0 NO_COMPU_METHOD 0 1 ECU_ADDRESS_EXTENSION 0x80 /end CHARACTERISTIC
/begin CHARACTERISTIC CtApImageProcess_FreeRunning.PpPathPlanner_Planner2AllModules_100ms.DePlanner_PlannerEnvirInfo.fReserved "" VALUE 0x25d001c __FLOAT32_IEEE_S 0 NO_COMPU_METHOD 0 3.402823e+38 ECU_ADDRESS_EXTENSION 0x80 /end CHARACTERISTIC
/begin CHARACTERISTIC CtApImageProcess_FreeRunning.PpPathPlanner_Planner2AllModules_100ms.DePlanner_PlannerEnvirInfo.nReserved "" VALUE 0x25d0020 __UWORD_S 0 NO_COMPU_METHOD 0 65535 ECU_ADDRESS_EXTENSION 0x80 /end CHARACTERISTIC
/begin CHARACTERISTIC CtApImageProcess_FreeRunning.PpPdImageProcess_FreeRunningRead.DeImageProcess_FreeRunning_Normal.DeStatus "" VALUE 0x25e0000 __UWORD_S 0 CtApImageProcess_FreeRunning.PpPdImageProcess_FreeRunningRead.DeImageProcess_FreeRunning_Normal.DeStatus.Dt_ENUM_PdDatablockStatus.CONVERSION 0 65535 ECU_ADDRESS_EXTENSION 0x80 /end CHARACTERISTIC
/begin CHARACTERISTIC CtApImageProcess_FreeRunning.PpPdImageProcess_FreeRunningRead.DeImageProcess_FreeRunning_Normal.DeVersion.DeExpectedVersion.DeMajor "" VALUE 0x25e0004 __UBYTE_S 0 NO_COMPU_METHOD 0 255 ECU_ADDRESS_EXTENSION 0x80 /end CHARACTERISTIC
/begin CHARACTERISTIC CtApImageProcess_FreeRunning.PpPdImageProcess_FreeRunningRead.DeImageProcess_FreeRunning_Normal.DeVersion.DeExpectedVersion.DeMinor "" VALUE 0x25e0005 __UBYTE_S 0 NO_COMPU_METHOD 0 255 ECU_ADDRESS_EXTENSION 0x80 /end CHARACTERISTIC
/begin CHARACTERISTIC CtApImageProcess_FreeRunning.PpPdImageProcess_FreeRunningRead.DeImageProcess_FreeRunning_Normal.DeVersion.DeVersion.DeMajor "" VALUE 0x25e0008 __UBYTE_S 0 NO_COMPU_METHOD 0 255 ECU_ADDRESS_EXTENSION 0x80 /end CHARACTERISTIC
/begin CHARACTERISTIC CtApImageProcess_FreeRunning.PpPdImageProcess_FreeRunningRead.DeImageProcess_FreeRunning_Normal.DeVersion.DeVersion.DeMinor "" VALUE 0x25e0009 __UBYTE_S 0 NO_COMPU_METHOD 0 255 ECU_ADDRESS_EXTENSION 0x80 /end CHARACTERISTIC
/begin CHARACTERISTIC CtApImageProcess_FreeRunning.PpPdImageProcess_FreeRunningRead.DeImageProcess_FreeRunning_Normal.DeData.ngSignal "10 sint32 array" VAL_BLK 0x25e000c __SLONG_S 0 NO_COMPU_METHOD -2147483648 2147483647 ECU_ADDRESS_EXTENSION 0x80 MATRIX_DIM 10 1 1 /end CHARACTERISTIC
/begin CHARACTERISTIC CtApImageProcess_FreeRunning.PpPdImageProcess_FreeRunningRead.DeImageProcess_FreeRunning_Normal.DeData.fgSignal "10 float32 array" VAL_BLK 0x25e0034 __FLOAT32_IEEE_S 0 NO_COMPU_METHOD 0 3.402823e+38 ECU_ADDRESS_EXTENSION 0x80 MATRIX_DIM 10 1 1 /end CHARACTERISTIC
/begin CHARACTERISTIC CtApImageProcess_FreeRunning.PpPdImageProcess_FreeRunningRead.DeImageProcess_Normal.DeStatus "" VALUE 0x25f0000 __UWORD_S 0 CtApImageProcess_FreeRunning.PpPdImageProcess_FreeRunningRead.DeImageProcess_Normal.DeStatus.Dt_ENUM_PdDatablockStatus.CONVERSION 0 65535 ECU_ADDRESS_EXTENSION 0x80 /end CHARACTERISTIC
/begin CHARACTERISTIC CtApImageProcess_FreeRunning.PpPdImageProcess_FreeRunningRead.DeImageProcess_Normal.DeVersion.DeExpectedVersion.DeMajor "" VALUE 0x25f0004 __UBYTE_S 0 NO_COMPU_METHOD 0 255 ECU_ADDRESS_EXTENSION 0x80 /end CHARACTERISTIC
/begin CHARACTERISTIC CtApImageProcess_FreeRunning.PpPdImageProcess_FreeRunningRead.DeImageProcess_Normal.DeVersion.DeExpectedVersion.DeMinor "" VALUE 0x25f0005 __UBYTE_S 0 NO_COMPU_METHOD 0 255 ECU_ADDRESS_EXTENSION 0x80 /end CHARACTERISTIC
/begin CHARACTERISTIC CtApImageProcess_FreeRunning.PpPdImageProcess_FreeRunningRead.DeImageProcess_Normal.DeVersion.DeVersion.DeMajor "" VALUE 0x25f0008 __UBYTE_S 0 NO_COMPU_METHOD 0 255 ECU_ADDRESS_EXTENSION 0x80 /end CHARACTERISTIC
/begin CHARACTERISTIC CtApImageProcess_FreeRunning.PpPdImageProcess_FreeRunningRead.DeImageProcess_Normal.DeVersion.DeVersion.DeMinor "" VALUE 0x25f0009 __UBYTE_S 0 NO_COMPU_METHOD 0 255 ECU_ADDRESS_EXTENSION 0x80 /end CHARACTERISTIC
/begin CHARACTERISTIC CtApImageProcess_FreeRunning.PpPdImageProcess_FreeRunningRead.DeImageProcess_Normal.DeData.stHeader_Counter "" VALUE 0x25f000c __UWORD_S 0 NO_COMPU_METHOD 0 65535 ECU_ADDRESS_EXTENSION 0x80 /end CHARACTERISTIC
/begin CHARACTERISTIC CtApImageProcess_FreeRunning.PpPdImageProcess_FreeRunningRead.DeImageProcess_Normal.DeData.stHeader_FrameID "" VALUE 0x25f000e __UBYTE_S 0 NO_COMPU_METHOD 0 255 ECU_ADDRESS_EXTENSION 0x80 /end CHARACTERISTIC
/begin CHARACTERISTIC CtApImageProcess_FreeRunning.PpPdImageProcess_FreeRunningRead.DeImageProcess_Normal.DeData.stHeader_TimeStamp "2 uint32 array" VAL_BLK 0x25f0010 __ULONG_S 0 NO_COMPU_METHOD 0 4294967295 ECU_ADDRESS_EXTENSION 0x80 MATRIX_DIM 2 1 1 /end CHARACTERISTIC
/begin CHARACTERISTIC CtApImageProcess_FreeRunning.PpPdImageProcess_FreeRunningRead.DeImageProcess_Normal.DeData.stCamInt_w "" VALUE 0x25f0018 __SLONG_S 0 NO_COMPU_METHOD -2147483648 2147483647 ECU_ADDRESS_EXTENSION 0x80 /end CHARACTERISTIC
/begin CHARACTERISTIC CtApImageProcess_FreeRunning.PpPdImageProcess_FreeRunningRead.DeImageProcess_Normal.DeData.stCamInt_h "" VALUE 0x25f001c __SLONG_S 0 NO_COMPU_METHOD -2147483648 2147483647 ECU_ADDRESS_EXTENSION 0x80 /end CHARACTERISTIC
/begin CHARACTERISTIC CtApImageProcess_FreeRunning.PpPdImageProcess_FreeRunningRead.DeImageProcess_Normal.DeData.stCamInt_cu "" VALUE 0x25f0020 __FLOAT32_IEEE_S 0 NO_COMPU_METHOD 0 3.402823e+38 ECU_ADDRESS_EXTENSION 0x80 /end CHARACTERISTIC
/begin CHARACTERISTIC CtApImageProcess_FreeRunning.PpPdImageProcess_FreeRunningRead.DeImageProcess_Normal.DeData.stCamInt_cv "" VALUE 0x25f0024 __FLOAT32_IEEE_S 0 NO_COMPU_METHOD 0 3.402823e+38 ECU_ADDRESS_EXTENSION 0x80 /end CHARACTERISTIC
/begin CHARACTERISTIC CtApImageProcess_FreeRunning.PpPdImageProcess_FreeRunningRead.DeImageProcess_Normal.DeData.stCamInt_skew_c "" VALUE 0x25f0028 __FLOAT32_IEEE_S 0 NO_COMPU_METHOD 0 3.402823e+38 ECU_ADDRESS_EXTENSION 0x80 /end CHARACTERISTIC
/begin CHARACTERISTIC CtApImageProcess_FreeRunning.PpPdImageProcess_FreeRunningRead.DeImageProcess_Normal.DeData.stCamInt_skew_d "" VALUE 0x25f002c __FLOAT32_IEEE_S 0 NO_COMPU_METHOD 0 3.402823e+38 ECU_ADDRESS_EXTENSION 0x80 /end CHARACTERISTIC
/begin CHARACTERISTIC CtApImageProcess_FreeRunning.PpPdImageProcess_FreeRunningRead.DeImageProcess_Normal.DeData.stCamInt_skew_e "" VALUE 0x25f0030 __FLOAT32_IEEE_S 0 NO_COMPU_METHOD 0 3.402823e+38 ECU_ADDRESS_EXTENSION 0x80 /end CHARACTERISTIC
/begin CHARACTERISTIC CtApImageProcess_FreeRunning.PpPdImageProcess_FreeRunningRead.DeImageProcess_Normal.DeData.stCamInt_fu_or_hfov_at_cu "" VALUE 0x25f0034 __FLOAT32_IEEE_S 0 NO_COMPU_METHOD 0 3.402823e+38 ECU_ADDRESS_EXTENSION 0x80 /end CHARACTERISTIC
/begin CHARACTERISTIC CtApImageProcess_FreeRunning.PpPdImageProcess_FreeRunningRead.DeImageProcess_Normal.DeData.stCamInt_fu_or_hfov_at_cv "" VALUE 0x25f0038 __FLOAT32_IEEE_S 0 NO_COMPU_METHOD 0 3.402823e+38 ECU_ADDRESS_EXTENSION 0x80 /end CHARACTERISTIC
/begin CHARACTERISTIC CtApImageProcess_FreeRunning.PpPdImageProcess_FreeRunningRead.DeImageProcess_Normal.DeData.stCamInt_use_fov "" VALUE 0x25f003c __SLONG_S 0 NO_COMPU_METHOD -2147483648 2147483647 ECU_ADDRESS_EXTENSION 0x80 /end CHARACTERISTIC
/begin CHARACTERISTIC CtApImageProcess_FreeRunning.PpPdImageProcess_FreeRunningRead.DeImageProcess_Normal.DeData.stCamInt_lut "" VALUE 0x25f0040 __SLONG_S 0 NO_COMPU_METHOD -2147483648 2147483647 ECU_ADDRESS_EXTENSION 0x80 /end CHARACTERISTIC
/begin CHARACTERISTIC CtApImageProcess_FreeRunning.PpPdImageProcess_FreeRunningRead.DeImageProcess_Normal.DeData.stCamExt_rx "" VALUE 0x25f0044 __FLOAT32_IEEE_S 0 NO_COMPU_METHOD 0 3.402823e+38 ECU_ADDRESS_EXTENSION 0x80 /end CHARACTERISTIC
/begin CHARACTERISTIC CtApImageProcess_FreeRunning.PpPdImageProcess_FreeRunningRead.DeImageProcess_Normal.DeData.stCamExt_ry "" VALUE 0x25f0048 __FLOAT32_IEEE_S 0 NO_COMPU_METHOD 0 3.402823e+38 ECU_ADDRESS_EXTENSION 0x80 /end CHARACTERISTIC
/begin CHARACTERISTIC CtApImageProcess_FreeRunning.PpPdImageProcess_FreeRunningRead.DeImageProcess_Normal.DeData.stCamExt_rz "" VALUE 0x25f004c __FLOAT32_IEEE_S 0 NO_COMPU_METHOD 0 3.402823e+38 ECU_ADDRESS_EXTENSION 0x80 /end CHARACTERISTIC
/begin CHARACTERISTIC CtApImageProcess_FreeRunning.PpPdImageProcess_FreeRunningRead.DeImageProcess_Normal.DeData.stCamExt_tx "" VALUE 0x25f0050 __FLOAT32_IEEE_S 0 NO_COMPU_METHOD 0 3.402823e+38 ECU_ADDRESS_EXTENSION 0x80 /end CHARACTERISTIC
/begin CHARACTERISTIC CtApImageProcess_FreeRunning.PpPdImageProcess_FreeRunningRead.DeImageProcess_Normal.DeData.stCamExt_ty "" VALUE 0x25f0054 __FLOAT32_IEEE_S 0 NO_COMPU_METHOD 0 3.402823e+38 ECU_ADDRESS_EXTENSION 0x80 /end CHARACTERISTIC
/begin CHARACTERISTIC CtApImageProcess_FreeRunning.PpPdImageProcess_FreeRunningRead.DeImageProcess_Normal.DeData.stCamExt_tz "" VALUE 0x25f0058 __FLOAT32_IEEE_S 0 NO_COMPU_METHOD 0 3.402823e+38 ECU_ADDRESS_EXTENSION 0x80 /end CHARACTERISTIC
/begin CHARACTERISTIC CtApImageProcess_FreeRunning.PpPdImageProcess_FreeRunningRead.DeImageProcess_Normal.DeData.stCarParam_eachPulseDist "" VALUE 0x25f005c __FLOAT32_IEEE_S 0 NO_COMPU_METHOD 0 3.402823e+38 ECU_ADDRESS_EXTENSION 0x80 /end CHARACTERISTIC
/begin CHARACTERISTIC CtApImageProcess_FreeRunning.PpPdImageProcess_FreeRunningRead.DeImageProcess_Normal.DeData.stCarParam_frontWheelDriven "" VALUE 0x25f0060 __UBYTE_S 0 NO_COMPU_METHOD 0 255 ECU_ADDRESS_EXTENSION 0x80 /end CHARACTERISTIC
/begin CHARACTERISTIC CtApImageProcess_FreeRunning.PpPdImageProcess_FreeRunningRead.DeImageProcess_Normal.DeData.stCarParam_reserved "31 float32 array" VAL_BLK 0x25f0064 __FLOAT32_IEEE_S 0 NO_COMPU_METHOD 0 3.402823e+38 ECU_ADDRESS_EXTENSION 0x80 MATRIX_DIM 31 1 1 /end CHARACTERISTIC
/begin CHARACTERISTIC CtApImageProcess_FreeRunning.PpPdImageProcess_FreeRunningRead.DeImageProcess_Normal.DeData.stCarParam_gnMotionModelCalib_01 "200 uint8 array" VAL_BLK 0x25f00e0 __UBYTE_S 0 NO_COMPU_METHOD 0 255 ECU_ADDRESS_EXTENSION 0x80 MATRIX_DIM 200 1 1 /end CHARACTERISTIC
/begin CHARACTERISTIC CtApImageProcess_FreeRunning.PpPdImageProcess_FreeRunningRead.DeImageProcess_Normal.DeData.stCarParam_gnMotionModelCalib_02 "200 uint8 array" VAL_BLK 0x25f01a8 __UBYTE_S 0 NO_COMPU_METHOD 0 255 ECU_ADDRESS_EXTENSION 0x80 MATRIX_DIM 200 1 1 /end CHARACTERISTIC
/begin CHARACTERISTIC CtApImageProcess_FreeRunning.PpPdImageProcess_FreeRunningRead.DeImageProcess_Normal.DeData.stCarParam_gnMotionModelCalib_03 "200 uint8 array" VAL_BLK 0x25f0270 __UBYTE_S 0 NO_COMPU_METHOD 0 255 ECU_ADDRESS_EXTENSION 0x80 MATRIX_DIM 200 1 1 /end CHARACTERISTIC
/begin CHARACTERISTIC CtApImageProcess_FreeRunning.PpPdImageProcess_FreeRunningRead.DeImageProcess_Normal.DeData.stCarParam_gnMotionModelCalib_04 "200 uint8 array" VAL_BLK 0x25f0338 __UBYTE_S 0 NO_COMPU_METHOD 0 255 ECU_ADDRESS_EXTENSION 0x80 MATRIX_DIM 200 1 1 /end CHARACTERISTIC
/begin CHARACTERISTIC CtApImageProcess_FreeRunning.PpPdImageProcess_FreeRunningRead.DeImageProcess_Normal.DeData.stCarParam_gnMotionModelCalib_05 "200 uint8 array" VAL_BLK 0x25f0400 __UBYTE_S 0 NO_COMPU_METHOD 0 255 ECU_ADDRESS_EXTENSION 0x80 MATRIX_DIM 200 1 1 /end CHARACTERISTIC
/begin CHARACTERISTIC CtApImageProcess_FreeRunning.PpPdImageProcess_FreeRunningRead.DeImageProcess_Normal.DeData.stCarParam_gnMotionModelCalib_06 "200 uint8 array" VAL_BLK 0x25f04c8 __UBYTE_S 0 NO_COMPU_METHOD 0 255 ECU_ADDRESS_EXTENSION 0x80 MATRIX_DIM 200 1 1 /end CHARACTERISTIC
/begin CHARACTERISTIC CtApImageProcess_FreeRunning.PpPdImageProcess_FreeRunningRead.DeImageProcessSec_Normal.DeStatus "" VALUE 0x2600000 __UWORD_S 0 CtApImageProcess_FreeRunning.PpPdImageProcess_FreeRunningRead.DeImageProcessSec_Normal.DeStatus.Dt_ENUM_PdDatablockStatus.CONVERSION 0 65535 ECU_ADDRESS_EXTENSION 0x80 /end CHARACTERISTIC
/begin CHARACTERISTIC CtApImageProcess_FreeRunning.PpPdImageProcess_FreeRunningRead.DeImageProcessSec_Normal.DeVersion.DeExpectedVersion.DeMajor "" VALUE 0x2600004 __UBYTE_S 0 NO_COMPU_METHOD 0 255 ECU_ADDRESS_EXTENSION 0x80 /end CHARACTERISTIC
/begin CHARACTERISTIC CtApImageProcess_FreeRunning.PpPdImageProcess_FreeRunningRead.DeImageProcessSec_Normal.DeVersion.DeExpectedVersion.DeMinor "" VALUE 0x2600005 __UBYTE_S 0 NO_COMPU_METHOD 0 255 ECU_ADDRESS_EXTENSION 0x80 /end CHARACTERISTIC
/begin CHARACTERISTIC CtApImageProcess_FreeRunning.PpPdImageProcess_FreeRunningRead.DeImageProcessSec_Normal.DeVersion.DeVersion.DeMajor "" VALUE 0x2600008 __UBYTE_S 0 NO_COMPU_METHOD 0 255 ECU_ADDRESS_EXTENSION 0x80 /end CHARACTERISTIC
/begin CHARACTERISTIC CtApImageProcess_FreeRunning.PpPdImageProcess_FreeRunningRead.DeImageProcessSec_Normal.DeVersion.DeVersion.DeMinor "" VALUE 0x2600009 __UBYTE_S 0 NO_COMPU_METHOD 0 255 ECU_ADDRESS_EXTENSION 0x80 /end CHARACTERISTIC
/begin CHARACTERISTIC CtApImageProcess_FreeRunning.PpPdImageProcess_FreeRunningRead.DeImageProcessSec_Normal.DeData "150 uint8 array" VAL_BLK 0x260000c __UBYTE_S 0 NO_COMPU_METHOD 0 255 ECU_ADDRESS_EXTENSION 0x80 MATRIX_DIM 150 1 1 /end CHARACTERISTIC
/begin CHARACTERISTIC CtApImageProcess_FreeRunning.PpPfInformation.DeBuildDate.status "" VALUE 0x2610000 __UBYTE_S 0 NO_COMPU_METHOD 0 255 ECU_ADDRESS_EXTENSION 0x80 /end CHARACTERISTIC
/begin CHARACTERISTIC CtApImageProcess_FreeRunning.PpPfInformation.DeBuildDate.nanoseconds "" VALUE 0x2610004 __ULONG_S 0 NO_COMPU_METHOD 0 4294967295 ECU_ADDRESS_EXTENSION 0x80 /end CHARACTERISTIC
/begin CHARACTERISTIC CtApImageProcess_FreeRunning.PpPfInformation.DeBuildDate.seconds "" VALUE 0x2610008 __ULONG_S 0 NO_COMPU_METHOD 0 4294967295 ECU_ADDRESS_EXTENSION 0x80 /end CHARACTERISTIC
/begin CHARACTERISTIC CtApImageProcess_FreeRunning.PpPfInformation.DeBuildDate.secondsHigh "" VALUE 0x261000c __UWORD_S 0 NO_COMPU_METHOD 0 65535 ECU_ADDRESS_EXTENSION 0x80 /end CHARACTERISTIC
/begin CHARACTERISTIC CtApImageProcess_FreeRunning.PpPfInformation.DeBuildRevision "" VALUE 0x2620000 __ULONG_S 0 NO_COMPU_METHOD 0 4294967295 ECU_ADDRESS_EXTENSION 0x80 /end CHARACTERISTIC
/begin CHARACTERISTIC CtApImageProcess_FreeRunning.PpPfInformation.DePlatformVersion.DeMajor "" VALUE 0x2630000 __UBYTE_S 0 NO_COMPU_METHOD 0 255 ECU_ADDRESS_EXTENSION 0x80 /end CHARACTERISTIC
/begin CHARACTERISTIC CtApImageProcess_FreeRunning.PpPfInformation.DePlatformVersion.DeMinor "" VALUE 0x2630001 __UBYTE_S 0 NO_COMPU_METHOD 0 255 ECU_ADDRESS_EXTENSION 0x80 /end CHARACTERISTIC
/begin CHARACTERISTIC CtApImageProcess_FreeRunning.PpPfInformation.DePlatformVersion.DePatch "" VALUE 0x2630002 __UBYTE_S 0 NO_COMPU_METHOD 0 255 ECU_ADDRESS_EXTENSION 0x80 /end CHARACTERISTIC
/begin CHARACTERISTIC CtApImageProcess_FreeRunning.PpPfInformation.DeReleaseType "5 uint8 array" VAL_BLK 0x2640000 __UBYTE_S 0 NO_COMPU_METHOD 0 255 ECU_ADDRESS_EXTENSION 0x80 MATRIX_DIM 5 1 1 /end CHARACTERISTIC
/begin CHARACTERISTIC CtApImageProcess_FreeRunning.PpPfInformation.DeSystemVersion.DeMajor "" VALUE 0x2650000 __UBYTE_S 0 NO_COMPU_METHOD 0 255 ECU_ADDRESS_EXTENSION 0x80 /end CHARACTERISTIC
/begin CHARACTERISTIC CtApImageProcess_FreeRunning.PpPfInformation.DeSystemVersion.DeMinor "" VALUE 0x2650001 __UBYTE_S 0 NO_COMPU_METHOD 0 255 ECU_ADDRESS_EXTENSION 0x80 /end CHARACTERISTIC
/begin CHARACTERISTIC CtApImageProcess_FreeRunning.PpPfInformation.DeSystemVersion.DePatch "" VALUE 0x2650002 __UBYTE_S 0 NO_COMPU_METHOD 0 255 ECU_ADDRESS_EXTENSION 0x80 /end CHARACTERISTIC
/begin CHARACTERISTIC CtApImageProcess_FreeRunning.PpPFProvidedData.DeIFSETVersion.DeMajor "" VALUE 0x2660000 __UBYTE_S 0 NO_COMPU_METHOD 0 255 ECU_ADDRESS_EXTENSION 0x80 /end CHARACTERISTIC
/begin CHARACTERISTIC CtApImageProcess_FreeRunning.PpPFProvidedData.DeIFSETVersion.DeMinor "" VALUE 0x2660001 __UBYTE_S 0 NO_COMPU_METHOD 0 255 ECU_ADDRESS_EXTENSION 0x80 /end CHARACTERISTIC
/begin CHARACTERISTIC CtApImageProcess_FreeRunning.PpPFProvidedData.DeIFSETVersion.DePatch "" VALUE 0x2660002 __UBYTE_S 0 NO_COMPU_METHOD 0 255 ECU_ADDRESS_EXTENSION 0x80 /end CHARACTERISTIC
/begin CHARACTERISTIC CtApImageProcess_FreeRunning.PpPFProvidedData.DeLCSPH00State "" VALUE 0x2670000 __UBYTE_S 0 CtApImageProcess_FreeRunning.PpPFProvidedData.DeLCSPH00State.Dt_ENUM_LCS_State.CONVERSION 0 255 ECU_ADDRESS_EXTENSION 0x80 /end CHARACTERISTIC
/begin CHARACTERISTIC CtApImageProcess_FreeRunning.PpPFProvidedData.DeLCSSH00State "" VALUE 0x2680000 __UBYTE_S 0 CtApImageProcess_FreeRunning.PpPFProvidedData.DeLCSSH00State.Dt_ENUM_LCS_State.CONVERSION 0 255 ECU_ADDRESS_EXTENSION 0x80 /end CHARACTERISTIC
/begin CHARACTERISTIC CtApImageProcess_FreeRunning.PpPFProvidedData.DeLCSSH01State "" VALUE 0x2690000 __UBYTE_S 0 CtApImageProcess_FreeRunning.PpPFProvidedData.DeLCSSH01State.Dt_ENUM_LCS_State.CONVERSION 0 255 ECU_ADDRESS_EXTENSION 0x80 /end CHARACTERISTIC
/begin CHARACTERISTIC CtApImageProcess_FreeRunning.PpPFProvidedData.DeLCSSystemState "" VALUE 0x26a0000 __UBYTE_S 0 CtApImageProcess_FreeRunning.PpPFProvidedData.DeLCSSystemState.Dt_ENUM_LCS_State.CONVERSION 0 255 ECU_ADDRESS_EXTENSION 0x80 /end CHARACTERISTIC
/begin CHARACTERISTIC CtApImageProcess_FreeRunning.PpPFProvidedData.DeVARHWVariant "" VALUE 0x26b0000 __UBYTE_S 0 CtApImageProcess_FreeRunning.PpPFProvidedData.DeVARHWVariant.Dt_ENUM_VAR_HWVariant.CONVERSION 0 255 ECU_ADDRESS_EXTENSION 0x80 /end CHARACTERISTIC
/begin CHARACTERISTIC CtApImageProcess_FreeRunning.PpStateMonitor_FailureAction_50ms.DeFltActnReq.stHeader.Counter "" VALUE 0x26c0000 __UWORD_S 0 NO_COMPU_METHOD 0 65535 ECU_ADDRESS_EXTENSION 0x80 /end CHARACTERISTIC
/begin CHARACTERISTIC CtApImageProcess_FreeRunning.PpStateMonitor_FailureAction_50ms.DeFltActnReq.stHeader.FrameID "" VALUE 0x26c0002 __UBYTE_S 0 NO_COMPU_METHOD 0 255 ECU_ADDRESS_EXTENSION 0x80 /end CHARACTERISTIC
/begin CHARACTERISTIC CtApImageProcess_FreeRunning.PpStateMonitor_FailureAction_50ms.DeFltActnReq.stHeader.TimeStamp "2 uint32 array" VAL_BLK 0x26c0004 __ULONG_S 0 NO_COMPU_METHOD 0 4294967295 ECU_ADDRESS_EXTENSION 0x80 MATRIX_DIM 2 1 1 /end CHARACTERISTIC
/begin CHARACTERISTIC CtApImageProcess_FreeRunning.PpStateMonitor_FailureAction_50ms.DeFltActnReq.FltActnReq "" VALUE 0x26c000c __ULONG_S 0 NO_COMPU_METHOD 0 4294967295 ECU_ADDRESS_EXTENSION 0x80 /end CHARACTERISTIC
/begin CHARACTERISTIC CtApImageProcess_FreeRunning.PpStateMonitor_FailureAction_50ms.DeFltActnReq.Reserved "" VALUE 0x26c0010 __ULONG_S 0 NO_COMPU_METHOD 0 4294967295 ECU_ADDRESS_EXTENSION 0x80 /end CHARACTERISTIC
/begin CHARACTERISTIC CtApImageProcess_FreeRunning.PpStateMonitor_FailureAction_50ms.DeFltIndicator.stHeader.Counter "" VALUE 0x26d0000 __UWORD_S 0 NO_COMPU_METHOD 0 65535 ECU_ADDRESS_EXTENSION 0x80 /end CHARACTERISTIC
/begin CHARACTERISTIC CtApImageProcess_FreeRunning.PpStateMonitor_FailureAction_50ms.DeFltIndicator.stHeader.FrameID "" VALUE 0x26d0002 __UBYTE_S 0 NO_COMPU_METHOD 0 255 ECU_ADDRESS_EXTENSION 0x80 /end CHARACTERISTIC
/begin CHARACTERISTIC CtApImageProcess_FreeRunning.PpStateMonitor_FailureAction_50ms.DeFltIndicator.stHeader.TimeStamp "2 uint32 array" VAL_BLK 0x26d0004 __ULONG_S 0 NO_COMPU_METHOD 0 4294967295 ECU_ADDRESS_EXTENSION 0x80 MATRIX_DIM 2 1 1 /end CHARACTERISTIC
/begin CHARACTERISTIC CtApImageProcess_FreeRunning.PpStateMonitor_FailureAction_50ms.DeFltIndicator.PilotFltSt "" VALUE 0x26d000c __UBYTE_S 0 NO_COMPU_METHOD 0 255 ECU_ADDRESS_EXTENSION 0x80 /end CHARACTERISTIC
/begin CHARACTERISTIC CtApImageProcess_FreeRunning.PpStateMonitor_FailureAction_50ms.DeFltIndicator.ACCtFltSt "" VALUE 0x26d000d __UBYTE_S 0 NO_COMPU_METHOD 0 255 ECU_ADDRESS_EXTENSION 0x80 /end CHARACTERISTIC
/begin CHARACTERISTIC CtApImageProcess_FreeRunning.PpStateMonitor_FailureAction_50ms.DeFltIndicator.ParkingtFltSt "" VALUE 0x26d000e __UBYTE_S 0 NO_COMPU_METHOD 0 255 ECU_ADDRESS_EXTENSION 0x80 /end CHARACTERISTIC
/begin CHARACTERISTIC CtApImageProcess_FreeRunning.PpStateMonitor_FailureAction_50ms.DeFltIndicator.SwDTCReq "" VALUE 0x26d000f __UBYTE_S 0 NO_COMPU_METHOD 0 255 ECU_ADDRESS_EXTENSION 0x80 /end CHARACTERISTIC
/begin CHARACTERISTIC CtApImageProcess_FreeRunning.PpStateMonitor_FailureAction_50ms.DeFltIndicator.DataRecReq "" VALUE 0x26d0010 __UBYTE_S 0 NO_COMPU_METHOD 0 255 ECU_ADDRESS_EXTENSION 0x80 /end CHARACTERISTIC
/begin CHARACTERISTIC CtApImageProcess_FreeRunning.PpStateMonitor_FailureAction_50ms.DeFltIndicator.reserved "" VALUE 0x26d0014 __ULONG_S 0 NO_COMPU_METHOD 0 4294967295 ECU_ADDRESS_EXTENSION 0x80 /end CHARACTERISTIC
/begin CHARACTERISTIC CtApImageProcess_FreeRunning.PpStateMonitor_FailureAction_50ms.DeStateMonitor_BKP.StateMonitor_BKP "32 uint8 array" VAL_BLK 0x26e0000 __UBYTE_S 0 NO_COMPU_METHOD 0 255 ECU_ADDRESS_EXTENSION 0x80 MATRIX_DIM 32 1 1 /end CHARACTERISTIC
/begin CHARACTERISTIC CtApImageProcess_FreeRunning.PpSysManager_DrivingModeSts_50ms.DeDrivingModeSts.stHeader.Counter "" VALUE 0x26f0000 __UWORD_S 0 NO_COMPU_METHOD 0 65535 ECU_ADDRESS_EXTENSION 0x80 /end CHARACTERISTIC
/begin CHARACTERISTIC CtApImageProcess_FreeRunning.PpSysManager_DrivingModeSts_50ms.DeDrivingModeSts.stHeader.FrameID "" VALUE 0x26f0002 __UBYTE_S 0 NO_COMPU_METHOD 0 255 ECU_ADDRESS_EXTENSION 0x80 /end CHARACTERISTIC
/begin CHARACTERISTIC CtApImageProcess_FreeRunning.PpSysManager_DrivingModeSts_50ms.DeDrivingModeSts.stHeader.TimeStamp "2 uint32 array" VAL_BLK 0x26f0004 __ULONG_S 0 NO_COMPU_METHOD 0 4294967295 ECU_ADDRESS_EXTENSION 0x80 MATRIX_DIM 2 1 1 /end CHARACTERISTIC
/begin CHARACTERISTIC CtApImageProcess_FreeRunning.PpSysManager_DrivingModeSts_50ms.DeDrivingModeSts.nWarningLevel "" VALUE 0x26f000c __UBYTE_S 0 NO_COMPU_METHOD 0 255 ECU_ADDRESS_EXTENSION 0x80 /end CHARACTERISTIC
/begin CHARACTERISTIC CtApImageProcess_FreeRunning.PpSysManager_DrivingModeSts_50ms.DeDrivingModeSts.nDrivingStatus "" VALUE 0x26f000d __UBYTE_S 0 NO_COMPU_METHOD 0 255 ECU_ADDRESS_EXTENSION 0x80 /end CHARACTERISTIC
/begin CHARACTERISTIC CtApImageProcess_FreeRunning.PpSysManager_DrivingModeSts_50ms.DeDrivingModeSts.nDrivingMode "" VALUE 0x26f000e __UBYTE_S 0 NO_COMPU_METHOD 0 255 ECU_ADDRESS_EXTENSION 0x80 /end CHARACTERISTIC
/begin CHARACTERISTIC CtApImageProcess_FreeRunning.PpSysManager_DrivingModeSts_50ms.DeDrivingModeSts.ngBKP "10 uint8 array" VAL_BLK 0x26f000f __UBYTE_S 0 NO_COMPU_METHOD 0 255 ECU_ADDRESS_EXTENSION 0x80 MATRIX_DIM 10 1 1 /end CHARACTERISTIC
/begin CHARACTERISTIC CtApImageProcess_FreeRunning.PpSysManager_MobileyeGenericSensor_10ms.DeMobileyeGenericSensor.Steering_Wheel_Anglesecinfo "" VALUE 0x2700000 __FLOAT32_IEEE_S 0 NO_COMPU_METHOD 0 3.402823e+38 ECU_ADDRESS_EXTENSION 0x80 /end CHARACTERISTIC
/begin CHARACTERISTIC CtApImageProcess_FreeRunning.PpSysManager_MobileyeGenericSensor_10ms.DeMobileyeGenericSensor.Left_Blinksecinfo "" VALUE 0x2700004 __UBYTE_S 0 NO_COMPU_METHOD 0 1 ECU_ADDRESS_EXTENSION 0x80 /end CHARACTERISTIC
/begin CHARACTERISTIC CtApImageProcess_FreeRunning.PpSysManager_MobileyeGenericSensor_10ms.DeMobileyeGenericSensor.Yaw_Ratesecinfo "" VALUE 0x2700008 __FLOAT32_IEEE_S 0 NO_COMPU_METHOD 0 3.402823e+38 ECU_ADDRESS_EXTENSION 0x80 /end CHARACTERISTIC
/begin CHARACTERISTIC CtApImageProcess_FreeRunning.PpSysManager_MobileyeGenericSensor_10ms.DeMobileyeGenericSensor.Vehicle_Speedsecinfo "" VALUE 0x270000c __FLOAT32_IEEE_S 0 NO_COMPU_METHOD 0 3.402823e+38 ECU_ADDRESS_EXTENSION 0x80 /end CHARACTERISTIC
/begin CHARACTERISTIC CtApImageProcess_FreeRunning.PpSysManager_MobileyeGenericSensor_10ms.DeMobileyeGenericSensor.Wiperssecinfo "" VALUE 0x2700010 __UBYTE_S 0 NO_COMPU_METHOD 0 255 ECU_ADDRESS_EXTENSION 0x80 /end CHARACTERISTIC
/begin CHARACTERISTIC CtApImageProcess_FreeRunning.PpSysManager_MobileyeGenericSensor_10ms.DeMobileyeGenericSensor.Right_Blinksecinfo "" VALUE 0x2700011 __UBYTE_S 0 NO_COMPU_METHOD 0 1 ECU_ADDRESS_EXTENSION 0x80 /end CHARACTERISTIC
/begin CHARACTERISTIC CtApImageProcess_FreeRunning.PpSysManager_MobileyeGenericSensor_10ms.DeMobileyeGenericSensor.Reverse_Gearsecinfo "" VALUE 0x2700012 __UBYTE_S 0 NO_COMPU_METHOD 0 1 ECU_ADDRESS_EXTENSION 0x80 /end CHARACTERISTIC
/begin CHARACTERISTIC CtApImageProcess_FreeRunning.PpSysManager_MobileyeGenericSensor_10ms.DeMobileyeGenericSensor.High_Beamsecinfo "" VALUE 0x2700013 __UBYTE_S 0 NO_COMPU_METHOD 0 1 ECU_ADDRESS_EXTENSION 0x80 /end CHARACTERISTIC
/begin CHARACTERISTIC CtApImageProcess_FreeRunning.PpSysManager_MobileyeGenericSensor_10ms.DeMobileyeGenericSensor.Brakessecinfo "" VALUE 0x2700014 __UBYTE_S 0 NO_COMPU_METHOD 0 1 ECU_ADDRESS_EXTENSION 0x80 /end CHARACTERISTIC
/begin CHARACTERISTIC CtApImageProcess_FreeRunning.PpSysManager_MobileyeGenericSensor_10ms.DeMobileyeGenericSensor.stHeader.Counter "" VALUE 0x2700018 __UWORD_S 0 NO_COMPU_METHOD 0 65535 ECU_ADDRESS_EXTENSION 0x80 /end CHARACTERISTIC
/begin CHARACTERISTIC CtApImageProcess_FreeRunning.PpSysManager_MobileyeGenericSensor_10ms.DeMobileyeGenericSensor.stHeader.FrameID "" VALUE 0x270001a __UBYTE_S 0 NO_COMPU_METHOD 0 255 ECU_ADDRESS_EXTENSION 0x80 /end CHARACTERISTIC
/begin CHARACTERISTIC CtApImageProcess_FreeRunning.PpSysManager_MobileyeGenericSensor_10ms.DeMobileyeGenericSensor.stHeader.TimeStamp "2 uint32 array" VAL_BLK 0x270001c __ULONG_S 0 NO_COMPU_METHOD 0 4294967295 ECU_ADDRESS_EXTENSION 0x80 MATRIX_DIM 2 1 1 /end CHARACTERISTIC
/begin CHARACTERISTIC CtApImageProcess_FreeRunning.PpSysManager_VCUInfo_100ms.DeVMS_VCUStatus5.RdFrictionCoefficientHSC4 "" VALUE 0x2710000 __FLOAT32_IEEE_S 0 NO_COMPU_METHOD 0 3.402823e+38 ECU_ADDRESS_EXTENSION 0x80 /end CHARACTERISTIC
/begin CHARACTERISTIC CtApImageProcess_FreeRunning.PpSysManager_VCUInfo_100ms.DeVMS_VCUStatus5.StrgWhlAngGrdLmtHSC4 "" VALUE 0x2710004 __SWORD_S 0 NO_COMPU_METHOD -32768 32767 ECU_ADDRESS_EXTENSION 0x80 /end CHARACTERISTIC
/begin CHARACTERISTIC CtApImageProcess_FreeRunning.PpSysManager_VCUInfo_100ms.DeVMS_VCUStatus5.StrgWhlAngLmtHSC4 "" VALUE 0x2710008 __FLOAT32_IEEE_S 0 NO_COMPU_METHOD 0 3.402823e+38 ECU_ADDRESS_EXTENSION 0x80 /end CHARACTERISTIC
/begin CHARACTERISTIC CtApImageProcess_FreeRunning.PpSysManager_VCUInfo_100ms.DeVMS_VCUStatus5.VehAcceLmtHSC4 "" VALUE 0x271000c __FLOAT32_IEEE_S 0 NO_COMPU_METHOD 0 3.402823e+38 ECU_ADDRESS_EXTENSION 0x80 /end CHARACTERISTIC
/begin CHARACTERISTIC CtApImageProcess_FreeRunning.PpSysManager_VCUInfo_100ms.DeVMS_VCUStatus5.VehDeceLmtHSC4 "" VALUE 0x2710010 __FLOAT32_IEEE_S 0 NO_COMPU_METHOD 0 3.402823e+38 ECU_ADDRESS_EXTENSION 0x80 /end CHARACTERISTIC
/begin CHARACTERISTIC CtApImageProcess_FreeRunning.PpSysManager_VCUInfo_100ms.DeVMS_VCUStatus5.stHeader.Counter "" VALUE 0x2710014 __UWORD_S 0 NO_COMPU_METHOD 0 65535 ECU_ADDRESS_EXTENSION 0x80 /end CHARACTERISTIC
/begin CHARACTERISTIC CtApImageProcess_FreeRunning.PpSysManager_VCUInfo_100ms.DeVMS_VCUStatus5.stHeader.FrameID "" VALUE 0x2710016 __UBYTE_S 0 NO_COMPU_METHOD 0 255 ECU_ADDRESS_EXTENSION 0x80 /end CHARACTERISTIC
/begin CHARACTERISTIC CtApImageProcess_FreeRunning.PpSysManager_VCUInfo_100ms.DeVMS_VCUStatus5.stHeader.TimeStamp "2 uint32 array" VAL_BLK 0x2710018 __ULONG_S 0 NO_COMPU_METHOD 0 4294967295 ECU_ADDRESS_EXTENSION 0x80 MATRIX_DIM 2 1 1 /end CHARACTERISTIC
/begin CHARACTERISTIC CtApImageProcess_FreeRunning.PpSysManager_VCUInfo_100ms.DeVMS_VCUStatus5.AutodDrvngSysSts "" VALUE 0x2710020 __UBYTE_S 0 NO_COMPU_METHOD 0 255 ECU_ADDRESS_EXTENSION 0x80 /end CHARACTERISTIC
/begin CHARACTERISTIC CtApImageProcess_FreeRunning.PpSysManager_VCUInfo_100ms.DeVMS_VCUStatus5.AIParkngSts "" VALUE 0x2710021 __UBYTE_S 0 NO_COMPU_METHOD 0 255 ECU_ADDRESS_EXTENSION 0x80 /end CHARACTERISTIC
/begin CHARACTERISTIC CtApImageProcess_FreeRunning.PpSysManager_VCUInfo_100ms.DeVMS_VCUStatus5.White_Body_Color "" VALUE 0x2710022 __UWORD_S 0 NO_COMPU_METHOD 0 65535 ECU_ADDRESS_EXTENSION 0x80 /end CHARACTERISTIC
/begin CHARACTERISTIC CtApImageProcess_FreeRunning.PpSysManager_VCUInfo_10ms.DeVMS_BKP.VMS_BKP "10 float32 array" VAL_BLK 0x2720000 __FLOAT32_IEEE_S 0 NO_COMPU_METHOD 0 3.402823e+38 ECU_ADDRESS_EXTENSION 0x80 MATRIX_DIM 10 1 1 /end CHARACTERISTIC
/begin CHARACTERISTIC CtApImageProcess_FreeRunning.PpSysManager_VCUInfo_10ms.DeVMS_VCUStatus10.RNonDrvnWhlRotlDistVHSC2 "" VALUE 0x2730000 __UBYTE_S 0 NO_COMPU_METHOD 0 1 ECU_ADDRESS_EXTENSION 0x80 /end CHARACTERISTIC
/begin CHARACTERISTIC CtApImageProcess_FreeRunning.PpSysManager_VCUInfo_10ms.DeVMS_VCUStatus10.RNonDrvnWhlRotlDistPCHSC2 "" VALUE 0x2730002 __UWORD_S 0 NO_COMPU_METHOD 0 65535 ECU_ADDRESS_EXTENSION 0x80 /end CHARACTERISTIC
/begin CHARACTERISTIC CtApImageProcess_FreeRunning.PpSysManager_VCUInfo_10ms.DeVMS_VCUStatus10.RDrvnWhlRotlDistVHSC2 "" VALUE 0x2730004 __UBYTE_S 0 NO_COMPU_METHOD 0 1 ECU_ADDRESS_EXTENSION 0x80 /end CHARACTERISTIC
/begin CHARACTERISTIC CtApImageProcess_FreeRunning.PpSysManager_VCUInfo_10ms.DeVMS_VCUStatus10.RDrvnWhlRotlDistPlsCtrHSC2 "" VALUE 0x2730006 __UWORD_S 0 NO_COMPU_METHOD 0 65535 ECU_ADDRESS_EXTENSION 0x80 /end CHARACTERISTIC
/begin CHARACTERISTIC CtApImageProcess_FreeRunning.PpSysManager_VCUInfo_10ms.DeVMS_VCUStatus10.LDrvnWhlRotlDistVHSC2 "" VALUE 0x2730008 __UBYTE_S 0 NO_COMPU_METHOD 0 1 ECU_ADDRESS_EXTENSION 0x80 /end CHARACTERISTIC
/begin CHARACTERISTIC CtApImageProcess_FreeRunning.PpSysManager_VCUInfo_10ms.DeVMS_VCUStatus10.LNonDrvnWhlRotlDistPCHSC2 "" VALUE 0x273000a __UWORD_S 0 NO_COMPU_METHOD 0 65535 ECU_ADDRESS_EXTENSION 0x80 /end CHARACTERISTIC
/begin CHARACTERISTIC CtApImageProcess_FreeRunning.PpSysManager_VCUInfo_10ms.DeVMS_VCUStatus10.LNonDrvnWhlRotlDistVHSC2 "" VALUE 0x273000c __UBYTE_S 0 NO_COMPU_METHOD 0 1 ECU_ADDRESS_EXTENSION 0x80 /end CHARACTERISTIC
/begin CHARACTERISTIC CtApImageProcess_FreeRunning.PpSysManager_VCUInfo_10ms.DeVMS_VCUStatus10.LDrvnWhlRotlDistPlsCtrHSC2 "" VALUE 0x273000e __UWORD_S 0 NO_COMPU_METHOD 0 65535 ECU_ADDRESS_EXTENSION 0x80 /end CHARACTERISTIC
/begin CHARACTERISTIC CtApImageProcess_FreeRunning.PpSysManager_VCUInfo_10ms.DeVMS_VCUStatus10.stHeader.Counter "" VALUE 0x2730010 __UWORD_S 0 NO_COMPU_METHOD 0 65535 ECU_ADDRESS_EXTENSION 0x80 /end CHARACTERISTIC
/begin CHARACTERISTIC CtApImageProcess_FreeRunning.PpSysManager_VCUInfo_10ms.DeVMS_VCUStatus10.stHeader.FrameID "" VALUE 0x2730012 __UBYTE_S 0 NO_COMPU_METHOD 0 255 ECU_ADDRESS_EXTENSION 0x80 /end CHARACTERISTIC
/begin CHARACTERISTIC CtApImageProcess_FreeRunning.PpSysManager_VCUInfo_10ms.DeVMS_VCUStatus10.stHeader.TimeStamp "2 uint32 array" VAL_BLK 0x2730014 __ULONG_S 0 NO_COMPU_METHOD 0 4294967295 ECU_ADDRESS_EXTENSION 0x80 MATRIX_DIM 2 1 1 /end CHARACTERISTIC
/begin CHARACTERISTIC CtApImageProcess_FreeRunning.PpSysManager_VCUInfo_10ms.DeVMS_VCUStatus10.fPtBrkPdlInptHSC4 "" VALUE 0x273001c __FLOAT32_IEEE_S 0 NO_COMPU_METHOD 0 3.402823e+38 ECU_ADDRESS_EXTENSION 0x80 /end CHARACTERISTIC
/begin CHARACTERISTIC CtApImageProcess_FreeRunning.PpSysManager_VCUInfo_10ms.DeVMS_VCUStatus2.StrgWhlAngHSC4 "" VALUE 0x2740000 __FLOAT32_IEEE_S 0 NO_COMPU_METHOD 0 3.402823e+38 ECU_ADDRESS_EXTENSION 0x80 /end CHARACTERISTIC
/begin CHARACTERISTIC CtApImageProcess_FreeRunning.PpSysManager_VCUInfo_10ms.DeVMS_VCUStatus2.StrgWhlAngAlvRCHSC4 "" VALUE 0x2740004 __UBYTE_S 0 NO_COMPU_METHOD 0 255 ECU_ADDRESS_EXTENSION 0x80 /end CHARACTERISTIC
/begin CHARACTERISTIC CtApImageProcess_FreeRunning.PpSysManager_VCUInfo_10ms.DeVMS_VCUStatus2.StrgWhlAngExtdPVHSC4 "" VALUE 0x2740006 __UWORD_S 0 NO_COMPU_METHOD 0 65535 ECU_ADDRESS_EXTENSION 0x80 /end CHARACTERISTIC
/begin CHARACTERISTIC CtApImageProcess_FreeRunning.PpSysManager_VCUInfo_10ms.DeVMS_VCUStatus2.StrgWhlAngGrdHSC4 "" VALUE 0x2740008 __SWORD_S 0 NO_COMPU_METHOD -32768 32767 ECU_ADDRESS_EXTENSION 0x80 /end CHARACTERISTIC
/begin CHARACTERISTIC CtApImageProcess_FreeRunning.PpSysManager_VCUInfo_10ms.DeVMS_VCUStatus2.StrgWhlAngSnsrCalStsHSC4 "" VALUE 0x274000a __UBYTE_S 0 NO_COMPU_METHOD 0 255 ECU_ADDRESS_EXTENSION 0x80 /end CHARACTERISTIC
/begin CHARACTERISTIC CtApImageProcess_FreeRunning.PpSysManager_VCUInfo_10ms.DeVMS_VCUStatus2.StrgWhlAngSnsrChksmHSC4 "" VALUE 0x274000b __UBYTE_S 0 NO_COMPU_METHOD 0 255 ECU_ADDRESS_EXTENSION 0x80 /end CHARACTERISTIC
/begin CHARACTERISTIC CtApImageProcess_FreeRunning.PpSysManager_VCUInfo_10ms.DeVMS_VCUStatus2.StrgWhlAngSnsrFltHSC4 "" VALUE 0x274000c __UBYTE_S 0 NO_COMPU_METHOD 0 1 ECU_ADDRESS_EXTENSION 0x80 /end CHARACTERISTIC
/begin CHARACTERISTIC CtApImageProcess_FreeRunning.PpSysManager_VCUInfo_10ms.DeVMS_VCUStatus2.StrgWhlAngSnsrInidHSC4 "" VALUE 0x274000d __UBYTE_S 0 NO_COMPU_METHOD 0 1 ECU_ADDRESS_EXTENSION 0x80 /end CHARACTERISTIC
/begin CHARACTERISTIC CtApImageProcess_FreeRunning.PpSysManager_VCUInfo_10ms.DeVMS_VCUStatus2.StrgWhlAngSnsrMultCapbHSC4 "" VALUE 0x274000e __UBYTE_S 0 NO_COMPU_METHOD 0 1 ECU_ADDRESS_EXTENSION 0x80 /end CHARACTERISTIC
/begin CHARACTERISTIC CtApImageProcess_FreeRunning.PpSysManager_VCUInfo_10ms.DeVMS_VCUStatus2.StrgWhlAngVHSC4 "" VALUE 0x274000f __UBYTE_S 0 NO_COMPU_METHOD 0 1 ECU_ADDRESS_EXTENSION 0x80 /end CHARACTERISTIC
/begin CHARACTERISTIC CtApImageProcess_FreeRunning.PpSysManager_VCUInfo_10ms.DeVMS_VCUStatus2.stHeader.Counter "" VALUE 0x2740010 __UWORD_S 0 NO_COMPU_METHOD 0 65535 ECU_ADDRESS_EXTENSION 0x80 /end CHARACTERISTIC
/begin CHARACTERISTIC CtApImageProcess_FreeRunning.PpSysManager_VCUInfo_10ms.DeVMS_VCUStatus2.stHeader.FrameID "" VALUE 0x2740012 __UBYTE_S 0 NO_COMPU_METHOD 0 255 ECU_ADDRESS_EXTENSION 0x80 /end CHARACTERISTIC
/begin CHARACTERISTIC CtApImageProcess_FreeRunning.PpSysManager_VCUInfo_10ms.DeVMS_VCUStatus2.stHeader.TimeStamp "2 uint32 array" VAL_BLK 0x2740014 __ULONG_S 0 NO_COMPU_METHOD 0 4294967295 ECU_ADDRESS_EXTENSION 0x80 MATRIX_DIM 2 1 1 /end CHARACTERISTIC
/begin CHARACTERISTIC CtApImageProcess_FreeRunning.PpSysManager_VCUInfo_10ms.DeVMS_VCUStatus2.SCUShifterLvrPos "" VALUE 0x274001c __UBYTE_S 0 NO_COMPU_METHOD 0 255 ECU_ADDRESS_EXTENSION 0x80 /end CHARACTERISTIC
/begin CHARACTERISTIC CtApImageProcess_FreeRunning.PpSysManager_VCUInfo_10ms.DeVMS_VCUStatus9.VCUMainID "" VALUE 0x2750000 __UBYTE_S 0 NO_COMPU_METHOD 0 255 ECU_ADDRESS_EXTENSION 0x80 /end CHARACTERISTIC
/begin CHARACTERISTIC CtApImageProcess_FreeRunning.PpSysManager_VCUInfo_10ms.DeVMS_VCUStatus9.VCUAddonsID "" VALUE 0x2750001 __UBYTE_S 0 NO_COMPU_METHOD 0 255 ECU_ADDRESS_EXTENSION 0x80 /end CHARACTERISTIC
/begin CHARACTERISTIC CtApImageProcess_FreeRunning.PpSysManager_VCUInfo_10ms.DeVMS_VCUStatus9.Vehicleplatform "" VALUE 0x2750002 __UBYTE_S 0 NO_COMPU_METHOD 0 255 ECU_ADDRESS_EXTENSION 0x80 /end CHARACTERISTIC
/begin CHARACTERISTIC CtApImageProcess_FreeRunning.PpSysManager_VCUInfo_10ms.DeVMS_VCUStatus9.VCUstage "" VALUE 0x2750003 __UBYTE_S 0 NO_COMPU_METHOD 0 255 ECU_ADDRESS_EXTENSION 0x80 /end CHARACTERISTIC
/begin CHARACTERISTIC CtApImageProcess_FreeRunning.PpSysManager_VCUInfo_10ms.DeVMS_VCUStatus9.Projectname "" VALUE 0x2750004 __UBYTE_S 0 NO_COMPU_METHOD 0 255 ECU_ADDRESS_EXTENSION 0x80 /end CHARACTERISTIC
/begin CHARACTERISTIC CtApImageProcess_FreeRunning.PpSysManager_VCUInfo_10ms.DeVMS_VCUStatus9.Component "" VALUE 0x2750005 __UBYTE_S 0 NO_COMPU_METHOD 0 255 ECU_ADDRESS_EXTENSION 0x80 /end CHARACTERISTIC
/begin CHARACTERISTIC CtApImageProcess_FreeRunning.PpSysManager_VCUInfo_10ms.DeVMS_VCUStatus9.VehOdoHSC2 "" VALUE 0x2750008 __ULONG_S 0 NO_COMPU_METHOD 0 4294967295 ECU_ADDRESS_EXTENSION 0x80 /end CHARACTERISTIC
/begin CHARACTERISTIC CtApImageProcess_FreeRunning.PpSysManager_VCUInfo_10ms.DeVMS_VCUStatus9.stHeader.Counter "" VALUE 0x275000c __UWORD_S 0 NO_COMPU_METHOD 0 65535 ECU_ADDRESS_EXTENSION 0x80 /end CHARACTERISTIC
/begin CHARACTERISTIC CtApImageProcess_FreeRunning.PpSysManager_VCUInfo_10ms.DeVMS_VCUStatus9.stHeader.FrameID "" VALUE 0x275000e __UBYTE_S 0 NO_COMPU_METHOD 0 255 ECU_ADDRESS_EXTENSION 0x80 /end CHARACTERISTIC
/begin CHARACTERISTIC CtApImageProcess_FreeRunning.PpSysManager_VCUInfo_10ms.DeVMS_VCUStatus9.stHeader.TimeStamp "2 uint32 array" VAL_BLK 0x2750010 __ULONG_S 0 NO_COMPU_METHOD 0 4294967295 ECU_ADDRESS_EXTENSION 0x80 MATRIX_DIM 2 1 1 /end CHARACTERISTIC
/begin CHARACTERISTIC CtApImageProcess_FreeRunning.PpSysManager_VCUInfo_10ms.DeVMS_VCUStatus9.EPTRdy "" VALUE 0x2750018 __UBYTE_S 0 NO_COMPU_METHOD 0 1 ECU_ADDRESS_EXTENSION 0x80 /end CHARACTERISTIC
/begin CHARACTERISTIC CtApImageProcess_FreeRunning.PpSysManager_VCUInfo_10ms.DeVMS_VCUStatus9.SysPwrMd "" VALUE 0x2750019 __UBYTE_S 0 NO_COMPU_METHOD 0 255 ECU_ADDRESS_EXTENSION 0x80 /end CHARACTERISTIC
/begin CHARACTERISTIC CtApImageProcess_FreeRunning.PpSysManager_VCUInfo_200ms.DeVCUStatus8.TimeDspFmtHSC4 "" VALUE 0x2760000 __UBYTE_S 0 NO_COMPU_METHOD 0 1 ECU_ADDRESS_EXTENSION 0x80 /end CHARACTERISTIC
/begin CHARACTERISTIC CtApImageProcess_FreeRunning.PpSysManager_VCUInfo_200ms.DeVCUStatus8.SecsOfMinuteHSC4 "" VALUE 0x2760001 __UBYTE_S 0 NO_COMPU_METHOD 0 255 ECU_ADDRESS_EXTENSION 0x80 /end CHARACTERISTIC
/begin CHARACTERISTIC CtApImageProcess_FreeRunning.PpSysManager_VCUInfo_200ms.DeVCUStatus8.MinuteOfHourHSC4 "" VALUE 0x2760002 __UBYTE_S 0 NO_COMPU_METHOD 0 255 ECU_ADDRESS_EXTENSION 0x80 /end CHARACTERISTIC
/begin CHARACTERISTIC CtApImageProcess_FreeRunning.PpSysManager_VCUInfo_200ms.DeVCUStatus8.HourOfDayHSC4 "" VALUE 0x2760003 __UBYTE_S 0 NO_COMPU_METHOD 0 255 ECU_ADDRESS_EXTENSION 0x80 /end CHARACTERISTIC
/begin CHARACTERISTIC CtApImageProcess_FreeRunning.PpSysManager_VCUInfo_200ms.DeVCUStatus8.CalendarYearHSC4 "" VALUE 0x2760004 __UWORD_S 0 NO_COMPU_METHOD 0 65535 ECU_ADDRESS_EXTENSION 0x80 /end CHARACTERISTIC
/begin CHARACTERISTIC CtApImageProcess_FreeRunning.PpSysManager_VCUInfo_200ms.DeVCUStatus8.CalendarMonthHSC4 "" VALUE 0x2760006 __UBYTE_S 0 NO_COMPU_METHOD 0 255 ECU_ADDRESS_EXTENSION 0x80 /end CHARACTERISTIC
/begin CHARACTERISTIC CtApImageProcess_FreeRunning.PpSysManager_VCUInfo_200ms.DeVCUStatus8.CalendarDayHSC4 "" VALUE 0x2760007 __UBYTE_S 0 NO_COMPU_METHOD 0 255 ECU_ADDRESS_EXTENSION 0x80 /end CHARACTERISTIC
/begin CHARACTERISTIC CtApImageProcess_FreeRunning.PpSysManager_VCUInfo_200ms.DeVCUStatus8.stHeader.Counter "" VALUE 0x2760008 __UWORD_S 0 NO_COMPU_METHOD 0 65535 ECU_ADDRESS_EXTENSION 0x80 /end CHARACTERISTIC
/begin CHARACTERISTIC CtApImageProcess_FreeRunning.PpSysManager_VCUInfo_200ms.DeVCUStatus8.stHeader.FrameID "" VALUE 0x276000a __UBYTE_S 0 NO_COMPU_METHOD 0 255 ECU_ADDRESS_EXTENSION 0x80 /end CHARACTERISTIC
/begin CHARACTERISTIC CtApImageProcess_FreeRunning.PpSysManager_VCUInfo_200ms.DeVCUStatus8.stHeader.TimeStamp "2 uint32 array" VAL_BLK 0x276000c __ULONG_S 0 NO_COMPU_METHOD 0 4294967295 ECU_ADDRESS_EXTENSION 0x80 MATRIX_DIM 2 1 1 /end CHARACTERISTIC
/begin CHARACTERISTIC CtApImageProcess_FreeRunning.PpSysManager_VCUInfo_200ms.DeVMS_VCUStatus7_200ms.ACInCarTemHSC4 "" VALUE 0x2770000 __FLOAT32_IEEE_S 0 NO_COMPU_METHOD 0 3.402823e+38 ECU_ADDRESS_EXTENSION 0x80 /end CHARACTERISTIC
/begin CHARACTERISTIC CtApImageProcess_FreeRunning.PpSysManager_VCUInfo_200ms.DeVMS_VCUStatus7_200ms.FuelLvlPcntVHSC4 "" VALUE 0x2770004 __UBYTE_S 0 NO_COMPU_METHOD 0 1 ECU_ADDRESS_EXTENSION 0x80 /end CHARACTERISTIC
/begin CHARACTERISTIC CtApImageProcess_FreeRunning.PpSysManager_VCUInfo_200ms.DeVMS_VCUStatus7_200ms.FuelLvlPcntHSC4 "" VALUE 0x2770008 __FLOAT32_IEEE_S 0 NO_COMPU_METHOD 0 3.402823e+38 ECU_ADDRESS_EXTENSION 0x80 /end CHARACTERISTIC
/begin CHARACTERISTIC CtApImageProcess_FreeRunning.PpSysManager_VCUInfo_200ms.DeVMS_VCUStatus7_200ms.AmbtLghtLvlHSC4 "" VALUE 0x277000c __UBYTE_S 0 NO_COMPU_METHOD 0 255 ECU_ADDRESS_EXTENSION 0x80 /end CHARACTERISTIC
/begin CHARACTERISTIC CtApImageProcess_FreeRunning.PpSysManager_VCUInfo_200ms.DeVMS_VCUStatus7_200ms.OtsdAirTemCrValV_HSC4 "" VALUE 0x277000d __UBYTE_S 0 NO_COMPU_METHOD 0 1 ECU_ADDRESS_EXTENSION 0x80 /end CHARACTERISTIC
/begin CHARACTERISTIC CtApImageProcess_FreeRunning.PpSysManager_VCUInfo_200ms.DeVMS_VCUStatus7_200ms.OtsdAirTemCrVal_HSC4 "" VALUE 0x2770010 __FLOAT32_IEEE_S 0 NO_COMPU_METHOD 0 3.402823e+38 ECU_ADDRESS_EXTENSION 0x80 /end CHARACTERISTIC
/begin CHARACTERISTIC CtApImageProcess_FreeRunning.PpSysManager_VCUInfo_200ms.DeVMS_VCUStatus7_200ms.BrkLghtsStaHSC4 "" VALUE 0x2770014 __UBYTE_S 0 NO_COMPU_METHOD 0 1 ECU_ADDRESS_EXTENSION 0x80 /end CHARACTERISTIC
/begin CHARACTERISTIC CtApImageProcess_FreeRunning.PpSysManager_VCUInfo_200ms.DeVMS_VCUStatus7_200ms.DangerousWrnngLghtStaHSC4 "" VALUE 0x2770015 __UBYTE_S 0 NO_COMPU_METHOD 0 1 ECU_ADDRESS_EXTENSION 0x80 /end CHARACTERISTIC
/begin CHARACTERISTIC CtApImageProcess_FreeRunning.PpSysManager_VCUInfo_200ms.DeVMS_VCUStatus7_200ms.DipdBeamLampsStaHSC4 "" VALUE 0x2770016 __UBYTE_S 0 NO_COMPU_METHOD 0 1 ECU_ADDRESS_EXTENSION 0x80 /end CHARACTERISTIC
/begin CHARACTERISTIC CtApImageProcess_FreeRunning.PpSysManager_VCUInfo_200ms.DeVMS_VCUStatus7_200ms.FrtFogLampStaHSC4 "" VALUE 0x2770017 __UBYTE_S 0 NO_COMPU_METHOD 0 1 ECU_ADDRESS_EXTENSION 0x80 /end CHARACTERISTIC
/begin CHARACTERISTIC CtApImageProcess_FreeRunning.PpSysManager_VCUInfo_200ms.DeVMS_VCUStatus7_200ms.HornStaHSC4 "" VALUE 0x2770018 __UBYTE_S 0 NO_COMPU_METHOD 0 1 ECU_ADDRESS_EXTENSION 0x80 /end CHARACTERISTIC
/begin CHARACTERISTIC CtApImageProcess_FreeRunning.PpSysManager_VCUInfo_200ms.DeVMS_VCUStatus7_200ms.LDircnLampsStaHSC4 "" VALUE 0x2770019 __UBYTE_S 0 NO_COMPU_METHOD 0 1 ECU_ADDRESS_EXTENSION 0x80 /end CHARACTERISTIC
/begin CHARACTERISTIC CtApImageProcess_FreeRunning.PpSysManager_VCUInfo_200ms.DeVMS_VCUStatus7_200ms.MainBeamLampsStaHSC4 "" VALUE 0x277001a __UBYTE_S 0 NO_COMPU_METHOD 0 1 ECU_ADDRESS_EXTENSION 0x80 /end CHARACTERISTIC
/begin CHARACTERISTIC CtApImageProcess_FreeRunning.PpSysManager_VCUInfo_200ms.DeVMS_VCUStatus7_200ms.RDircnLampsStaHSC4 "" VALUE 0x277001b __UBYTE_S 0 NO_COMPU_METHOD 0 1 ECU_ADDRESS_EXTENSION 0x80 /end CHARACTERISTIC
/begin CHARACTERISTIC CtApImageProcess_FreeRunning.PpSysManager_VCUInfo_200ms.DeVMS_VCUStatus7_200ms.RevsngLghtStaHSC4 "" VALUE 0x277001c __UBYTE_S 0 NO_COMPU_METHOD 0 1 ECU_ADDRESS_EXTENSION 0x80 /end CHARACTERISTIC
/begin CHARACTERISTIC CtApImageProcess_FreeRunning.PpSysManager_VCUInfo_200ms.DeVMS_VCUStatus7_200ms.RrFogLampStaHSC4 "" VALUE 0x277001d __UBYTE_S 0 NO_COMPU_METHOD 0 1 ECU_ADDRESS_EXTENSION 0x80 /end CHARACTERISTIC
/begin CHARACTERISTIC CtApImageProcess_FreeRunning.PpSysManager_VCUInfo_200ms.DeVMS_VCUStatus7_200ms.WidthLampAndTaillightStateHSC4 "" VALUE 0x277001e __UBYTE_S 0 NO_COMPU_METHOD 0 1 ECU_ADDRESS_EXTENSION 0x80 /end CHARACTERISTIC
/begin CHARACTERISTIC CtApImageProcess_FreeRunning.PpSysManager_VCUInfo_200ms.DeVMS_VCUStatus7_200ms.WiperStaHSC4 "" VALUE 0x277001f __UBYTE_S 0 NO_COMPU_METHOD 0 255 ECU_ADDRESS_EXTENSION 0x80 /end CHARACTERISTIC
/begin CHARACTERISTIC CtApImageProcess_FreeRunning.PpSysManager_VCUInfo_200ms.DeVMS_VCUStatus7_200ms.WshrStaHSC4 "" VALUE 0x2770020 __UBYTE_S 0 NO_COMPU_METHOD 0 1 ECU_ADDRESS_EXTENSION 0x80 /end CHARACTERISTIC
/begin CHARACTERISTIC CtApImageProcess_FreeRunning.PpSysManager_VCUInfo_200ms.DeVMS_VCUStatus7_200ms.stHeader.Counter "" VALUE 0x2770024 __UWORD_S 0 NO_COMPU_METHOD 0 65535 ECU_ADDRESS_EXTENSION 0x80 /end CHARACTERISTIC
/begin CHARACTERISTIC CtApImageProcess_FreeRunning.PpSysManager_VCUInfo_200ms.DeVMS_VCUStatus7_200ms.stHeader.FrameID "" VALUE 0x2770026 __UBYTE_S 0 NO_COMPU_METHOD 0 255 ECU_ADDRESS_EXTENSION 0x80 /end CHARACTERISTIC
/begin CHARACTERISTIC CtApImageProcess_FreeRunning.PpSysManager_VCUInfo_200ms.DeVMS_VCUStatus7_200ms.stHeader.TimeStamp "2 uint32 array" VAL_BLK 0x2770028 __ULONG_S 0 NO_COMPU_METHOD 0 4294967295 ECU_ADDRESS_EXTENSION 0x80 MATRIX_DIM 2 1 1 /end CHARACTERISTIC
/begin CHARACTERISTIC CtApImageProcess_FreeRunning.PpSysManager_VCUInfo_20ms.DeVMS_VCUStatus3.SysVol_HSC4 "" VALUE 0x2780000 __FLOAT32_IEEE_S 0 NO_COMPU_METHOD 0 3.402823e+38 ECU_ADDRESS_EXTENSION 0x80 /end CHARACTERISTIC
/begin CHARACTERISTIC CtApImageProcess_FreeRunning.PpSysManager_VCUInfo_20ms.DeVMS_VCUStatus3.EPBAppcnStsHSC4 "" VALUE 0x2780004 __UBYTE_S 0 NO_COMPU_METHOD 0 255 ECU_ADDRESS_EXTENSION 0x80 /end CHARACTERISTIC
/begin CHARACTERISTIC CtApImageProcess_FreeRunning.PpSysManager_VCUInfo_20ms.DeVMS_VCUStatus3.VehSpdAvgVHSC4 "" VALUE 0x2780005 __UBYTE_S 0 NO_COMPU_METHOD 0 1 ECU_ADDRESS_EXTENSION 0x80 /end CHARACTERISTIC
/begin CHARACTERISTIC CtApImageProcess_FreeRunning.PpSysManager_VCUInfo_20ms.DeVMS_VCUStatus3.VehSpdAvgHSC4 "" VALUE 0x2780008 __FLOAT32_IEEE_S 0 NO_COMPU_METHOD 0 3.402823e+38 ECU_ADDRESS_EXTENSION 0x80 /end CHARACTERISTIC
/begin CHARACTERISTIC CtApImageProcess_FreeRunning.PpSysManager_VCUInfo_20ms.DeVMS_VCUStatus3.VSELongtAccVHSC4 "" VALUE 0x278000c __UBYTE_S 0 NO_COMPU_METHOD 0 1 ECU_ADDRESS_EXTENSION 0x80 /end CHARACTERISTIC
/begin CHARACTERISTIC CtApImageProcess_FreeRunning.PpSysManager_VCUInfo_20ms.DeVMS_VCUStatus3.VSELongtAccHSC4 "" VALUE 0x2780010 __FLOAT32_IEEE_S 0 NO_COMPU_METHOD 0 3.402823e+38 ECU_ADDRESS_EXTENSION 0x80 /end CHARACTERISTIC
/begin CHARACTERISTIC CtApImageProcess_FreeRunning.PpSysManager_VCUInfo_20ms.DeVMS_VCUStatus3.VehDynYawRateVHSC4 "" VALUE 0x2780014 __UBYTE_S 0 NO_COMPU_METHOD 0 1 ECU_ADDRESS_EXTENSION 0x80 /end CHARACTERISTIC
/begin CHARACTERISTIC CtApImageProcess_FreeRunning.PpSysManager_VCUInfo_20ms.DeVMS_VCUStatus3.VehDynYawRateHSC4 "" VALUE 0x2780018 __FLOAT32_IEEE_S 0 NO_COMPU_METHOD 0 3.402823e+38 ECU_ADDRESS_EXTENSION 0x80 /end CHARACTERISTIC
/begin CHARACTERISTIC CtApImageProcess_FreeRunning.PpSysManager_VCUInfo_20ms.DeVMS_VCUStatus3.AirbagDplHSC4 "" VALUE 0x278001c __UBYTE_S 0 NO_COMPU_METHOD 0 1 ECU_ADDRESS_EXTENSION 0x80 /end CHARACTERISTIC
/begin CHARACTERISTIC CtApImageProcess_FreeRunning.PpSysManager_VCUInfo_20ms.DeVMS_VCUStatus3.stHeader.Counter "" VALUE 0x2780020 __UWORD_S 0 NO_COMPU_METHOD 0 65535 ECU_ADDRESS_EXTENSION 0x80 /end CHARACTERISTIC
/begin CHARACTERISTIC CtApImageProcess_FreeRunning.PpSysManager_VCUInfo_20ms.DeVMS_VCUStatus3.stHeader.FrameID "" VALUE 0x2780022 __UBYTE_S 0 NO_COMPU_METHOD 0 255 ECU_ADDRESS_EXTENSION 0x80 /end CHARACTERISTIC
/begin CHARACTERISTIC CtApImageProcess_FreeRunning.PpSysManager_VCUInfo_20ms.DeVMS_VCUStatus3.stHeader.TimeStamp "2 uint32 array" VAL_BLK 0x2780024 __ULONG_S 0 NO_COMPU_METHOD 0 4294967295 ECU_ADDRESS_EXTENSION 0x80 MATRIX_DIM 2 1 1 /end CHARACTERISTIC
/begin CHARACTERISTIC CtApImageProcess_FreeRunning.PpSysManager_VCUInfo_20ms.DeVMS_VCUStatus3.APATrgtEPSStrgWhlAng "" VALUE 0x278002c __FLOAT32_IEEE_S 0 NO_COMPU_METHOD 0 3.402823e+38 ECU_ADDRESS_EXTENSION 0x80 /end CHARACTERISTIC
/begin CHARACTERISTIC CtApImageProcess_FreeRunning.PpSysManager_VCUInfo_20ms.DeVMS_VCUStatus3.APATrgtEPSStrgWhlAngV "" VALUE 0x2780030 __UBYTE_S 0 NO_COMPU_METHOD 0 1 ECU_ADDRESS_EXTENSION 0x80 /end CHARACTERISTIC
/begin CHARACTERISTIC CtApImageProcess_FreeRunning.PpSysManager_VCUInfo_20ms.DeVMS_VCUStatus3.LKAReqToq "" VALUE 0x2780034 __FLOAT32_IEEE_S 0 NO_COMPU_METHOD 0 3.402823e+38 ECU_ADDRESS_EXTENSION 0x80 /end CHARACTERISTIC
/begin CHARACTERISTIC CtApImageProcess_FreeRunning.PpSysManager_VCUInfo_20ms.DeVMS_VCUStatus3.APASCSAcclReqVal "" VALUE 0x2780038 __FLOAT32_IEEE_S 0 NO_COMPU_METHOD 0 3.402823e+38 ECU_ADDRESS_EXTENSION 0x80 /end CHARACTERISTIC
/begin CHARACTERISTIC CtApImageProcess_FreeRunning.PpSysManager_VCUInfo_20ms.DeVMS_VCUStatus3.ACCAccReqVal "" VALUE 0x278003c __FLOAT32_IEEE_S 0 NO_COMPU_METHOD 0 3.402823e+38 ECU_ADDRESS_EXTENSION 0x80 /end CHARACTERISTIC
/begin CHARACTERISTIC CtApImageProcess_FreeRunning.PpSysManager_VCUInfo_20ms.DeVMS_VCUStatus3.AEBDclReqVal_sech2SecHS2 "" VALUE 0x2780040 __FLOAT32_IEEE_S 0 NO_COMPU_METHOD 0 3.402823e+38 ECU_ADDRESS_EXTENSION 0x80 /end CHARACTERISTIC
/begin CHARACTERISTIC CtApImageProcess_FreeRunning.PpSysManager_VCUInfo_20ms.DeVMS_VCUStatus3.VSELongtAcc "" VALUE 0x2780044 __FLOAT32_IEEE_S 0 NO_COMPU_METHOD 0 3.402823e+38 ECU_ADDRESS_EXTENSION 0x80 /end CHARACTERISTIC
/begin CHARACTERISTIC CtApImageProcess_FreeRunning.PpSysManager_VCUInfo_20ms.DeVMS_VCUStatus3.DrvrStrgDlvrdToq "" VALUE 0x2780048 __FLOAT32_IEEE_S 0 NO_COMPU_METHOD 0 3.402823e+38 ECU_ADDRESS_EXTENSION 0x80 /end CHARACTERISTIC
/begin CHARACTERISTIC CtApImageProcess_FreeRunning.PpSysManager_VCUInfo_20ms.DeVMS_VCUStatus3.ChLKARespToq "" VALUE 0x278004c __FLOAT32_IEEE_S 0 NO_COMPU_METHOD 0 3.402823e+38 ECU_ADDRESS_EXTENSION 0x80 /end CHARACTERISTIC
/begin CHARACTERISTIC CtApImageProcess_FreeRunning.PpSysManager_VCUInfo_20ms.DeVMS_VCUStatus3.bkp "4 float32 array" VAL_BLK 0x2780050 __FLOAT32_IEEE_S 0 NO_COMPU_METHOD 0 3.402823e+38 ECU_ADDRESS_EXTENSION 0x80 MATRIX_DIM 4 1 1 /end CHARACTERISTIC
/begin CHARACTERISTIC CtApImageProcess_FreeRunning.PpSysManager_VCUInfo_20ms.DeVMS_VCUStatus3.ACCSysSts "" VALUE 0x2780060 __UBYTE_S 0 NO_COMPU_METHOD 0 255 ECU_ADDRESS_EXTENSION 0x80 /end CHARACTERISTIC
/begin CHARACTERISTIC CtApImageProcess_FreeRunning.PpSysManager_VCUInfo_20ms.DeVMS_VCUStatus3.TJAICASysSts "" VALUE 0x2780061 __UBYTE_S 0 NO_COMPU_METHOD 0 255 ECU_ADDRESS_EXTENSION 0x80 /end CHARACTERISTIC
/begin CHARACTERISTIC CtApImageProcess_FreeRunning.PpSysManager_VCUInfo_50ms.DeVMS_VCUStatus4.VehLckngStaHSC4 "" VALUE 0x2790000 __UBYTE_S 0 NO_COMPU_METHOD 0 1 ECU_ADDRESS_EXTENSION 0x80 /end CHARACTERISTIC
/begin CHARACTERISTIC CtApImageProcess_FreeRunning.PpSysManager_VCUInfo_50ms.DeVMS_VCUStatus4.FrtPsngDoorOpenStsHSC4 "" VALUE 0x2790001 __UBYTE_S 0 NO_COMPU_METHOD 0 255 ECU_ADDRESS_EXTENSION 0x80 /end CHARACTERISTIC
/begin CHARACTERISTIC CtApImageProcess_FreeRunning.PpSysManager_VCUInfo_50ms.DeVMS_VCUStatus4.DrvrDoorOpenStsHSC4 "" VALUE 0x2790002 __UBYTE_S 0 NO_COMPU_METHOD 0 255 ECU_ADDRESS_EXTENSION 0x80 /end CHARACTERISTIC
/begin CHARACTERISTIC CtApImageProcess_FreeRunning.PpSysManager_VCUInfo_50ms.DeVMS_VCUStatus4.VehInertiaSwTrigdHSC4 "" VALUE 0x2790003 __UBYTE_S 0 NO_COMPU_METHOD 0 1 ECU_ADDRESS_EXTENSION 0x80 /end CHARACTERISTIC
/begin CHARACTERISTIC CtApImageProcess_FreeRunning.PpSysManager_VCUInfo_50ms.DeVMS_VCUStatus4.BrkPdlDrvrAppdPrsV_HSC4 "" VALUE 0x2790004 __UBYTE_S 0 NO_COMPU_METHOD 0 1 ECU_ADDRESS_EXTENSION 0x80 /end CHARACTERISTIC
/begin CHARACTERISTIC CtApImageProcess_FreeRunning.PpSysManager_VCUInfo_50ms.DeVMS_VCUStatus4.BrkPdlDrvrAppdPrsAlvRC_HSC4 "" VALUE 0x2790005 __UBYTE_S 0 NO_COMPU_METHOD 0 255 ECU_ADDRESS_EXTENSION 0x80 /end CHARACTERISTIC
/begin CHARACTERISTIC CtApImageProcess_FreeRunning.PpSysManager_VCUInfo_50ms.DeVMS_VCUStatus4.BrkPdlDrvrAppdPrs_HSC4 "" VALUE 0x2790006 __UWORD_S 0 NO_COMPU_METHOD 0 65535 ECU_ADDRESS_EXTENSION 0x80 /end CHARACTERISTIC
/begin CHARACTERISTIC CtApImageProcess_FreeRunning.PpSysManager_VCUInfo_50ms.DeVMS_VCUStatus4.RLDoorOpenStsHS2 "" VALUE 0x2790008 __UBYTE_S 0 NO_COMPU_METHOD 0 255 ECU_ADDRESS_EXTENSION 0x80 /end CHARACTERISTIC
/begin CHARACTERISTIC CtApImageProcess_FreeRunning.PpSysManager_VCUInfo_50ms.DeVMS_VCUStatus4.RRDoorOpenStsHS2 "" VALUE 0x2790009 __UBYTE_S 0 NO_COMPU_METHOD 0 255 ECU_ADDRESS_EXTENSION 0x80 /end CHARACTERISTIC
/begin CHARACTERISTIC CtApImageProcess_FreeRunning.PpSysManager_VCUInfo_50ms.DeVMS_VCUStatus4.stHeader.Counter "" VALUE 0x279000c __UWORD_S 0 NO_COMPU_METHOD 0 65535 ECU_ADDRESS_EXTENSION 0x80 /end CHARACTERISTIC
/begin CHARACTERISTIC CtApImageProcess_FreeRunning.PpSysManager_VCUInfo_50ms.DeVMS_VCUStatus4.stHeader.FrameID "" VALUE 0x279000e __UBYTE_S 0 NO_COMPU_METHOD 0 255 ECU_ADDRESS_EXTENSION 0x80 /end CHARACTERISTIC
/begin CHARACTERISTIC CtApImageProcess_FreeRunning.PpSysManager_VCUInfo_50ms.DeVMS_VCUStatus4.stHeader.TimeStamp "2 uint32 array" VAL_BLK 0x2790010 __ULONG_S 0 NO_COMPU_METHOD 0 4294967295 ECU_ADDRESS_EXTENSION 0x80 MATRIX_DIM 2 1 1 /end CHARACTERISTIC
/begin CHARACTERISTIC CtApImageProcess_FreeRunning.PpSysManager_VCUInfo_50ms.DeVMS_VCUStatus4.BntOpenSts "" VALUE 0x2790018 __UBYTE_S 0 NO_COMPU_METHOD 0 255 ECU_ADDRESS_EXTENSION 0x80 /end CHARACTERISTIC
/begin CHARACTERISTIC CtApImageProcess_FreeRunning.PpSysManager_VCUInfo_50ms.DeVMS_VCUStatus4.LdSpcOpenSts "" VALUE 0x2790019 __UBYTE_S 0 NO_COMPU_METHOD 0 255 ECU_ADDRESS_EXTENSION 0x80 /end CHARACTERISTIC
/begin CHARACTERISTIC CtApImageProcess_FreeRunning.PpSysManager_VCUInfo_50ms.DeVMS_VCUStatus4.LongdAccSnsrVal "" VALUE 0x279001c __FLOAT32_IEEE_S 0 NO_COMPU_METHOD 0 3.402823e+38 ECU_ADDRESS_EXTENSION 0x80 /end CHARACTERISTIC
/begin CHARACTERISTIC CtApImageProcess_FreeRunning.PpSysManager_VCUInfo_50ms.DeVMS_VCUStatus4.bkp "4 float32 array" VAL_BLK 0x2790020 __FLOAT32_IEEE_S 0 NO_COMPU_METHOD 0 3.402823e+38 ECU_ADDRESS_EXTENSION 0x80 MATRIX_DIM 4 1 1 /end CHARACTERISTIC
/begin CHARACTERISTIC CtApImageProcess_FreeRunning.PpSysManager_VCUStatus1_10ms.DeVMS_VCUStatus1.DrivemModeStssecinfo "" VALUE 0x27a0000 __UBYTE_S 0 NO_COMPU_METHOD 0 255 ECU_ADDRESS_EXTENSION 0x80 /end CHARACTERISTIC
/begin CHARACTERISTIC CtApImageProcess_FreeRunning.PpSysManager_VCUStatus1_10ms.DeVMS_VCUStatus1.DriveModeReqsecinfo "" VALUE 0x27a0001 __UBYTE_S 0 NO_COMPU_METHOD 0 1 ECU_ADDRESS_EXTENSION 0x80 /end CHARACTERISTIC
/begin CHARACTERISTIC CtApImageProcess_FreeRunning.PpSysManager_VCUStatus1_10ms.DeVMS_VCUStatus1.EnSpdsecinfo "" VALUE 0x27a0004 __FLOAT32_IEEE_S 0 NO_COMPU_METHOD 0 3.402823e+38 ECU_ADDRESS_EXTENSION 0x80 /end CHARACTERISTIC
/begin CHARACTERISTIC CtApImageProcess_FreeRunning.PpSysManager_VCUStatus1_10ms.DeVMS_VCUStatus1.keep1secinfo "" VALUE 0x27a0008 __FLOAT32_IEEE_S 0 NO_COMPU_METHOD 0 3.402823e+38 ECU_ADDRESS_EXTENSION 0x80 /end CHARACTERISTIC
/begin CHARACTERISTIC CtApImageProcess_FreeRunning.PpSysManager_VCUStatus1_10ms.DeVMS_VCUStatus1.EPSMotOtptToqsecinfo "" VALUE 0x27a000c __FLOAT32_IEEE_S 0 NO_COMPU_METHOD 0 3.402823e+38 ECU_ADDRESS_EXTENSION 0x80 /end CHARACTERISTIC
/begin CHARACTERISTIC CtApImageProcess_FreeRunning.PpSysManager_VCUStatus1_10ms.DeVMS_VCUStatus1.SCUShiferLvrPossecinfo "" VALUE 0x27a0010 __UBYTE_S 0 NO_COMPU_METHOD 0 255 ECU_ADDRESS_EXTENSION 0x80 /end CHARACTERISTIC
/begin CHARACTERISTIC CtApImageProcess_FreeRunning.PpSysManager_VCUStatus1_10ms.DeVMS_VCUStatus1.PtBrkPdlDscrtInptStsVsecinfo "" VALUE 0x27a0011 __UBYTE_S 0 NO_COMPU_METHOD 0 1 ECU_ADDRESS_EXTENSION 0x80 /end CHARACTERISTIC
/begin CHARACTERISTIC CtApImageProcess_FreeRunning.PpSysManager_VCUStatus1_10ms.DeVMS_VCUStatus1.PtBrkPdlDscrtInptStssecinfo "" VALUE 0x27a0012 __UBYTE_S 0 NO_COMPU_METHOD 0 1 ECU_ADDRESS_EXTENSION 0x80 /end CHARACTERISTIC
/begin CHARACTERISTIC CtApImageProcess_FreeRunning.PpSysManager_VCUStatus6_50ms.DeVMS_VCUStatus6.WhlGndVelLDrvnVsecinfo "" VALUE 0x27b0000 __UBYTE_S 0 NO_COMPU_METHOD 0 1 ECU_ADDRESS_EXTENSION 0x80 /end CHARACTERISTIC
/begin CHARACTERISTIC CtApImageProcess_FreeRunning.PpSysManager_VCUStatus6_50ms.DeVMS_VCUStatus6.WhlGndVelLDrvnsecinfo "" VALUE 0x27b0004 __FLOAT32_IEEE_S 0 NO_COMPU_METHOD 0 3.402823e+38 ECU_ADDRESS_EXTENSION 0x80 /end CHARACTERISTIC
/begin CHARACTERISTIC CtApImageProcess_FreeRunning.PpSysManager_VCUStatus6_50ms.DeVMS_VCUStatus6.WhlGndVelRDrvnVsecinfo "" VALUE 0x27b0008 __UBYTE_S 0 NO_COMPU_METHOD 0 1 ECU_ADDRESS_EXTENSION 0x80 /end CHARACTERISTIC
/begin CHARACTERISTIC CtApImageProcess_FreeRunning.PpSysManager_VCUStatus6_50ms.DeVMS_VCUStatus6.WhlGndVelRDrvnsecinfo "" VALUE 0x27b000c __FLOAT32_IEEE_S 0 NO_COMPU_METHOD 0 3.402823e+38 ECU_ADDRESS_EXTENSION 0x80 /end CHARACTERISTIC
/begin CHARACTERISTIC CtApImageProcess_FreeRunning.PpSysManager_VCUStatus6_50ms.DeVMS_VCUStatus6.WhlGndVelLNonDrvnVsecinfo "" VALUE 0x27b0010 __UBYTE_S 0 NO_COMPU_METHOD 0 1 ECU_ADDRESS_EXTENSION 0x80 /end CHARACTERISTIC
/begin CHARACTERISTIC CtApImageProcess_FreeRunning.PpSysManager_VCUStatus6_50ms.DeVMS_VCUStatus6.WhlGndVelLNonDrvnsecinfo "" VALUE 0x27b0014 __FLOAT32_IEEE_S 0 NO_COMPU_METHOD 0 3.402823e+38 ECU_ADDRESS_EXTENSION 0x80 /end CHARACTERISTIC
/begin CHARACTERISTIC CtApImageProcess_FreeRunning.PpSysManager_VCUStatus6_50ms.DeVMS_VCUStatus6.WhlGndVelRNonDrvnVsecinfo "" VALUE 0x27b0018 __UBYTE_S 0 NO_COMPU_METHOD 0 1 ECU_ADDRESS_EXTENSION 0x80 /end CHARACTERISTIC
/begin CHARACTERISTIC CtApImageProcess_FreeRunning.PpSysManager_VCUStatus6_50ms.DeVMS_VCUStatus6.WhlGndVelRNonDrvnsecinfo "" VALUE 0x27b001c __FLOAT32_IEEE_S 0 NO_COMPU_METHOD 0 3.402823e+38 ECU_ADDRESS_EXTENSION 0x80 /end CHARACTERISTIC
/begin CHARACTERISTIC CtApImageProcess_FreeRunning.PpSysManager_VCUStatus6_50ms.DeVMS_VCUStatus6.DeTimestamp.DeTimestampEGT.DeTimestampHigh "" VALUE 0x27b0020 __ULONG_S 0 NO_COMPU_METHOD 0 4294967295 ECU_ADDRESS_EXTENSION 0x80 /end CHARACTERISTIC
/begin CHARACTERISTIC CtApImageProcess_FreeRunning.PpSysManager_VCUStatus6_50ms.DeVMS_VCUStatus6.DeTimestamp.DeTimestampEGT.DeTimestampLow "" VALUE 0x27b0024 __ULONG_S 0 NO_COMPU_METHOD 0 4294967295 ECU_ADDRESS_EXTENSION 0x80 /end CHARACTERISTIC
/begin CHARACTERISTIC CtApImageProcess_FreeRunning.PpSysManager_VCUStatus6_50ms.DeVMS_VCUStatus6.DeTimestamp.DeTimestampMW_RX.DeTimestampHigh "" VALUE 0x27b0028 __ULONG_S 0 NO_COMPU_METHOD 0 4294967295 ECU_ADDRESS_EXTENSION 0x80 /end CHARACTERISTIC
/begin CHARACTERISTIC CtApImageProcess_FreeRunning.PpSysManager_VCUStatus6_50ms.DeVMS_VCUStatus6.DeTimestamp.DeTimestampMW_RX.DeTimestampLow "" VALUE 0x27b002c __ULONG_S 0 NO_COMPU_METHOD 0 4294967295 ECU_ADDRESS_EXTENSION 0x80 /end CHARACTERISTIC
/begin CHARACTERISTIC CtApImageProcess_FreeRunning.PpSysManager_VCUStatus6_50ms.DeVMS_VCUStatus6.DeTimestamp.DeTimestampMW_TX.DeTimestampHigh "" VALUE 0x27b0030 __ULONG_S 0 NO_COMPU_METHOD 0 4294967295 ECU_ADDRESS_EXTENSION 0x80 /end CHARACTERISTIC
/begin CHARACTERISTIC CtApImageProcess_FreeRunning.PpSysManager_VCUStatus6_50ms.DeVMS_VCUStatus6.DeTimestamp.DeTimestampMW_TX.DeTimestampLow "" VALUE 0x27b0034 __ULONG_S 0 NO_COMPU_METHOD 0 4294967295 ECU_ADDRESS_EXTENSION 0x80 /end CHARACTERISTIC
/begin CHARACTERISTIC CtApImageProcess_FreeRunning.PpUltrasonicHandler_HSC1_PDC_50ms.DeIECU_HSC1_PDC_FrP00.FrtObsDist_h1HSC1 "" VALUE 0x27c0000 __UBYTE_S 0 NO_COMPU_METHOD 0 255 ECU_ADDRESS_EXTENSION 0x80 /end CHARACTERISTIC
/begin CHARACTERISTIC CtApImageProcess_FreeRunning.PpUltrasonicHandler_HSC1_PDC_50ms.DeIECU_HSC1_PDC_FrP00.RrObsDist_h1HSC1 "" VALUE 0x27c0001 __UBYTE_S 0 NO_COMPU_METHOD 0 255 ECU_ADDRESS_EXTENSION 0x80 /end CHARACTERISTIC
/begin CHARACTERISTIC CtApImageProcess_FreeRunning.PpUltrasonicHandler_PDC_CHCAN_50ms.DePDC_HSC2_FrP00.PDCSysStsHSC2 "" VALUE 0x27d0000 __UBYTE_S 0 NO_COMPU_METHOD 0 255 ECU_ADDRESS_EXTENSION 0x80 /end CHARACTERISTIC
/begin CHARACTERISTIC CtApImageProcess_FreeRunning.PpUltrasonicHandler_PDC_CHCAN_50ms.DePDC_HSC2_FrP00.RrPDCAudWrnngHSC2 "" VALUE 0x27d0001 __UBYTE_S 0 NO_COMPU_METHOD 0 255 ECU_ADDRESS_EXTENSION 0x80 /end CHARACTERISTIC
/begin CHARACTERISTIC CtApImageProcess_FreeRunning.PpUltrasonicHandler_PDC_CHCAN_50ms.DePDC_HSC2_FrP00.FrtPDCAudWrnngHSC2 "" VALUE 0x27d0002 __UBYTE_S 0 NO_COMPU_METHOD 0 255 ECU_ADDRESS_EXTENSION 0x80 /end CHARACTERISTIC
/begin CHARACTERISTIC CtApImageProcess_FreeRunning.PpUltrasonicHandler_PDC_CHCAN_50ms.DePDC_HSC2_FrP00.RrMidRObsRngHSC2 "" VALUE 0x27d0003 __UBYTE_S 0 NO_COMPU_METHOD 0 255 ECU_ADDRESS_EXTENSION 0x80 /end CHARACTERISTIC
/begin CHARACTERISTIC CtApImageProcess_FreeRunning.PpUltrasonicHandler_PDC_CHCAN_50ms.DePDC_HSC2_FrP00.RrMidLObsRngHSC2 "" VALUE 0x27d0004 __UBYTE_S 0 NO_COMPU_METHOD 0 255 ECU_ADDRESS_EXTENSION 0x80 /end CHARACTERISTIC
/begin CHARACTERISTIC CtApImageProcess_FreeRunning.PpUltrasonicHandler_PDC_CHCAN_50ms.DePDC_HSC2_FrP00.FrtMidRObsRngHSC2 "" VALUE 0x27d0005 __UBYTE_S 0 NO_COMPU_METHOD 0 255 ECU_ADDRESS_EXTENSION 0x80 /end CHARACTERISTIC
/begin CHARACTERISTIC CtApImageProcess_FreeRunning.PpUltrasonicHandler_PDC_CHCAN_50ms.DePDC_HSC2_FrP00.FrtMidLObsRngHSC2 "" VALUE 0x27d0006 __UBYTE_S 0 NO_COMPU_METHOD 0 255 ECU_ADDRESS_EXTENSION 0x80 /end CHARACTERISTIC
/begin CHARACTERISTIC CtApImageProcess_FreeRunning.PpUltrasonicHandler_PDC_CHCAN_50ms.DePDC_HSC2_FrP00.RRObsRngHSC2 "" VALUE 0x27d0007 __UBYTE_S 0 NO_COMPU_METHOD 0 255 ECU_ADDRESS_EXTENSION 0x80 /end CHARACTERISTIC
/begin CHARACTERISTIC CtApImageProcess_FreeRunning.PpUltrasonicHandler_PDC_CHCAN_50ms.DePDC_HSC2_FrP00.RLObsRngHSC2 "" VALUE 0x27d0008 __UBYTE_S 0 NO_COMPU_METHOD 0 255 ECU_ADDRESS_EXTENSION 0x80 /end CHARACTERISTIC
/begin CHARACTERISTIC CtApImageProcess_FreeRunning.PpUltrasonicHandler_PDC_CHCAN_50ms.DePDC_HSC2_FrP00.FRObsRngHSC2 "" VALUE 0x27d0009 __UBYTE_S 0 NO_COMPU_METHOD 0 255 ECU_ADDRESS_EXTENSION 0x80 /end CHARACTERISTIC
/begin CHARACTERISTIC CtApImageProcess_FreeRunning.PpUltrasonicHandler_PDC_CHCAN_50ms.DePDC_HSC2_FrP00.FLObsRngHSC2 "" VALUE 0x27d000a __UBYTE_S 0 NO_COMPU_METHOD 0 255 ECU_ADDRESS_EXTENSION 0x80 /end CHARACTERISTIC
/begin CHARACTERISTIC CtApImageProcess_FreeRunning.PpUltrasonicHandler_PDC_CHCAN_50ms.DePDC_HSC2_FrP00.PDCCofignStsHSC2 "" VALUE 0x27d000b __UBYTE_S 0 NO_COMPU_METHOD 0 255 ECU_ADDRESS_EXTENSION 0x80 /end CHARACTERISTIC
/begin CHARACTERISTIC CtApImageProcess_FreeRunning.PpUltrasonicHandler_PDC_CHCAN_50ms.DePDC_HSC2_FrP00.FrtObsDist_h2HSC2 "" VALUE 0x27d000c __UBYTE_S 0 NO_COMPU_METHOD 0 255 ECU_ADDRESS_EXTENSION 0x80 /end CHARACTERISTIC
/begin CHARACTERISTIC CtApImageProcess_FreeRunning.PpUltrasonicHandler_PDC_CHCAN_50ms.DePDC_HSC2_FrP00.RrObsDist_h2HSC2 "" VALUE 0x27d000d __UBYTE_S 0 NO_COMPU_METHOD 0 255 ECU_ADDRESS_EXTENSION 0x80 /end CHARACTERISTIC
/begin CHARACTERISTIC CtApImageProcess_FreeRunning.PpUltrasonicHandler_PDC_CHCAN_50ms.DePDC_HSC2_FrP01.RRSideObsDistHSC2 "" VALUE 0x27e0000 __UWORD_S 0 NO_COMPU_METHOD 0 65535 ECU_ADDRESS_EXTENSION 0x80 /end CHARACTERISTIC
/begin CHARACTERISTIC CtApImageProcess_FreeRunning.PpUltrasonicHandler_PDC_CHCAN_50ms.DePDC_HSC2_FrP01.RLSideObsDistHSC2 "" VALUE 0x27e0002 __UWORD_S 0 NO_COMPU_METHOD 0 65535 ECU_ADDRESS_EXTENSION 0x80 /end CHARACTERISTIC
/begin CHARACTERISTIC CtApImageProcess_FreeRunning.PpUltrasonicHandler_PDC_CHCAN_50ms.DePDC_HSC2_FrP01.FRSideObsDistHSC2 "" VALUE 0x27e0004 __UWORD_S 0 NO_COMPU_METHOD 0 65535 ECU_ADDRESS_EXTENSION 0x80 /end CHARACTERISTIC
/begin CHARACTERISTIC CtApImageProcess_FreeRunning.PpUltrasonicHandler_PDC_CHCAN_50ms.DePDC_HSC2_FrP01.FLSideObsDistHSC2 "" VALUE 0x27e0006 __UWORD_S 0 NO_COMPU_METHOD 0 65535 ECU_ADDRESS_EXTENSION 0x80 /end CHARACTERISTIC
/begin CHARACTERISTIC CtApImageProcess_FreeRunning.PpUltrasonicProcess_Dists_20ms.DeUltrasonicProcess_BKP.UltrasonicProcess_BKP "10 uint32 array" VAL_BLK 0x27f0000 __ULONG_S 0 NO_COMPU_METHOD 0 4294967295 ECU_ADDRESS_EXTENSION 0x80 MATRIX_DIM 10 1 1 /end CHARACTERISTIC
/begin CHARACTERISTIC CtApImageProcess_FreeRunning.PpUltrasonicProcess_Dists_20ms.DeUltrasonicProcess_Dists.stHeader.Counter "" VALUE 0x2800000 __UWORD_S 0 NO_COMPU_METHOD 0 65535 ECU_ADDRESS_EXTENSION 0x80 /end CHARACTERISTIC
/begin CHARACTERISTIC CtApImageProcess_FreeRunning.PpUltrasonicProcess_Dists_20ms.DeUltrasonicProcess_Dists.stHeader.FrameID "" VALUE 0x2800002 __UBYTE_S 0 NO_COMPU_METHOD 0 255 ECU_ADDRESS_EXTENSION 0x80 /end CHARACTERISTIC
/begin CHARACTERISTIC CtApImageProcess_FreeRunning.PpUltrasonicProcess_Dists_20ms.DeUltrasonicProcess_Dists.stHeader.TimeStamp "2 uint32 array" VAL_BLK 0x2800004 __ULONG_S 0 NO_COMPU_METHOD 0 4294967295 ECU_ADDRESS_EXTENSION 0x80 MATRIX_DIM 2 1 1 /end CHARACTERISTIC
/begin CHARACTERISTIC CtApImageProcess_FreeRunning.PpUltrasonicProcess_Dists_20ms.DeUltrasonicProcess_Dists.gstProbes[0].ExParam "7 float32 array" VAL_BLK 0x280000c __FLOAT32_IEEE_S 0 NO_COMPU_METHOD 0 3.402823e+38 ECU_ADDRESS_EXTENSION 0x80 MATRIX_DIM 7 1 1 /end CHARACTERISTIC
/begin CHARACTERISTIC CtApImageProcess_FreeRunning.PpUltrasonicProcess_Dists_20ms.DeUltrasonicProcess_Dists.gstProbes[0].bOutRange "" VALUE 0x2800028 __UBYTE_S 0 NO_COMPU_METHOD 0 1 ECU_ADDRESS_EXTENSION 0x80 /end CHARACTERISTIC
/begin CHARACTERISTIC CtApImageProcess_FreeRunning.PpUltrasonicProcess_Dists_20ms.DeUltrasonicProcess_Dists.gstProbes[0].fDist "" VALUE 0x280002c __FLOAT32_IEEE_S 0 NO_COMPU_METHOD 0 3.402823e+38 ECU_ADDRESS_EXTENSION 0x80 /end CHARACTERISTIC
/begin CHARACTERISTIC CtApImageProcess_FreeRunning.PpUltrasonicProcess_Dists_20ms.DeUltrasonicProcess_Dists.gstProbes[1].ExParam "7 float32 array" VAL_BLK 0x2800030 __FLOAT32_IEEE_S 0 NO_COMPU_METHOD 0 3.402823e+38 ECU_ADDRESS_EXTENSION 0x80 MATRIX_DIM 7 1 1 /end CHARACTERISTIC
/begin CHARACTERISTIC CtApImageProcess_FreeRunning.PpUltrasonicProcess_Dists_20ms.DeUltrasonicProcess_Dists.gstProbes[1].bOutRange "" VALUE 0x280004c __UBYTE_S 0 NO_COMPU_METHOD 0 1 ECU_ADDRESS_EXTENSION 0x80 /end CHARACTERISTIC
/begin CHARACTERISTIC CtApImageProcess_FreeRunning.PpUltrasonicProcess_Dists_20ms.DeUltrasonicProcess_Dists.gstProbes[1].fDist "" VALUE 0x2800050 __FLOAT32_IEEE_S 0 NO_COMPU_METHOD 0 3.402823e+38 ECU_ADDRESS_EXTENSION 0x80 /end CHARACTERISTIC
/begin CHARACTERISTIC CtApImageProcess_FreeRunning.PpUltrasonicProcess_Dists_20ms.DeUltrasonicProcess_Dists.gstProbes[2].ExParam "7 float32 array" VAL_BLK 0x2800054 __FLOAT32_IEEE_S 0 NO_COMPU_METHOD 0 3.402823e+38 ECU_ADDRESS_EXTENSION 0x80 MATRIX_DIM 7 1 1 /end CHARACTERISTIC
/begin CHARACTERISTIC CtApImageProcess_FreeRunning.PpUltrasonicProcess_Dists_20ms.DeUltrasonicProcess_Dists.gstProbes[2].bOutRange "" VALUE 0x2800070 __UBYTE_S 0 NO_COMPU_METHOD 0 1 ECU_ADDRESS_EXTENSION 0x80 /end CHARACTERISTIC
/begin CHARACTERISTIC CtApImageProcess_FreeRunning.PpUltrasonicProcess_Dists_20ms.DeUltrasonicProcess_Dists.gstProbes[2].fDist "" VALUE 0x2800074 __FLOAT32_IEEE_S 0 NO_COMPU_METHOD 0 3.402823e+38 ECU_ADDRESS_EXTENSION 0x80 /end CHARACTERISTIC
/begin CHARACTERISTIC CtApImageProcess_FreeRunning.PpUltrasonicProcess_Dists_20ms.DeUltrasonicProcess_Dists.gstProbes[3].ExParam "7 float32 array" VAL_BLK 0x2800078 __FLOAT32_IEEE_S 0 NO_COMPU_METHOD 0 3.402823e+38 ECU_ADDRESS_EXTENSION 0x80 MATRIX_DIM 7 1 1 /end CHARACTERISTIC
/begin CHARACTERISTIC CtApImageProcess_FreeRunning.PpUltrasonicProcess_Dists_20ms.DeUltrasonicProcess_Dists.gstProbes[3].bOutRange "" VALUE 0x2800094 __UBYTE_S 0 NO_COMPU_METHOD 0 1 ECU_ADDRESS_EXTENSION 0x80 /end CHARACTERISTIC
/begin CHARACTERISTIC CtApImageProcess_FreeRunning.PpUltrasonicProcess_Dists_20ms.DeUltrasonicProcess_Dists.gstProbes[3].fDist "" VALUE 0x2800098 __FLOAT32_IEEE_S 0 NO_COMPU_METHOD 0 3.402823e+38 ECU_ADDRESS_EXTENSION 0x80 /end CHARACTERISTIC
/begin CHARACTERISTIC CtApImageProcess_FreeRunning.PpUltrasonicProcess_Dists_20ms.DeUltrasonicProcess_Dists.gstProbes[4].ExParam "7 float32 array" VAL_BLK 0x280009c __FLOAT32_IEEE_S 0 NO_COMPU_METHOD 0 3.402823e+38 ECU_ADDRESS_EXTENSION 0x80 MATRIX_DIM 7 1 1 /end CHARACTERISTIC
/begin CHARACTERISTIC CtApImageProcess_FreeRunning.PpUltrasonicProcess_Dists_20ms.DeUltrasonicProcess_Dists.gstProbes[4].bOutRange "" VALUE 0x28000b8 __UBYTE_S 0 NO_COMPU_METHOD 0 1 ECU_ADDRESS_EXTENSION 0x80 /end CHARACTERISTIC
/begin CHARACTERISTIC CtApImageProcess_FreeRunning.PpUltrasonicProcess_Dists_20ms.DeUltrasonicProcess_Dists.gstProbes[4].fDist "" VALUE 0x28000bc __FLOAT32_IEEE_S 0 NO_COMPU_METHOD 0 3.402823e+38 ECU_ADDRESS_EXTENSION 0x80 /end CHARACTERISTIC
/begin CHARACTERISTIC CtApImageProcess_FreeRunning.PpUltrasonicProcess_Dists_20ms.DeUltrasonicProcess_Dists.gstProbes[5].ExParam "7 float32 array" VAL_BLK 0x28000c0 __FLOAT32_IEEE_S 0 NO_COMPU_METHOD 0 3.402823e+38 ECU_ADDRESS_EXTENSION 0x80 MATRIX_DIM 7 1 1 /end CHARACTERISTIC
/begin CHARACTERISTIC CtApImageProcess_FreeRunning.PpUltrasonicProcess_Dists_20ms.DeUltrasonicProcess_Dists.gstProbes[5].bOutRange "" VALUE 0x28000dc __UBYTE_S 0 NO_COMPU_METHOD 0 1 ECU_ADDRESS_EXTENSION 0x80 /end CHARACTERISTIC
/begin CHARACTERISTIC CtApImageProcess_FreeRunning.PpUltrasonicProcess_Dists_20ms.DeUltrasonicProcess_Dists.gstProbes[5].fDist "" VALUE 0x28000e0 __FLOAT32_IEEE_S 0 NO_COMPU_METHOD 0 3.402823e+38 ECU_ADDRESS_EXTENSION 0x80 /end CHARACTERISTIC
/begin CHARACTERISTIC CtApImageProcess_FreeRunning.PpUltrasonicProcess_Dists_20ms.DeUltrasonicProcess_Dists.gstProbes[6].ExParam "7 float32 array" VAL_BLK 0x28000e4 __FLOAT32_IEEE_S 0 NO_COMPU_METHOD 0 3.402823e+38 ECU_ADDRESS_EXTENSION 0x80 MATRIX_DIM 7 1 1 /end CHARACTERISTIC
/begin CHARACTERISTIC CtApImageProcess_FreeRunning.PpUltrasonicProcess_Dists_20ms.DeUltrasonicProcess_Dists.gstProbes[6].bOutRange "" VALUE 0x2800100 __UBYTE_S 0 NO_COMPU_METHOD 0 1 ECU_ADDRESS_EXTENSION 0x80 /end CHARACTERISTIC
/begin CHARACTERISTIC CtApImageProcess_FreeRunning.PpUltrasonicProcess_Dists_20ms.DeUltrasonicProcess_Dists.gstProbes[6].fDist "" VALUE 0x2800104 __FLOAT32_IEEE_S 0 NO_COMPU_METHOD 0 3.402823e+38 ECU_ADDRESS_EXTENSION 0x80 /end CHARACTERISTIC
/begin CHARACTERISTIC CtApImageProcess_FreeRunning.PpUltrasonicProcess_Dists_20ms.DeUltrasonicProcess_Dists.gstProbes[7].ExParam "7 float32 array" VAL_BLK 0x2800108 __FLOAT32_IEEE_S 0 NO_COMPU_METHOD 0 3.402823e+38 ECU_ADDRESS_EXTENSION 0x80 MATRIX_DIM 7 1 1 /end CHARACTERISTIC
/begin CHARACTERISTIC CtApImageProcess_FreeRunning.PpUltrasonicProcess_Dists_20ms.DeUltrasonicProcess_Dists.gstProbes[7].bOutRange "" VALUE 0x2800124 __UBYTE_S 0 NO_COMPU_METHOD 0 1 ECU_ADDRESS_EXTENSION 0x80 /end CHARACTERISTIC
/begin CHARACTERISTIC CtApImageProcess_FreeRunning.PpUltrasonicProcess_Dists_20ms.DeUltrasonicProcess_Dists.gstProbes[7].fDist "" VALUE 0x2800128 __FLOAT32_IEEE_S 0 NO_COMPU_METHOD 0 3.402823e+38 ECU_ADDRESS_EXTENSION 0x80 /end CHARACTERISTIC
/begin CHARACTERISTIC CtApImageProcess_FreeRunning.PpUltrasonicProcess_Dists_20ms.DeUltrasonicProcess_Dists.gstProbes[8].ExParam "7 float32 array" VAL_BLK 0x280012c __FLOAT32_IEEE_S 0 NO_COMPU_METHOD 0 3.402823e+38 ECU_ADDRESS_EXTENSION 0x80 MATRIX_DIM 7 1 1 /end CHARACTERISTIC
/begin CHARACTERISTIC CtApImageProcess_FreeRunning.PpUltrasonicProcess_Dists_20ms.DeUltrasonicProcess_Dists.gstProbes[8].bOutRange "" VALUE 0x2800148 __UBYTE_S 0 NO_COMPU_METHOD 0 1 ECU_ADDRESS_EXTENSION 0x80 /end CHARACTERISTIC
/begin CHARACTERISTIC CtApImageProcess_FreeRunning.PpUltrasonicProcess_Dists_20ms.DeUltrasonicProcess_Dists.gstProbes[8].fDist "" VALUE 0x280014c __FLOAT32_IEEE_S 0 NO_COMPU_METHOD 0 3.402823e+38 ECU_ADDRESS_EXTENSION 0x80 /end CHARACTERISTIC
/begin CHARACTERISTIC CtApImageProcess_FreeRunning.PpUltrasonicProcess_Dists_20ms.DeUltrasonicProcess_Dists.gstProbes[9].ExParam "7 float32 array" VAL_BLK 0x2800150 __FLOAT32_IEEE_S 0 NO_COMPU_METHOD 0 3.402823e+38 ECU_ADDRESS_EXTENSION 0x80 MATRIX_DIM 7 1 1 /end CHARACTERISTIC
/begin CHARACTERISTIC CtApImageProcess_FreeRunning.PpUltrasonicProcess_Dists_20ms.DeUltrasonicProcess_Dists.gstProbes[9].bOutRange "" VALUE 0x280016c __UBYTE_S 0 NO_COMPU_METHOD 0 1 ECU_ADDRESS_EXTENSION 0x80 /end CHARACTERISTIC
/begin CHARACTERISTIC CtApImageProcess_FreeRunning.PpUltrasonicProcess_Dists_20ms.DeUltrasonicProcess_Dists.gstProbes[9].fDist "" VALUE 0x2800170 __FLOAT32_IEEE_S 0 NO_COMPU_METHOD 0 3.402823e+38 ECU_ADDRESS_EXTENSION 0x80 /end CHARACTERISTIC
/begin CHARACTERISTIC CtApImageProcess_FreeRunning.PpUltrasonicProcess_Dists_20ms.DeUltrasonicProcess_Dists.gstProbes[10].ExParam "7 float32 array" VAL_BLK 0x2800174 __FLOAT32_IEEE_S 0 NO_COMPU_METHOD 0 3.402823e+38 ECU_ADDRESS_EXTENSION 0x80 MATRIX_DIM 7 1 1 /end CHARACTERISTIC
/begin CHARACTERISTIC CtApImageProcess_FreeRunning.PpUltrasonicProcess_Dists_20ms.DeUltrasonicProcess_Dists.gstProbes[10].bOutRange "" VALUE 0x2800190 __UBYTE_S 0 NO_COMPU_METHOD 0 1 ECU_ADDRESS_EXTENSION 0x80 /end CHARACTERISTIC
/begin CHARACTERISTIC CtApImageProcess_FreeRunning.PpUltrasonicProcess_Dists_20ms.DeUltrasonicProcess_Dists.gstProbes[10].fDist "" VALUE 0x2800194 __FLOAT32_IEEE_S 0 NO_COMPU_METHOD 0 3.402823e+38 ECU_ADDRESS_EXTENSION 0x80 /end CHARACTERISTIC
/begin CHARACTERISTIC CtApImageProcess_FreeRunning.PpUltrasonicProcess_Dists_20ms.DeUltrasonicProcess_Dists.gstProbes[11].ExParam "7 float32 array" VAL_BLK 0x2800198 __FLOAT32_IEEE_S 0 NO_COMPU_METHOD 0 3.402823e+38 ECU_ADDRESS_EXTENSION 0x80 MATRIX_DIM 7 1 1 /end CHARACTERISTIC
/begin CHARACTERISTIC CtApImageProcess_FreeRunning.PpUltrasonicProcess_Dists_20ms.DeUltrasonicProcess_Dists.gstProbes[11].bOutRange "" VALUE 0x28001b4 __UBYTE_S 0 NO_COMPU_METHOD 0 1 ECU_ADDRESS_EXTENSION 0x80 /end CHARACTERISTIC
/begin CHARACTERISTIC CtApImageProcess_FreeRunning.PpUltrasonicProcess_Dists_20ms.DeUltrasonicProcess_Dists.gstProbes[11].fDist "" VALUE 0x28001b8 __FLOAT32_IEEE_S 0 NO_COMPU_METHOD 0 3.402823e+38 ECU_ADDRESS_EXTENSION 0x80 /end CHARACTERISTIC
/begin CHARACTERISTIC CtApImageProcess_FreeRunning.PpVehicleIdentificationNumber.DeVehicleIdentificationNumber "17 uint8 array" VAL_BLK 0x2810000 __UBYTE_S 0 NO_COMPU_METHOD 0 255 ECU_ADDRESS_EXTENSION 0x80 MATRIX_DIM 17 1 1 /end CHARACTERISTIC
/begin COMPU_METHOD CtApImageProcess_FreeRunning.PpDsImageProcessDataSet.DeADASDecisionDS.DeStatus.Dt_ENUM_PdDatablockStatus.CONVERSION "" TAB_VERB "%10.10" "" COMPU_TAB_REF CtApImageProcess_FreeRunning.PpDsImageProcessDataSet.DeADASDecisionDS.DeStatus.Dt_ENUM_PdDatablockStatus /end COMPU_METHOD
/begin COMPU_METHOD CtApImageProcess_FreeRunning.PpPdImageProcess_FreeRunningRead.DeImageProcess_FreeRunning_Normal.DeStatus.Dt_ENUM_PdDatablockStatus.CONVERSION "" TAB_VERB "%10.10" "" COMPU_TAB_REF CtApImageProcess_FreeRunning.PpPdImageProcess_FreeRunningRead.DeImageProcess_FreeRunning_Normal.DeStatus.Dt_ENUM_PdDatablockStatus /end COMPU_METHOD
/begin COMPU_METHOD CtApImageProcess_FreeRunning.PpPdImageProcess_FreeRunningRead.DeImageProcess_Normal.DeStatus.Dt_ENUM_PdDatablockStatus.CONVERSION "" TAB_VERB "%10.10" "" COMPU_TAB_REF CtApImageProcess_FreeRunning.PpPdImageProcess_FreeRunningRead.DeImageProcess_Normal.DeStatus.Dt_ENUM_PdDatablockStatus /end COMPU_METHOD
/begin COMPU_METHOD CtApImageProcess_FreeRunning.PpPdImageProcess_FreeRunningRead.DeImageProcessSec_Normal.DeStatus.Dt_ENUM_PdDatablockStatus.CONVERSION "" TAB_VERB "%10.10" "" COMPU_TAB_REF CtApImageProcess_FreeRunning.PpPdImageProcess_FreeRunningRead.DeImageProcessSec_Normal.DeStatus.Dt_ENUM_PdDatablockStatus /end COMPU_METHOD
/begin COMPU_METHOD CtApImageProcess_FreeRunning.PpPFProvidedData.DeLCSPH00State.Dt_ENUM_LCS_State.CONVERSION "" TAB_VERB "%10.10" "" COMPU_TAB_REF CtApImageProcess_FreeRunning.PpPFProvidedData.DeLCSPH00State.Dt_ENUM_LCS_State /end COMPU_METHOD
/begin COMPU_METHOD CtApImageProcess_FreeRunning.PpPFProvidedData.DeLCSSH00State.Dt_ENUM_LCS_State.CONVERSION "" TAB_VERB "%10.10" "" COMPU_TAB_REF CtApImageProcess_FreeRunning.PpPFProvidedData.DeLCSSH00State.Dt_ENUM_LCS_State /end COMPU_METHOD
/begin COMPU_METHOD CtApImageProcess_FreeRunning.PpPFProvidedData.DeLCSSH01State.Dt_ENUM_LCS_State.CONVERSION "" TAB_VERB "%10.10" "" COMPU_TAB_REF CtApImageProcess_FreeRunning.PpPFProvidedData.DeLCSSH01State.Dt_ENUM_LCS_State /end COMPU_METHOD
/begin COMPU_METHOD CtApImageProcess_FreeRunning.PpPFProvidedData.DeLCSSystemState.Dt_ENUM_LCS_State.CONVERSION "" TAB_VERB "%10.10" "" COMPU_TAB_REF CtApImageProcess_FreeRunning.PpPFProvidedData.DeLCSSystemState.Dt_ENUM_LCS_State /end COMPU_METHOD
/begin COMPU_METHOD CtApImageProcess_FreeRunning.PpPFProvidedData.DeVARHWVariant.Dt_ENUM_VAR_HWVariant.CONVERSION "" TAB_VERB "%10.10" "" COMPU_TAB_REF CtApImageProcess_FreeRunning.PpPFProvidedData.DeVARHWVariant.Dt_ENUM_VAR_HWVariant /end COMPU_METHOD
/begin COMPU_VTAB CtApImageProcess_FreeRunning.PpDsImageProcessDataSet.DeADASDecisionDS.DeStatus.Dt_ENUM_PdDatablockStatus "Conversion table for CtApImageProcess_FreeRunning.PpDsImageProcessDataSet.DeADASDecisionDS.DeStatus.Dt_ENUM_PdDatablockStatus.CONVERSION COMPU_METHOD" TAB_VERB 5 0 "DATABLOCK_INIT" 1 "DATABLOCK_OK" 2 "DATABLOCK_NOT_OK" 3 "DATABLOCK_WRONGCRC" 4 "DATABLOCK_ERASED" /end COMPU_VTAB
/begin COMPU_VTAB CtApImageProcess_FreeRunning.PpPdImageProcess_FreeRunningRead.DeImageProcess_FreeRunning_Normal.DeStatus.Dt_ENUM_PdDatablockStatus "Conversion table for CtApImageProcess_FreeRunning.PpPdImageProcess_FreeRunningRead.DeImageProcess_FreeRunning_Normal.DeStatus.Dt_ENUM_PdDatablockStatus.CONVERSION COMPU_METHOD" TAB_VERB 5 0 "DATABLOCK_INIT" 1 "DATABLOCK_OK" 2 "DATABLOCK_NOT_OK" 3 "DATABLOCK_WRONGCRC" 4 "DATABLOCK_ERASED" /end COMPU_VTAB
/begin COMPU_VTAB CtApImageProcess_FreeRunning.PpPdImageProcess_FreeRunningRead.DeImageProcess_Normal.DeStatus.Dt_ENUM_PdDatablockStatus "Conversion table for CtApImageProcess_FreeRunning.PpPdImageProcess_FreeRunningRead.DeImageProcess_Normal.DeStatus.Dt_ENUM_PdDatablockStatus.CONVERSION COMPU_METHOD" TAB_VERB 5 0 "DATABLOCK_INIT" 1 "DATABLOCK_OK" 2 "DATABLOCK_NOT_OK" 3 "DATABLOCK_WRONGCRC" 4 "DATABLOCK_ERASED" /end COMPU_VTAB
/begin COMPU_VTAB CtApImageProcess_FreeRunning.PpPdImageProcess_FreeRunningRead.DeImageProcessSec_Normal.DeStatus.Dt_ENUM_PdDatablockStatus "Conversion table for CtApImageProcess_FreeRunning.PpPdImageProcess_FreeRunningRead.DeImageProcessSec_Normal.DeStatus.Dt_ENUM_PdDatablockStatus.CONVERSION COMPU_METHOD" TAB_VERB 5 0 "DATABLOCK_INIT" 1 "DATABLOCK_OK" 2 "DATABLOCK_NOT_OK" 3 "DATABLOCK_WRONGCRC" 4 "DATABLOCK_ERASED" /end COMPU_VTAB
/begin COMPU_VTAB CtApImageProcess_FreeRunning.PpPFProvidedData.DeLCSPH00State.Dt_ENUM_LCS_State "Conversion table for CtApImageProcess_FreeRunning.PpPFProvidedData.DeLCSPH00State.Dt_ENUM_LCS_State.CONVERSION COMPU_METHOD" TAB_VERB 8 0 "LCS_STATE_INIT" 1 "LCS_STATE_EST" 2 "LCS_STATE_STA" 3 "LCS_STATE_SBY" 4 "LCS_STATE_RUN" 5 "LCS_STATE_SHU" 6 "LCS_STATE_WPO" 7 "LCS_STATE_NOTPRESENT" /end COMPU_VTAB
/begin COMPU_VTAB CtApImageProcess_FreeRunning.PpPFProvidedData.DeLCSSH00State.Dt_ENUM_LCS_State "Conversion table for CtApImageProcess_FreeRunning.PpPFProvidedData.DeLCSSH00State.Dt_ENUM_LCS_State.CONVERSION COMPU_METHOD" TAB_VERB 8 0 "LCS_STATE_INIT" 1 "LCS_STATE_EST" 2 "LCS_STATE_STA" 3 "LCS_STATE_SBY" 4 "LCS_STATE_RUN" 5 "LCS_STATE_SHU" 6 "LCS_STATE_WPO" 7 "LCS_STATE_NOTPRESENT" /end COMPU_VTAB
/begin COMPU_VTAB CtApImageProcess_FreeRunning.PpPFProvidedData.DeLCSSH01State.Dt_ENUM_LCS_State "Conversion table for CtApImageProcess_FreeRunning.PpPFProvidedData.DeLCSSH01State.Dt_ENUM_LCS_State.CONVERSION COMPU_METHOD" TAB_VERB 8 0 "LCS_STATE_INIT" 1 "LCS_STATE_EST" 2 "LCS_STATE_STA" 3 "LCS_STATE_SBY" 4 "LCS_STATE_RUN" 5 "LCS_STATE_SHU" 6 "LCS_STATE_WPO" 7 "LCS_STATE_NOTPRESENT" /end COMPU_VTAB
/begin COMPU_VTAB CtApImageProcess_FreeRunning.PpPFProvidedData.DeLCSSystemState.Dt_ENUM_LCS_State "Conversion table for CtApImageProcess_FreeRunning.PpPFProvidedData.DeLCSSystemState.Dt_ENUM_LCS_State.CONVERSION COMPU_METHOD" TAB_VERB 8 0 "LCS_STATE_INIT" 1 "LCS_STATE_EST" 2 "LCS_STATE_STA" 3 "LCS_STATE_SBY" 4 "LCS_STATE_RUN" 5 "LCS_STATE_SHU" 6 "LCS_STATE_WPO" 7 "LCS_STATE_NOTPRESENT" /end COMPU_VTAB
/begin COMPU_VTAB CtApImageProcess_FreeRunning.PpPFProvidedData.DeVARHWVariant.Dt_ENUM_VAR_HWVariant "Conversion table for CtApImageProcess_FreeRunning.PpPFProvidedData.DeVARHWVariant.Dt_ENUM_VAR_HWVariant.CONVERSION COMPU_METHOD" TAB_VERB 2 0 "VARIANT_UNKNOWN" 1 "ADAS" /end COMPU_VTAB
/begin GROUP CtApImageProcess_FreeRunning_xcp_kvs_group "MotinWise KVS characteristic group" ROOT
 /begin REF_CHARACTERISTIC CtApImageProcess_FreeRunning.PpDR_Merges_10ms.DeDR_List.DR_List[106].time_sec CtApImageProcess_FreeRunning.PpDR_Merges_10ms.DeDR_List.DR_List[106].utm_x CtApImageProcess_FreeRunning.PpDR_Merges_10ms.DeDR_List.DR_List[106].utm_y CtApImageProcess_FreeRunning.PpDR_Merges_10ms.DeDR_List.DR_List[106].utm_z CtApImageProcess_FreeRunning.PpDR_Merges_10ms.DeDR_List.DR_List[106].heading CtApImageProcess_FreeRunning.PpDR_Merges_10ms.DeDR_List.DR_List[106].delta_x CtApImageProcess_FreeRunning.PpDR_Merges_10ms.DeDR_List.DR_List[106].delta_y CtApImageProcess_FreeRunning.PpDR_Merges_10ms.DeDR_List.DR_List[106].delta_z CtApImageProcess_FreeRunning.PpDR_Merges_10ms.DeDR_List.DR_List[106].delta_yaw CtApImageProcess_FreeRunning.PpDR_Merges_10ms.DeDR_List.DR_List[106].belif CtApImageProcess_FreeRunning.PpDR_Merges_10ms.DeDR_List.DR_List[106].reserved_int CtApImageProcess_FreeRunning.PpDR_Merges_10ms.DeDR_List.DR_List[107].stHeader.Counter CtApImageProcess_FreeRunning.PpDR_Merges_10ms.DeDR_List.DR_List[107].stHeader.FrameID CtApImageProcess_FreeRunning.PpDR_Merges_10ms.DeDR_List.DR_List[107].stHeader.TimeStamp CtApImageProcess_FreeRunning.PpDR_Merges_10ms.DeDR_List.DR_List[107].count CtApImageProcess_FreeRunning.PpDR_Merges_10ms.DeDR_List.DR_List[107].time_sec CtApImageProcess_FreeRunning.PpDR_Merges_10ms.DeDR_List.DR_List[107].utm_x CtApImageProcess_FreeRunning.PpDR_Merges_10ms.DeDR_List.DR_List[107].utm_y CtApImageProcess_FreeRunning.PpDR_Merges_10ms.DeDR_List.DR_List[107].utm_z CtApImageProcess_FreeRunning.PpDR_Merges_10ms.DeDR_List.DR_List[107].heading CtApImageProcess_FreeRunning.PpDR_Merges_10ms.DeDR_List.DR_List[107].delta_x CtApImageProcess_FreeRunning.PpDR_Merges_10ms.DeDR_List.DR_List[107].delta_y CtApImageProcess_FreeRunning.PpDR_Merges_10ms.DeDR_List.DR_List[107].delta_z CtApImageProcess_FreeRunning.PpDR_Merges_10ms.DeDR_List.DR_List[107].delta_yaw CtApImageProcess_FreeRunning.PpDR_Merges_10ms.DeDR_List.DR_List[107].belif CtApImageProcess_FreeRunning.PpDR_Merges_10ms.DeDR_List.DR_List[107].reserved_int CtApImageProcess_FreeRunning.PpDR_Merges_10ms.DeDR_List.DR_List[108].stHeader.Counter CtApImageProcess_FreeRunning.PpDR_Merges_10ms.DeDR_List.DR_List[108].stHeader.FrameID CtApImageProcess_FreeRunning.PpDR_Merges_10ms.DeDR_List.DR_List[108].stHeader.TimeStamp CtApImageProcess_FreeRunning.PpDR_Merges_10ms.DeDR_List.DR_List[108].count CtApImageProcess_FreeRunning.PpDR_Merges_10ms.DeDR_List.DR_List[108].time_sec CtApImageProcess_FreeRunning.PpDR_Merges_10ms.DeDR_List.DR_List[108].utm_x CtApImageProcess_FreeRunning.PpDR_Merges_10ms.DeDR_List.DR_List[108].utm_y CtApImageProcess_FreeRunning.PpDR_Merges_10ms.DeDR_List.DR_List[108].utm_z CtApImageProcess_FreeRunning.PpDR_Merges_10ms.DeDR_List.DR_List[108].heading CtApImageProcess_FreeRunning.PpDR_Merges_10ms.DeDR_List.DR_List[108].delta_x CtApImageProcess_FreeRunning.PpDR_Merges_10ms.DeDR_List.DR_List[108].delta_y CtApImageProcess_FreeRunning.PpDR_Merges_10ms.DeDR_List.DR_List[108].delta_z CtApImageProcess_FreeRunning.PpDR_Merges_10ms.DeDR_List.DR_List[108].delta_yaw CtApImageProcess_FreeRunning.PpDR_Merges_10ms.DeDR_List.DR_List[108].belif CtApImageProcess_FreeRunning.PpDR_Merges_10ms.DeDR_List.DR_List[108].reserved_int CtApImageProcess_FreeRunning.PpDR_Merges_10ms.DeDR_List.DR_List[109].stHeader.Counter CtApImageProcess_FreeRunning.PpDR_Merges_10ms.DeDR_List.DR_List[109].stHeader.FrameID CtApImageProcess_FreeRunning.PpDR_Merges_10ms.DeDR_List.DR_List[109].stHeader.TimeStamp CtApImageProcess_FreeRunning.PpDR_Merges_10ms.DeDR_List.DR_List[109].count CtApImageProcess_FreeRunning.PpDR_Merges_10ms.DeDR_List.DR_List[109].time_sec CtApImageProcess_FreeRunning.PpDR_Merges_10ms.DeDR_List.DR_List[109].utm_x CtApImageProcess_FreeRunning.PpDR_Merges_10ms.DeDR_List.DR_List[109].utm_y CtApImageProcess_FreeRunning.PpDR_Merges_10ms.DeDR_List.DR_List[109].utm_z CtApImageProcess_FreeRunning.PpDR_Merges_10ms.DeDR_List.DR_List[109].heading CtApImageProcess_FreeRunning.PpDR_Merges_10ms.DeDR_List.DR_List[109].delta_x CtApImageProcess_FreeRunning.PpDR_Merges_10ms.DeDR_List.DR_List[109].delta_y CtApImageProcess_FreeRunning.PpDR_Merges_10ms.DeDR_List.DR_List[109].delta_z CtApImageProcess_FreeRunning.PpDR_Merges_10ms.DeDR_List.DR_List[109].delta_yaw CtApImageProcess_FreeRunning.PpDR_Merges_10ms.DeDR_List.DR_List[109].belif CtApImageProcess_FreeRunning.PpDR_Merges_10ms.DeDR_List.DR_List[109].reserved_int CtApImageProcess_FreeRunning.PpDsImageProcessDataSet.DeADASDecisionDS.DeStatus CtApImageProcess_FreeRunning.PpDsImageProcessDataSet.DeADASDecisionDS.DeVersion.DeExpectedVersion.DeMajor CtApImageProcess_FreeRunning.PpDsImageProcessDataSet.DeADASDecisionDS.DeVersion.DeExpectedVersion.DeMinor CtApImageProcess_FreeRunning.PpDsImageProcessDataSet.DeADASDecisionDS.DeVersion.DeVersion.DeMajor CtApImageProcess_FreeRunning.PpDsImageProcessDataSet.DeADASDecisionDS.DeVersion.DeVersion.DeMinor CtApImageProcess_FreeRunning.PpDsImageProcessDataSet.DeADASDecisionDS.DeData.data CtApImageProcess_FreeRunning.PpEcuSerialNumber.DeEcuSerialNumber CtApImageProcess_FreeRunning.PpEthernetCom_AVCameraDirt_100ms.DeAVCameraDirt.stHeader.Counter CtApImageProcess_FreeRunning.PpEthernetCom_AVCameraDirt_100ms.DeAVCameraDirt.stHeader.FrameID CtApImageProcess_FreeRunning.PpEthernetCom_AVCameraDirt_100ms.DeAVCameraDirt.stHeader.TimeStamp CtApImageProcess_FreeRunning.PpEthernetCom_AVCameraDirt_100ms.DeAVCameraDirt.AVCameraDirt CtApImageProcess_FreeRunning.PpEthernetCom_AVData_Upload_Status_300ms.DeAVData_Upload_Status.stHeader.Counter CtApImageProcess_FreeRunning.PpEthernetCom_AVData_Upload_Status_300ms.DeAVData_Upload_Status.stHeader.FrameID CtApImageProcess_FreeRunning.PpEthernetCom_AVData_Upload_Status_300ms.DeAVData_Upload_Status.stHeader.TimeStamp CtApImageProcess_FreeRunning.PpEthernetCom_AVData_Upload_Status_300ms.DeAVData_Upload_Status.AVData_Upload_Status CtApImageProcess_FreeRunning.PpEyeQCom2ImageProcess_FreeRunning_300ms.DeEyeQ2ImageProcess.RSD_Message_reserved CtApImageProcess_FreeRunning.PpEyeQCom2ImageProcess_FreeRunning_300ms.DeEyeQ2ImageProcess.Zero_byte CtApImageProcess_FreeRunning.PpEyeQCom2ImageProcess_FreeRunning_300ms.DeEyeQ2ImageProcess.RSD_message_Version CtApImageProcess_FreeRunning.PpEyeQCom2ImageProcess_FreeRunning_300ms.DeEyeQ2ImageProcess.RSD_Sync_ID CtApImageProcess_FreeRunning.PpEyeQCom2ImageProcess_FreeRunning_300ms.DeEyeQ2ImageProcess.RSD_Payload_Byte_0 CtApImageProcess_FreeRunning.PpEyeQCom2ImageProcess_FreeRunning_300ms.DeEyeQ2ImageProcess.RSD_Payload_Byte_1 CtApImageProcess_FreeRunning.PpEyeQCom2ImageProcess_FreeRunning_300ms.DeEyeQ2ImageProcess.RSD_Payload_Byte_2 CtApImageProcess_FreeRunning.PpEyeQCom2ImageProcess_FreeRunning_300ms.DeEyeQ2ImageProcess.RSD_Payload_Byte_3 CtApImageProcess_FreeRunning.PpEyeQCom2ImageProcess_FreeRunning_300ms.DeEyeQ2ImageProcess.RSD_Payload_Byte_4 CtApImageProcess_FreeRunning.PpEyeQCom2ImageProcess_FreeRunning_300ms.DeEyeQ2ImageProcess.RSD_Payload_Byte_5 CtApImageProcess_FreeRunning.PpEyeQCom2ImageProcess_FreeRunning_300ms.DeEyeQ2ImageProcess.RSD_Payload_Byte_6 CtApImageProcess_FreeRunning.PpEyeQCom2ImageProcess_FreeRunning_300ms.DeEyeQ2ImageProcess.RSD_Payload_Byte_7 CtApImageProcess_FreeRunning.PpEyeQCom2ImageProcess_FreeRunning_300ms.DeEyeQ2ImageProcess.RSD_Payload_Byte_8 CtApImageProcess_FreeRunning.PpEyeQCom2ImageProcess_FreeRunning_300ms.DeEyeQ2ImageProcess.RSD_Payload_Byte_9 CtApImageProcess_FreeRunning.PpEyeQCom2ImageProcess_FreeRunning_300ms.DeEyeQ2ImageProcess.RSD_Payload_Byte_10 CtApImageProcess_FreeRunning.PpEyeQCom2ImageProcess_FreeRunning_300ms.DeEyeQ2ImageProcess.RSD_Payload_Byte_11 CtApImageProcess_FreeRunning.PpEyeQCom2ImageProcess_FreeRunning_300ms.DeEyeQ2ImageProcess.RSD_Payload_Byte_12 CtApImageProcess_FreeRunning.PpEyeQCom2ImageProcess_FreeRunning_300ms.DeEyeQ2ImageProcess.RSD_Payload_Byte_13 CtApImageProcess_FreeRunning.PpEyeQCom2ImageProcess_FreeRunning_300ms.DeEyeQ2ImageProcess.RSD_Payload_Byte_14 CtApImageProcess_FreeRunning.PpEyeQCom2ImageProcess_FreeRunning_300ms.DeEyeQ2ImageProcess.RSD_Payload_Byte_15 CtApImageProcess_FreeRunning.PpEyeQCom2ImageProcess_FreeRunning_300ms.DeEyeQ2ImageProcess.RSD_Payload_Byte_16 CtApImageProcess_FreeRunning.PpEyeQCom2ImageProcess_FreeRunning_300ms.DeEyeQ2ImageProcess.RSD_Payload_Byte_17 CtApImageProcess_FreeRunning.PpEyeQCom2ImageProcess_FreeRunning_300ms.DeEyeQ2ImageProcess.RSD_Payload_Byte_18 CtApImageProcess_FreeRunning.PpEyeQCom2ImageProcess_FreeRunning_300ms.DeEyeQ2ImageProcess.RSD_Payload_Byte_19 CtApImageProcess_FreeRunning.PpEyeQCom2ImageProcess_FreeRunning_300ms.DeEyeQ2ImageProcess.RSD_Payload_Byte_20 CtApImageProcess_FreeRunning.PpEyeQCom2ImageProcess_FreeRunning_300ms.DeEyeQ2ImageProcess.RSD_Payload_Byte_21 CtApImageProcess_FreeRunning.PpEyeQCom2ImageProcess_FreeRunning_300ms.DeEyeQ2ImageProcess.RSD_Payload_Byte_22 CtApImageProcess_FreeRunning.PpEyeQCom2ImageProcess_FreeRunning_300ms.DeEyeQ2ImageProcess.RSD_Payload_Byte_23 CtApImageProcess_FreeRunning.PpEyeQCom2ImageProcess_FreeRunning_300ms.DeEyeQ2ImageProcess.RSD_Payload_Byte_24 CtApImageProcess_FreeRunning.PpEyeQCom2ImageProcess_FreeRunning_300ms.DeEyeQ2ImageProcess.RSD_Payload_Byte_25 CtApImageProcess_FreeRunning.PpEyeQCom2ImageProcess_FreeRunning_300ms.DeEyeQ2ImageProcess.RSD_Payload_Byte_26 CtApImageProcess_FreeRunning.PpEyeQCom2ImageProcess_FreeRunning_300ms.DeEyeQ2ImageProcess.RSD_Payload_Byte_27 CtApImageProcess_FreeRunning.PpEyeQCom2ImageProcess_FreeRunning_300ms.DeEyeQ2ImageProcess.RSD_Payload_Byte_28 CtApImageProcess_FreeRunning.PpEyeQCom2ImageProcess_FreeRunning_300ms.DeEyeQ2ImageProcess.RSD_Payload_Byte_29 CtApImageProcess_FreeRunning.PpEyeQCom2ImageProcess_FreeRunning_300ms.DeEyeQ2ImageProcess.RSD_Payload_Byte_30 CtApImageProcess_FreeRunning.PpEyeQCom2ImageProcess_FreeRunning_300ms.DeEyeQ2ImageProcess.RSD_Payload_Byte_31 CtApImageProcess_FreeRunning.PpEyeQCom2ImageProcess_FreeRunning_300ms.DeEyeQ2ImageProcess.RSD_Payload_Byte_32 CtApImageProcess_FreeRunning.PpEyeQCom2ImageProcess_FreeRunning_300ms.DeEyeQ2ImageProcess.RSD_Payload_Byte_33 CtApImageProcess_FreeRunning.PpEyeQCom2ImageProcess_FreeRunning_300ms.DeEyeQ2ImageProcess.RSD_Payload_Byte_34 CtApImageProcess_FreeRunning.PpEyeQCom2ImageProcess_FreeRunning_300ms.DeEyeQ2ImageProcess.RSD_Payload_Byte_35 CtApImageProcess_FreeRunning.PpEyeQCom2ImageProcess_FreeRunning_300ms.DeEyeQ2ImageProcess.RSD_Payload_Byte_36 CtApImageProcess_FreeRunning.PpEyeQCom2ImageProcess_FreeRunning_300ms.DeEyeQ2ImageProcess.RSD_Payload_Byte_37 CtApImageProcess_FreeRunning.PpEyeQCom2ImageProcess_FreeRunning_300ms.DeEyeQ2ImageProcess.RSD_Payload_Byte_38 CtApImageProcess_FreeRunning.PpEyeQCom2ImageProcess_FreeRunning_300ms.DeEyeQ2ImageProcess.RSD_Payload_Byte_39 CtApImageProcess_FreeRunning.PpEyeQCom2ImageProcess_FreeRunning_300ms.DeEyeQ2ImageProcess.RSD_Payload_Byte_40 CtApImageProcess_FreeRunning.PpEyeQCom2ImageProcess_FreeRunning_300ms.DeEyeQ2ImageProcess.RSD_Payload_Byte_41 CtApImageProcess_FreeRunning.PpEyeQCom2ImageProcess_FreeRunning_300ms.DeEyeQ2ImageProcess.RSD_Payload_Byte_42 CtApImageProcess_FreeRunning.PpEyeQCom2ImageProcess_FreeRunning_300ms.DeEyeQ2ImageProcess.RSD_Payload_Byte_43 CtApImageProcess_FreeRunning.PpEyeQCom2ImageProcess_FreeRunning_300ms.DeEyeQ2ImageProcess.RSD_Payload_Byte_44 CtApImageProcess_FreeRunning.PpEyeQCom2ImageProcess_FreeRunning_300ms.DeEyeQ2ImageProcess.RSD_Payload_Byte_45 CtApImageProcess_FreeRunning.PpEyeQCom2ImageProcess_FreeRunning_300ms.DeEyeQ2ImageProcess.RSD_Payload_Byte_46 CtApImageProcess_FreeRunning.PpEyeQCom2ImageProcess_FreeRunning_300ms.DeEyeQ2ImageProcess.RSD_Payload_Byte_47 CtApImageProcess_FreeRunning.PpEyeQCom2ImageProcess_FreeRunning_300ms.DeEyeQ2ImageProcess.RSD_Payload_Byte_48 CtApImageProcess_FreeRunning.PpEyeQCom2ImageProcess_FreeRunning_300ms.DeEyeQ2ImageProcess.RSD_Payload_Byte_49 CtApImageProcess_FreeRunning.PpEyeQCom2ImageProcess_FreeRunning_300ms.DeEyeQ2ImageProcess.RSD_Payload_Byte_50 CtApImageProcess_FreeRunning.PpEyeQCom2ImageProcess_FreeRunning_300ms.DeEyeQ2ImageProcess.RSD_Payload_Byte_51 CtApImageProcess_FreeRunning.PpEyeQCom2ImageProcess_FreeRunning_300ms.DeEyeQ2ImageProcess.RSD_Payload_Byte_52 CtApImageProcess_FreeRunning.PpEyeQCom2ImageProcess_FreeRunning_300ms.DeEyeQ2ImageProcess.RSD_Payload_Byte_53 CtApImageProcess_FreeRunning.PpEyeQCom2ImageProcess_FreeRunning_300ms.DeEyeQ2ImageProcess.RSD_Payload_Byte_54 CtApImageProcess_FreeRunning.PpEyeQCom2ImageProcess_FreeRunning_300ms.DeEyeQ2ImageProcess.RSD_Payload_Byte_55 CtApImageProcess_FreeRunning.PpEyeQCom2ImageProcess_FreeRunning_300ms.DeEyeQ2ImageProcess.RSD_Payload_Byte_56 CtApImageProcess_FreeRunning.PpEyeQCom2ImageProcess_FreeRunning_300ms.DeEyeQ2ImageProcess.RSD_Payload_Byte_57 CtApImageProcess_FreeRunning.PpEyeQCom2ImageProcess_FreeRunning_300ms.DeEyeQ2ImageProcess.RSD_Payload_Byte_58 CtApImageProcess_FreeRunning.PpEyeQCom2ImageProcess_FreeRunning_300ms.DeEyeQ2ImageProcess.RSD_Payload_Byte_59 CtApImageProcess_FreeRunning.PpEyeQCom2ImageProcess_FreeRunning_300ms.DeEyeQ2ImageProcess.RSD_Payload_Byte_60 CtApImageProcess_FreeRunning.PpEyeQCom2ImageProcess_FreeRunning_300ms.DeEyeQ2ImageProcess.RSD_Payload_Byte_61 CtApImageProcess_FreeRunning.PpEyeQCom2ImageProcess_FreeRunning_300ms.DeEyeQ2ImageProcess.RSD_Payload_Byte_62 CtApImageProcess_FreeRunning.PpEyeQCom2ImageProcess_FreeRunning_300ms.DeEyeQ2ImageProcess.RSD_Payload_Byte_63 CtApImageProcess_FreeRunning.PpEyeQCom2ImageProcess_FreeRunning_300ms.DeEyeQ2ImageProcess.RSD_Payload_Byte_64 CtApImageProcess_FreeRunning.PpEyeQCom2ImageProcess_FreeRunning_300ms.DeEyeQ2ImageProcess.RSD_Payload_Byte_65 CtApImageProcess_FreeRunning.PpEyeQCom2ImageProcess_FreeRunning_300ms.DeEyeQ2ImageProcess.RSD_Payload_Byte_66 CtApImageProcess_FreeRunning.PpEyeQCom2ImageProcess_FreeRunning_300ms.DeEyeQ2ImageProcess.RSD_Payload_Byte_67 CtApImageProcess_FreeRunning.PpEyeQCom2ImageProcess_FreeRunning_300ms.DeEyeQ2ImageProcess.RSD_Payload_Byte_68 CtApImageProcess_FreeRunning.PpEyeQCom2ImageProcess_FreeRunning_300ms.DeEyeQ2ImageProcess.RSD_Payload_Byte_69 CtApImageProcess_FreeRunning.PpEyeQCom2ImageProcess_FreeRunning_300ms.DeEyeQ2ImageProcess.RSD_Payload_Byte_70 CtApImageProcess_FreeRunning.PpEyeQCom2ImageProcess_FreeRunning_300ms.DeEyeQ2ImageProcess.RSD_Payload_Byte_71 CtApImageProcess_FreeRunning.PpEyeQCom2ImageProcess_FreeRunning_300ms.DeEyeQ2ImageProcess.RSD_Payload_Byte_72 CtApImageProcess_FreeRunning.PpEyeQCom2ImageProcess_FreeRunning_300ms.DeEyeQ2ImageProcess.RSD_Payload_Byte_73 CtApImageProcess_FreeRunning.PpEyeQCom2ImageProcess_FreeRunning_300ms.DeEyeQ2ImageProcess.RSD_Payload_Byte_74 CtApImageProcess_FreeRunning.PpEyeQCom2ImageProcess_FreeRunning_300ms.DeEyeQ2ImageProcess.RSD_Payload_Byte_75 CtApImageProcess_FreeRunning.PpEyeQCom2ImageProcess_FreeRunning_300ms.DeEyeQ2ImageProcess.RSD_Payload_Byte_76 CtApImageProcess_FreeRunning.PpEyeQCom2ImageProcess_FreeRunning_300ms.DeEyeQ2ImageProcess.RSD_Payload_Byte_77 CtApImageProcess_FreeRunning.PpEyeQCom2ImageProcess_FreeRunning_300ms.DeEyeQ2ImageProcess.RSD_Payload_Byte_78 CtApImageProcess_FreeRunning.PpEyeQCom2ImageProcess_FreeRunning_300ms.DeEyeQ2ImageProcess.RSD_Payload_Byte_79 CtApImageProcess_FreeRunning.PpEyeQCom2ImageProcess_FreeRunning_300ms.DeEyeQ2ImageProcess.RSD_Payload_Byte_80 CtApImageProcess_FreeRunning.PpEyeQCom2ImageProcess_FreeRunning_300ms.DeEyeQ2ImageProcess.RSD_Payload_Byte_81 CtApImageProcess_FreeRunning.PpEyeQCom2ImageProcess_FreeRunning_300ms.DeEyeQ2ImageProcess.RSD_Payload_Byte_82 CtApImageProcess_FreeRunning.PpEyeQCom2ImageProcess_FreeRunning_300ms.DeEyeQ2ImageProcess.RSD_Payload_Byte_83 CtApImageProcess_FreeRunning.PpEyeQCom2ImageProcess_FreeRunning_300ms.DeEyeQ2ImageProcess.RSD_Payload_Byte_84 CtApImageProcess_FreeRunning.PpEyeQCom2ImageProcess_FreeRunning_300ms.DeEyeQ2ImageProcess.RSD_Payload_Byte_85 CtApImageProcess_FreeRunning.PpEyeQCom2ImageProcess_FreeRunning_300ms.DeEyeQ2ImageProcess.RSD_Payload_Byte_86 CtApImageProcess_FreeRunning.PpEyeQCom2ImageProcess_FreeRunning_300ms.DeEyeQ2ImageProcess.RSD_Payload_Byte_87 CtApImageProcess_FreeRunning.PpEyeQCom2ImageProcess_FreeRunning_300ms.DeEyeQ2ImageProcess.RSD_Payload_Byte_88 CtApImageProcess_FreeRunning.PpEyeQCom2ImageProcess_FreeRunning_300ms.DeEyeQ2ImageProcess.RSD_Payload_Byte_89 CtApImageProcess_FreeRunning.PpEyeQCom2ImageProcess_FreeRunning_300ms.DeEyeQ2ImageProcess.RSD_Payload_Byte_90 CtApImageProcess_FreeRunning.PpEyeQCom2ImageProcess_FreeRunning_300ms.DeEyeQ2ImageProcess.RSD_Payload_Byte_91 CtApImageProcess_FreeRunning.PpEyeQCom2ImageProcess_FreeRunning_300ms.DeEyeQ2ImageProcess.RSD_Payload_Byte_92 CtApImageProcess_FreeRunning.PpEyeQCom2ImageProcess_FreeRunning_300ms.DeEyeQ2ImageProcess.RSD_Payload_Byte_93 CtApImageProcess_FreeRunning.PpEyeQCom2ImageProcess_FreeRunning_300ms.DeEyeQ2ImageProcess.RSD_Payload_Byte_94 CtApImageProcess_FreeRunning.PpEyeQCom2ImageProcess_FreeRunning_300ms.DeEyeQ2ImageProcess.RSD_Payload_Byte_95 CtApImageProcess_FreeRunning.PpEyeQCom2ImageProcess_FreeRunning_300ms.DeEyeQ2ImageProcess.RSD_Payload_Byte_96 CtApImageProcess_FreeRunning.PpEyeQCom2ImageProcess_FreeRunning_300ms.DeEyeQ2ImageProcess.RSD_Payload_Byte_97 CtApImageProcess_FreeRunning.PpEyeQCom2ImageProcess_FreeRunning_300ms.DeEyeQ2ImageProcess.RSD_Payload_Byte_98 CtApImageProcess_FreeRunning.PpEyeQCom2ImageProcess_FreeRunning_300ms.DeEyeQ2ImageProcess.RSD_Payload_Byte_99 CtApImageProcess_FreeRunning.PpEyeQCom2ImageProcess_FreeRunning_300ms.DeEyeQ2ImageProcess.RSD_Payload_Byte_100 CtApImageProcess_FreeRunning.PpEyeQCom2ImageProcess_FreeRunning_300ms.DeEyeQ2ImageProcess.RSD_Payload_Byte_101 CtApImageProcess_FreeRunning.PpEyeQCom2ImageProcess_FreeRunning_300ms.DeEyeQ2ImageProcess.RSD_Payload_Byte_102 CtApImageProcess_FreeRunning.PpEyeQCom2ImageProcess_FreeRunning_300ms.DeEyeQ2ImageProcess.RSD_Payload_Byte_103 CtApImageProcess_FreeRunning.PpEyeQCom2ImageProcess_FreeRunning_300ms.DeEyeQ2ImageProcess.RSD_Payload_Byte_104 CtApImageProcess_FreeRunning.PpEyeQCom2ImageProcess_FreeRunning_300ms.DeEyeQ2ImageProcess.RSD_Payload_Byte_105 CtApImageProcess_FreeRunning.PpEyeQCom2ImageProcess_FreeRunning_300ms.DeEyeQ2ImageProcess.RSD_Payload_Byte_106 CtApImageProcess_FreeRunning.PpEyeQCom2ImageProcess_FreeRunning_300ms.DeEyeQ2ImageProcess.RSD_Payload_Byte_107 CtApImageProcess_FreeRunning.PpEyeQCom2ImageProcess_FreeRunning_300ms.DeEyeQ2ImageProcess.RSD_Payload_Byte_108 CtApImageProcess_FreeRunning.PpEyeQCom2ImageProcess_FreeRunning_300ms.DeEyeQ2ImageProcess.RSD_Payload_Byte_109 CtApImageProcess_FreeRunning.PpEyeQCom2ImageProcess_FreeRunning_300ms.DeEyeQ2ImageProcess.RSD_Payload_Byte_110 CtApImageProcess_FreeRunning.PpEyeQCom2ImageProcess_FreeRunning_300ms.DeEyeQ2ImageProcess.RSD_Payload_Byte_111 CtApImageProcess_FreeRunning.PpEyeQCom2ImageProcess_FreeRunning_300ms.DeEyeQ2ImageProcess.RSD_Payload_Byte_112 CtApImageProcess_FreeRunning.PpInertialProcess_IMUInfo2ImageProcess_10ms.DeInertialProcess_Info.stHeader.Counter CtApImageProcess_FreeRunning.PpInertialProcess_IMUInfo2ImageProcess_10ms.DeInertialProcess_Info.stHeader.FrameID CtApImageProcess_FreeRunning.PpInertialProcess_IMUInfo2ImageProcess_10ms.DeInertialProcess_Info.stHeader.TimeStamp CtApImageProcess_FreeRunning.PpInertialProcess_IMUInfo2ImageProcess_10ms.DeInertialProcess_Info.fLatitude CtApImageProcess_FreeRunning.PpInertialProcess_IMUInfo2ImageProcess_10ms.DeInertialProcess_Info.fLongitude CtApImageProcess_FreeRunning.PpInertialProcess_IMUInfo2ImageProcess_10ms.DeInertialProcess_Info.fAltitude CtApImageProcess_FreeRunning.PpInertialProcess_IMUInfo2ImageProcess_10ms.DeInertialProcess_Info.fAccX CtApImageProcess_FreeRunning.PpInertialProcess_IMUInfo2ImageProcess_10ms.DeInertialProcess_Info.fAccY CtApImageProcess_FreeRunning.PpInertialProcess_IMUInfo2ImageProcess_10ms.DeInertialProcess_Info.fAccZ CtApImageProcess_FreeRunning.PpInertialProcess_IMUInfo2ImageProcess_10ms.DeInertialProcess_Info.fAngRateX CtApImageProcess_FreeRunning.PpInertialProcess_IMUInfo2ImageProcess_10ms.DeInertialProcess_Info.fAngRateY CtApImageProcess_FreeRunning.PpInertialProcess_IMUInfo2ImageProcess_10ms.DeInertialProcess_Info.fAngRateZ CtApImageProcess_FreeRunning.PpInertialProcess_IMUInfo2ImageProcess_10ms.DeInertialProcess_Info.fVelNorth CtApImageProcess_FreeRunning.PpInertialProcess_IMUInfo2ImageProcess_10ms.DeInertialProcess_Info.fVelWest CtApImageProcess_FreeRunning.PpInertialProcess_IMUInfo2ImageProcess_10ms.DeInertialProcess_Info.fVelUp CtApImageProcess_FreeRunning.PpInertialProcess_IMUInfo2ImageProcess_10ms.DeInertialProcess_Info.fHeading CtApImageProcess_FreeRunning.PpInertialProcess_IMUInfo2ImageProcess_10ms.DeInertialProcess_Info.fPitch CtApImageProcess_FreeRunning.PpInertialProcess_IMUInfo2ImageProcess_10ms.DeInertialProcess_Info.fRoll CtApImageProcess_FreeRunning.PpInertialProcess_IMUInfo2ImageProcess_10ms.DeInertialProcess_Info.nNavStatus CtApImageProcess_FreeRunning.PpInertialProcess_IMUInfo2ImageProcess_10ms.DeInertialProcess_Info.nInitStatusPosition CtApImageProcess_FreeRunning.PpInertialProcess_IMUInfo2ImageProcess_10ms.DeInertialProcess_Info.nInitstatusVel CtApImageProcess_FreeRunning.PpInertialProcess_IMUInfo2ImageProcess_10ms.DeInertialProcess_Info.nInitstatusRP CtApImageProcess_FreeRunning.PpInertialProcess_IMUInfo2ImageProcess_10ms.DeInertialProcess_Info.nInitstatusH CtApImageProcess_FreeRunning.PpInertialProcess_IMUInfo2ImageProcess_10ms.DeInertialProcess_Info.dGPSTime CtApImageProcess_FreeRunning.PpInertialProcess_IMUInfo2ImageProcess_10ms.DeInertialProcess_Info.stdstd CtApImageProcess_FreeRunning.PpInertialProcess_IMUInfo2ImageProcess_10ms.DeInertialProcess_Info.iGPSPositionMode CtApImageProcess_FreeRunning.PpInertialProcess_IMUInfo2ImageProcess_10ms.DeInertialProcess_Info.iGPSVelMode CtApImageProcess_FreeRunning.PpInertialProcess_IMUInfo2ImageProcess_10ms.DeInertialProcess_Info.iDaulAntennaOrientationMode CtApImageProcess_FreeRunning.PpInertialProcess_IMUInfo2ImageProcess_10ms.DeInertialProcess_Info.iSINSMode CtApImageProcess_FreeRunning.PpInertialProcess_IMUInfo2ImageProcess_10ms.DeInertialProcess_Info.bkp CtApImageProcess_FreeRunning.PpParkingLot_Ctrl_40ms.DeSVCtrl.stHeader.Counter CtApImageProcess_FreeRunning.PpParkingLot_Ctrl_40ms.DeSVCtrl.stHeader.FrameID CtApImageProcess_FreeRunning.PpParkingLot_Ctrl_40ms.DeSVCtrl.stHeader.TimeStamp CtApImageProcess_FreeRunning.PpParkingLot_Ctrl_40ms.DeSVCtrl.isParkingSearchFuncEnable CtApImageProcess_FreeRunning.PpParkingLot_Ctrl_40ms.DeSVCtrl.isParkinglotTrackingFuncEnable CtApImageProcess_FreeRunning.PpParkingLot_Ctrl_40ms.DeSVCtrl.isOfilmParkinglotTrackingID CtApImageProcess_FreeRunning.PpParkingLot_Ctrl_40ms.DeSVCtrl.isParkinglotTrackingID CtApImageProcess_FreeRunning.PpParkingLot_Ctrl_40ms.DeSVCtrl.isParkingFuncEnable CtApImageProcess_FreeRunning.PpParkingLot_Ctrl_40ms.DeSVCtrl.fReserved CtApImageProcess_FreeRunning.PpPathPlanner_Planner2AllModules_100ms.DePlanner_PlannerEnvirInfo.stHeader.Counter CtApImageProcess_FreeRunning.PpPathPlanner_Planner2AllModules_100ms.DePlanner_PlannerEnvirInfo.stHeader.FrameID CtApImageProcess_FreeRunning.PpPathPlanner_Planner2AllModules_100ms.DePlanner_PlannerEnvirInfo.stHeader.TimeStamp CtApImageProcess_FreeRunning.PpPathPlanner_Planner2AllModules_100ms.DePlanner_PlannerEnvirInfo.nDriveEnviorment CtApImageProcess_FreeRunning.PpPathPlanner_Planner2AllModules_100ms.DePlanner_PlannerEnvirInfo.nCurrentBehavior CtApImageProcess_FreeRunning.PpPathPlanner_Planner2AllModules_100ms.DePlanner_PlannerEnvirInfo.APACtlCmd CtApImageProcess_FreeRunning.PpPathPlanner_Planner2AllModules_100ms.DePlanner_PlannerEnvirInfo.fSpeed CtApImageProcess_FreeRunning.PpPathPlanner_Planner2AllModules_100ms.DePlanner_PlannerEnvirInfo.bScanningEnable CtApImageProcess_FreeRunning.PpPathPlanner_Planner2AllModules_100ms.DePlanner_PlannerEnvirInfo.fReserved CtApImageProcess_FreeRunning.PpPathPlanner_Planner2AllModules_100ms.DePlanner_PlannerEnvirInfo.nReserved CtApImageProcess_FreeRunning.PpPdImageProcess_FreeRunningRead.DeImageProcess_FreeRunning_Normal.DeStatus CtApImageProcess_FreeRunning.PpPdImageProcess_FreeRunningRead.DeImageProcess_FreeRunning_Normal.DeVersion.DeExpectedVersion.DeMajor CtApImageProcess_FreeRunning.PpPdImageProcess_FreeRunningRead.DeImageProcess_FreeRunning_Normal.DeVersion.DeExpectedVersion.DeMinor CtApImageProcess_FreeRunning.PpPdImageProcess_FreeRunningRead.DeImageProcess_FreeRunning_Normal.DeVersion.DeVersion.DeMajor CtApImageProcess_FreeRunning.PpPdImageProcess_FreeRunningRead.DeImageProcess_FreeRunning_Normal.DeVersion.DeVersion.DeMinor CtApImageProcess_FreeRunning.PpPdImageProcess_FreeRunningRead.DeImageProcess_FreeRunning_Normal.DeData.ngSignal CtApImageProcess_FreeRunning.PpPdImageProcess_FreeRunningRead.DeImageProcess_FreeRunning_Normal.DeData.fgSignal CtApImageProcess_FreeRunning.PpPdImageProcess_FreeRunningRead.DeImageProcess_Normal.DeStatus CtApImageProcess_FreeRunning.PpPdImageProcess_FreeRunningRead.DeImageProcess_Normal.DeVersion.DeExpectedVersion.DeMajor CtApImageProcess_FreeRunning.PpPdImageProcess_FreeRunningRead.DeImageProcess_Normal.DeVersion.DeExpectedVersion.DeMinor CtApImageProcess_FreeRunning.PpPdImageProcess_FreeRunningRead.DeImageProcess_Normal.DeVersion.DeVersion.DeMajor CtApImageProcess_FreeRunning.PpPdImageProcess_FreeRunningRead.DeImageProcess_Normal.DeVersion.DeVersion.DeMinor CtApImageProcess_FreeRunning.PpPdImageProcess_FreeRunningRead.DeImageProcess_Normal.DeData.stHeader_Counter CtApImageProcess_FreeRunning.PpPdImageProcess_FreeRunningRead.DeImageProcess_Normal.DeData.stHeader_FrameID CtApImageProcess_FreeRunning.PpPdImageProcess_FreeRunningRead.DeImageProcess_Normal.DeData.stHeader_TimeStamp CtApImageProcess_FreeRunning.PpPdImageProcess_FreeRunningRead.DeImageProcess_Normal.DeData.stCamInt_w CtApImageProcess_FreeRunning.PpPdImageProcess_FreeRunningRead.DeImageProcess_Normal.DeData.stCamInt_h CtApImageProcess_FreeRunning.PpPdImageProcess_FreeRunningRead.DeImageProcess_Normal.DeData.stCamInt_cu CtApImageProcess_FreeRunning.PpPdImageProcess_FreeRunningRead.DeImageProcess_Normal.DeData.stCamInt_cv CtApImageProcess_FreeRunning.PpPdImageProcess_FreeRunningRead.DeImageProcess_Normal.DeData.stCamInt_skew_c CtApImageProcess_FreeRunning.PpPdImageProcess_FreeRunningRead.DeImageProcess_Normal.DeData.stCamInt_skew_d CtApImageProcess_FreeRunning.PpPdImageProcess_FreeRunningRead.DeImageProcess_Normal.DeData.stCamInt_skew_e CtApImageProcess_FreeRunning.PpPdImageProcess_FreeRunningRead.DeImageProcess_Normal.DeData.stCamInt_fu_or_hfov_at_cu CtApImageProcess_FreeRunning.PpPdImageProcess_FreeRunningRead.DeImageProcess_Normal.DeData.stCamInt_fu_or_hfov_at_cv CtApImageProcess_FreeRunning.PpPdImageProcess_FreeRunningRead.DeImageProcess_Normal.DeData.stCamInt_use_fov CtApImageProcess_FreeRunning.PpPdImageProcess_FreeRunningRead.DeImageProcess_Normal.DeData.stCamInt_lut CtApImageProcess_FreeRunning.PpPdImageProcess_FreeRunningRead.DeImageProcess_Normal.DeData.stCamExt_rx CtApImageProcess_FreeRunning.PpPdImageProcess_FreeRunningRead.DeImageProcess_Normal.DeData.stCamExt_ry CtApImageProcess_FreeRunning.PpPdImageProcess_FreeRunningRead.DeImageProcess_Normal.DeData.stCamExt_rz CtApImageProcess_FreeRunning.PpPdImageProcess_FreeRunningRead.DeImageProcess_Normal.DeData.stCamExt_tx CtApImageProcess_FreeRunning.PpPdImageProcess_FreeRunningRead.DeImageProcess_Normal.DeData.stCamExt_ty CtApImageProcess_FreeRunning.PpPdImageProcess_FreeRunningRead.DeImageProcess_Normal.DeData.stCamExt_tz CtApImageProcess_FreeRunning.PpPdImageProcess_FreeRunningRead.DeImageProcess_Normal.DeData.stCarParam_eachPulseDist CtApImageProcess_FreeRunning.PpPdImageProcess_FreeRunningRead.DeImageProcess_Normal.DeData.stCarParam_frontWheelDriven CtApImageProcess_FreeRunning.PpPdImageProcess_FreeRunningRead.DeImageProcess_Normal.DeData.stCarParam_reserved CtApImageProcess_FreeRunning.PpPdImageProcess_FreeRunningRead.DeImageProcess_Normal.DeData.stCarParam_gnMotionModelCalib_01 CtApImageProcess_FreeRunning.PpPdImageProcess_FreeRunningRead.DeImageProcess_Normal.DeData.stCarParam_gnMotionModelCalib_02 CtApImageProcess_FreeRunning.PpPdImageProcess_FreeRunningRead.DeImageProcess_Normal.DeData.stCarParam_gnMotionModelCalib_03 CtApImageProcess_FreeRunning.PpPdImageProcess_FreeRunningRead.DeImageProcess_Normal.DeData.stCarParam_gnMotionModelCalib_04 CtApImageProcess_FreeRunning.PpPdImageProcess_FreeRunningRead.DeImageProcess_Normal.DeData.stCarParam_gnMotionModelCalib_05 CtApImageProcess_FreeRunning.PpPdImageProcess_FreeRunningRead.DeImageProcess_Normal.DeData.stCarParam_gnMotionModelCalib_06 CtApImageProcess_FreeRunning.PpPdImageProcess_FreeRunningRead.DeImageProcessSec_Normal.DeStatus CtApImageProcess_FreeRunning.PpPdImageProcess_FreeRunningRead.DeImageProcessSec_Normal.DeVersion.DeExpectedVersion.DeMajor CtApImageProcess_FreeRunning.PpPdImageProcess_FreeRunningRead.DeImageProcessSec_Normal.DeVersion.DeExpectedVersion.DeMinor CtApImageProcess_FreeRunning.PpPdImageProcess_FreeRunningRead.DeImageProcessSec_Normal.DeVersion.DeVersion.DeMajor CtApImageProcess_FreeRunning.PpPdImageProcess_FreeRunningRead.DeImageProcessSec_Normal.DeVersion.DeVersion.DeMinor CtApImageProcess_FreeRunning.PpPdImageProcess_FreeRunningRead.DeImageProcessSec_Normal.DeData CtApImageProcess_FreeRunning.PpPfInformation.DeBuildDate.status CtApImageProcess_FreeRunning.PpPfInformation.DeBuildDate.nanoseconds CtApImageProcess_FreeRunning.PpPfInformation.DeBuildDate.seconds CtApImageProcess_FreeRunning.PpPfInformation.DeBuildDate.secondsHigh CtApImageProcess_FreeRunning.PpPfInformation.DeBuildRevision CtApImageProcess_FreeRunning.PpPfInformation.DePlatformVersion.DeMajor CtApImageProcess_FreeRunning.PpPfInformation.DePlatformVersion.DeMinor CtApImageProcess_FreeRunning.PpPfInformation.DePlatformVersion.DePatch CtApImageProcess_FreeRunning.PpPfInformation.DeReleaseType CtApImageProcess_FreeRunning.PpPfInformation.DeSystemVersion.DeMajor CtApImageProcess_FreeRunning.PpPfInformation.DeSystemVersion.DeMinor CtApImageProcess_FreeRunning.PpPfInformation.DeSystemVersion.DePatch CtApImageProcess_FreeRunning.PpPFProvidedData.DeIFSETVersion.DeMajor CtApImageProcess_FreeRunning.PpPFProvidedData.DeIFSETVersion.DeMinor CtApImageProcess_FreeRunning.PpPFProvidedData.DeIFSETVersion.DePatch CtApImageProcess_FreeRunning.PpPFProvidedData.DeLCSPH00State CtApImageProcess_FreeRunning.PpPFProvidedData.DeLCSSH00State CtApImageProcess_FreeRunning.PpPFProvidedData.DeLCSSH01State CtApImageProcess_FreeRunning.PpPFProvidedData.DeLCSSystemState CtApImageProcess_FreeRunning.PpPFProvidedData.DeVARHWVariant CtApImageProcess_FreeRunning.PpStateMonitor_FailureAction_50ms.DeFltActnReq.stHeader.Counter CtApImageProcess_FreeRunning.PpStateMonitor_FailureAction_50ms.DeFltActnReq.stHeader.FrameID CtApImageProcess_FreeRunning.PpStateMonitor_FailureAction_50ms.DeFltActnReq.stHeader.TimeStamp CtApImageProcess_FreeRunning.PpStateMonitor_FailureAction_50ms.DeFltActnReq.FltActnReq CtApImageProcess_FreeRunning.PpStateMonitor_FailureAction_50ms.DeFltActnReq.Reserved CtApImageProcess_FreeRunning.PpStateMonitor_FailureAction_50ms.DeFltIndicator.stHeader.Counter CtApImageProcess_FreeRunning.PpStateMonitor_FailureAction_50ms.DeFltIndicator.stHeader.FrameID CtApImageProcess_FreeRunning.PpStateMonitor_FailureAction_50ms.DeFltIndicator.stHeader.TimeStamp CtApImageProcess_FreeRunning.PpStateMonitor_FailureAction_50ms.DeFltIndicator.PilotFltSt CtApImageProcess_FreeRunning.PpStateMonitor_FailureAction_50ms.DeFltIndicator.ACCtFltSt CtApImageProcess_FreeRunning.PpStateMonitor_FailureAction_50ms.DeFltIndicator.ParkingtFltSt CtApImageProcess_FreeRunning.PpStateMonitor_FailureAction_50ms.DeFltIndicator.SwDTCReq CtApImageProcess_FreeRunning.PpStateMonitor_FailureAction_50ms.DeFltIndicator.DataRecReq CtApImageProcess_FreeRunning.PpStateMonitor_FailureAction_50ms.DeFltIndicator.reserved CtApImageProcess_FreeRunning.PpStateMonitor_FailureAction_50ms.DeStateMonitor_BKP.StateMonitor_BKP CtApImageProcess_FreeRunning.PpSysManager_DrivingModeSts_50ms.DeDrivingModeSts.stHeader.Counter CtApImageProcess_FreeRunning.PpSysManager_DrivingModeSts_50ms.DeDrivingModeSts.stHeader.FrameID CtApImageProcess_FreeRunning.PpSysManager_DrivingModeSts_50ms.DeDrivingModeSts.stHeader.TimeStamp CtApImageProcess_FreeRunning.PpSysManager_DrivingModeSts_50ms.DeDrivingModeSts.nWarningLevel CtApImageProcess_FreeRunning.PpSysManager_DrivingModeSts_50ms.DeDrivingModeSts.nDrivingStatus CtApImageProcess_FreeRunning.PpSysManager_DrivingModeSts_50ms.DeDrivingModeSts.nDrivingMode CtApImageProcess_FreeRunning.PpSysManager_DrivingModeSts_50ms.DeDrivingModeSts.ngBKP CtApImageProcess_FreeRunning.PpSysManager_MobileyeGenericSensor_10ms.DeMobileyeGenericSensor.Steering_Wheel_Anglesecinfo CtApImageProcess_FreeRunning.PpSysManager_MobileyeGenericSensor_10ms.DeMobileyeGenericSensor.Left_Blinksecinfo CtApImageProcess_FreeRunning.PpSysManager_MobileyeGenericSensor_10ms.DeMobileyeGenericSensor.Yaw_Ratesecinfo CtApImageProcess_FreeRunning.PpSysManager_MobileyeGenericSensor_10ms.DeMobileyeGenericSensor.Vehicle_Speedsecinfo CtApImageProcess_FreeRunning.PpSysManager_MobileyeGenericSensor_10ms.DeMobileyeGenericSensor.Wiperssecinfo CtApImageProcess_FreeRunning.PpSysManager_MobileyeGenericSensor_10ms.DeMobileyeGenericSensor.Right_Blinksecinfo CtApImageProcess_FreeRunning.PpSysManager_MobileyeGenericSensor_10ms.DeMobileyeGenericSensor.Reverse_Gearsecinfo CtApImageProcess_FreeRunning.PpSysManager_MobileyeGenericSensor_10ms.DeMobileyeGenericSensor.High_Beamsecinfo CtApImageProcess_FreeRunning.PpSysManager_MobileyeGenericSensor_10ms.DeMobileyeGenericSensor.Brakessecinfo CtApImageProcess_FreeRunning.PpSysManager_MobileyeGenericSensor_10ms.DeMobileyeGenericSensor.stHeader.Counter CtApImageProcess_FreeRunning.PpSysManager_MobileyeGenericSensor_10ms.DeMobileyeGenericSensor.stHeader.FrameID CtApImageProcess_FreeRunning.PpSysManager_MobileyeGenericSensor_10ms.DeMobileyeGenericSensor.stHeader.TimeStamp CtApImageProcess_FreeRunning.PpSysManager_VCUInfo_100ms.DeVMS_VCUStatus5.RdFrictionCoefficientHSC4 CtApImageProcess_FreeRunning.PpSysManager_VCUInfo_100ms.DeVMS_VCUStatus5.StrgWhlAngGrdLmtHSC4 CtApImageProcess_FreeRunning.PpSysManager_VCUInfo_100ms.DeVMS_VCUStatus5.StrgWhlAngLmtHSC4 CtApImageProcess_FreeRunning.PpSysManager_VCUInfo_100ms.DeVMS_VCUStatus5.VehAcceLmtHSC4 CtApImageProcess_FreeRunning.PpSysManager_VCUInfo_100ms.DeVMS_VCUStatus5.VehDeceLmtHSC4 CtApImageProcess_FreeRunning.PpSysManager_VCUInfo_100ms.DeVMS_VCUStatus5.stHeader.Counter CtApImageProcess_FreeRunning.PpSysManager_VCUInfo_100ms.DeVMS_VCUStatus5.stHeader.FrameID CtApImageProcess_FreeRunning.PpSysManager_VCUInfo_100ms.DeVMS_VCUStatus5.stHeader.TimeStamp CtApImageProcess_FreeRunning.PpSysManager_VCUInfo_100ms.DeVMS_VCUStatus5.AutodDrvngSysSts CtApImageProcess_FreeRunning.PpSysManager_VCUInfo_100ms.DeVMS_VCUStatus5.AIParkngSts CtApImageProcess_FreeRunning.PpSysManager_VCUInfo_100ms.DeVMS_VCUStatus5.White_Body_Color CtApImageProcess_FreeRunning.PpSysManager_VCUInfo_10ms.DeVMS_BKP.VMS_BKP CtApImageProcess_FreeRunning.PpSysManager_VCUInfo_10ms.DeVMS_VCUStatus10.RNonDrvnWhlRotlDistVHSC2 CtApImageProcess_FreeRunning.PpSysManager_VCUInfo_10ms.DeVMS_VCUStatus10.RNonDrvnWhlRotlDistPCHSC2 CtApImageProcess_FreeRunning.PpSysManager_VCUInfo_10ms.DeVMS_VCUStatus10.RDrvnWhlRotlDistVHSC2 CtApImageProcess_FreeRunning.PpSysManager_VCUInfo_10ms.DeVMS_VCUStatus10.RDrvnWhlRotlDistPlsCtrHSC2 CtApImageProcess_FreeRunning.PpSysManager_VCUInfo_10ms.DeVMS_VCUStatus10.LDrvnWhlRotlDistVHSC2 CtApImageProcess_FreeRunning.PpSysManager_VCUInfo_10ms.DeVMS_VCUStatus10.LNonDrvnWhlRotlDistPCHSC2 CtApImageProcess_FreeRunning.PpSysManager_VCUInfo_10ms.DeVMS_VCUStatus10.LNonDrvnWhlRotlDistVHSC2 CtApImageProcess_FreeRunning.PpSysManager_VCUInfo_10ms.DeVMS_VCUStatus10.LDrvnWhlRotlDistPlsCtrHSC2 CtApImageProcess_FreeRunning.PpSysManager_VCUInfo_10ms.DeVMS_VCUStatus10.stHeader.Counter CtApImageProcess_FreeRunning.PpSysManager_VCUInfo_10ms.DeVMS_VCUStatus10.stHeader.FrameID CtApImageProcess_FreeRunning.PpSysManager_VCUInfo_10ms.DeVMS_VCUStatus10.stHeader.TimeStamp CtApImageProcess_FreeRunning.PpSysManager_VCUInfo_10ms.DeVMS_VCUStatus10.fPtBrkPdlInptHSC4 CtApImageProcess_FreeRunning.PpSysManager_VCUInfo_10ms.DeVMS_VCUStatus2.StrgWhlAngHSC4 CtApImageProcess_FreeRunning.PpSysManager_VCUInfo_10ms.DeVMS_VCUStatus2.StrgWhlAngAlvRCHSC4 CtApImageProcess_FreeRunning.PpSysManager_VCUInfo_10ms.DeVMS_VCUStatus2.StrgWhlAngExtdPVHSC4 CtApImageProcess_FreeRunning.PpSysManager_VCUInfo_10ms.DeVMS_VCUStatus2.StrgWhlAngGrdHSC4 CtApImageProcess_FreeRunning.PpSysManager_VCUInfo_10ms.DeVMS_VCUStatus2.StrgWhlAngSnsrCalStsHSC4 CtApImageProcess_FreeRunning.PpSysManager_VCUInfo_10ms.DeVMS_VCUStatus2.StrgWhlAngSnsrChksmHSC4 CtApImageProcess_FreeRunning.PpSysManager_VCUInfo_10ms.DeVMS_VCUStatus2.StrgWhlAngSnsrFltHSC4 CtApImageProcess_FreeRunning.PpSysManager_VCUInfo_10ms.DeVMS_VCUStatus2.StrgWhlAngSnsrInidHSC4 CtApImageProcess_FreeRunning.PpSysManager_VCUInfo_10ms.DeVMS_VCUStatus2.StrgWhlAngSnsrMultCapbHSC4 CtApImageProcess_FreeRunning.PpSysManager_VCUInfo_10ms.DeVMS_VCUStatus2.StrgWhlAngVHSC4 CtApImageProcess_FreeRunning.PpSysManager_VCUInfo_10ms.DeVMS_VCUStatus2.stHeader.Counter CtApImageProcess_FreeRunning.PpSysManager_VCUInfo_10ms.DeVMS_VCUStatus2.stHeader.FrameID CtApImageProcess_FreeRunning.PpSysManager_VCUInfo_10ms.DeVMS_VCUStatus2.stHeader.TimeStamp CtApImageProcess_FreeRunning.PpSysManager_VCUInfo_10ms.DeVMS_VCUStatus2.SCUShifterLvrPos CtApImageProcess_FreeRunning.PpSysManager_VCUInfo_10ms.DeVMS_VCUStatus9.VCUMainID CtApImageProcess_FreeRunning.PpSysManager_VCUInfo_10ms.DeVMS_VCUStatus9.VCUAddonsID CtApImageProcess_FreeRunning.PpSysManager_VCUInfo_10ms.DeVMS_VCUStatus9.Vehicleplatform CtApImageProcess_FreeRunning.PpSysManager_VCUInfo_10ms.DeVMS_VCUStatus9.VCUstage CtApImageProcess_FreeRunning.PpSysManager_VCUInfo_10ms.DeVMS_VCUStatus9.Projectname CtApImageProcess_FreeRunning.PpSysManager_VCUInfo_10ms.DeVMS_VCUStatus9.Component CtApImageProcess_FreeRunning.PpSysManager_VCUInfo_10ms.DeVMS_VCUStatus9.VehOdoHSC2 CtApImageProcess_FreeRunning.PpSysManager_VCUInfo_10ms.DeVMS_VCUStatus9.stHeader.Counter CtApImageProcess_FreeRunning.PpSysManager_VCUInfo_10ms.DeVMS_VCUStatus9.stHeader.FrameID CtApImageProcess_FreeRunning.PpSysManager_VCUInfo_10ms.DeVMS_VCUStatus9.stHeader.TimeStamp CtApImageProcess_FreeRunning.PpSysManager_VCUInfo_10ms.DeVMS_VCUStatus9.EPTRdy CtApImageProcess_FreeRunning.PpSysManager_VCUInfo_10ms.DeVMS_VCUStatus9.SysPwrMd CtApImageProcess_FreeRunning.PpSysManager_VCUInfo_200ms.DeVCUStatus8.TimeDspFmtHSC4 CtApImageProcess_FreeRunning.PpSysManager_VCUInfo_200ms.DeVCUStatus8.SecsOfMinuteHSC4 CtApImageProcess_FreeRunning.PpSysManager_VCUInfo_200ms.DeVCUStatus8.MinuteOfHourHSC4 CtApImageProcess_FreeRunning.PpSysManager_VCUInfo_200ms.DeVCUStatus8.HourOfDayHSC4 CtApImageProcess_FreeRunning.PpSysManager_VCUInfo_200ms.DeVCUStatus8.CalendarYearHSC4 CtApImageProcess_FreeRunning.PpSysManager_VCUInfo_200ms.DeVCUStatus8.CalendarMonthHSC4 CtApImageProcess_FreeRunning.PpSysManager_VCUInfo_200ms.DeVCUStatus8.CalendarDayHSC4 CtApImageProcess_FreeRunning.PpSysManager_VCUInfo_200ms.DeVCUStatus8.stHeader.Counter CtApImageProcess_FreeRunning.PpSysManager_VCUInfo_200ms.DeVCUStatus8.stHeader.FrameID CtApImageProcess_FreeRunning.PpSysManager_VCUInfo_200ms.DeVCUStatus8.stHeader.TimeStamp CtApImageProcess_FreeRunning.PpSysManager_VCUInfo_200ms.DeVMS_VCUStatus7_200ms.ACInCarTemHSC4 CtApImageProcess_FreeRunning.PpSysManager_VCUInfo_200ms.DeVMS_VCUStatus7_200ms.FuelLvlPcntVHSC4 CtApImageProcess_FreeRunning.PpSysManager_VCUInfo_200ms.DeVMS_VCUStatus7_200ms.FuelLvlPcntHSC4 CtApImageProcess_FreeRunning.PpSysManager_VCUInfo_200ms.DeVMS_VCUStatus7_200ms.AmbtLghtLvlHSC4 CtApImageProcess_FreeRunning.PpSysManager_VCUInfo_200ms.DeVMS_VCUStatus7_200ms.OtsdAirTemCrValV_HSC4 CtApImageProcess_FreeRunning.PpSysManager_VCUInfo_200ms.DeVMS_VCUStatus7_200ms.OtsdAirTemCrVal_HSC4 CtApImageProcess_FreeRunning.PpSysManager_VCUInfo_200ms.DeVMS_VCUStatus7_200ms.BrkLghtsStaHSC4 CtApImageProcess_FreeRunning.PpSysManager_VCUInfo_200ms.DeVMS_VCUStatus7_200ms.DangerousWrnngLghtStaHSC4 CtApImageProcess_FreeRunning.PpSysManager_VCUInfo_200ms.DeVMS_VCUStatus7_200ms.DipdBeamLampsStaHSC4 CtApImageProcess_FreeRunning.PpSysManager_VCUInfo_200ms.DeVMS_VCUStatus7_200ms.FrtFogLampStaHSC4 CtApImageProcess_FreeRunning.PpSysManager_VCUInfo_200ms.DeVMS_VCUStatus7_200ms.HornStaHSC4 CtApImageProcess_FreeRunning.PpSysManager_VCUInfo_200ms.DeVMS_VCUStatus7_200ms.LDircnLampsStaHSC4 CtApImageProcess_FreeRunning.PpSysManager_VCUInfo_200ms.DeVMS_VCUStatus7_200ms.MainBeamLampsStaHSC4 CtApImageProcess_FreeRunning.PpSysManager_VCUInfo_200ms.DeVMS_VCUStatus7_200ms.RDircnLampsStaHSC4 CtApImageProcess_FreeRunning.PpSysManager_VCUInfo_200ms.DeVMS_VCUStatus7_200ms.RevsngLghtStaHSC4 CtApImageProcess_FreeRunning.PpSysManager_VCUInfo_200ms.DeVMS_VCUStatus7_200ms.RrFogLampStaHSC4 CtApImageProcess_FreeRunning.PpSysManager_VCUInfo_200ms.DeVMS_VCUStatus7_200ms.WidthLampAndTaillightStateHSC4 CtApImageProcess_FreeRunning.PpSysManager_VCUInfo_200ms.DeVMS_VCUStatus7_200ms.WiperStaHSC4 CtApImageProcess_FreeRunning.PpSysManager_VCUInfo_200ms.DeVMS_VCUStatus7_200ms.WshrStaHSC4 CtApImageProcess_FreeRunning.PpSysManager_VCUInfo_200ms.DeVMS_VCUStatus7_200ms.stHeader.Counter CtApImageProcess_FreeRunning.PpSysManager_VCUInfo_200ms.DeVMS_VCUStatus7_200ms.stHeader.FrameID CtApImageProcess_FreeRunning.PpSysManager_VCUInfo_200ms.DeVMS_VCUStatus7_200ms.stHeader.TimeStamp CtApImageProcess_FreeRunning.PpSysManager_VCUInfo_20ms.DeVMS_VCUStatus3.SysVol_HSC4 CtApImageProcess_FreeRunning.PpSysManager_VCUInfo_20ms.DeVMS_VCUStatus3.EPBAppcnStsHSC4 CtApImageProcess_FreeRunning.PpSysManager_VCUInfo_20ms.DeVMS_VCUStatus3.VehSpdAvgVHSC4 CtApImageProcess_FreeRunning.PpSysManager_VCUInfo_20ms.DeVMS_VCUStatus3.VehSpdAvgHSC4 CtApImageProcess_FreeRunning.PpSysManager_VCUInfo_20ms.DeVMS_VCUStatus3.VSELongtAccVHSC4 CtApImageProcess_FreeRunning.PpSysManager_VCUInfo_20ms.DeVMS_VCUStatus3.VSELongtAccHSC4 CtApImageProcess_FreeRunning.PpSysManager_VCUInfo_20ms.DeVMS_VCUStatus3.VehDynYawRateVHSC4 CtApImageProcess_FreeRunning.PpSysManager_VCUInfo_20ms.DeVMS_VCUStatus3.VehDynYawRateHSC4 CtApImageProcess_FreeRunning.PpSysManager_VCUInfo_20ms.DeVMS_VCUStatus3.AirbagDplHSC4 CtApImageProcess_FreeRunning.PpSysManager_VCUInfo_20ms.DeVMS_VCUStatus3.stHeader.Counter CtApImageProcess_FreeRunning.PpSysManager_VCUInfo_20ms.DeVMS_VCUStatus3.stHeader.FrameID CtApImageProcess_FreeRunning.PpSysManager_VCUInfo_20ms.DeVMS_VCUStatus3.stHeader.TimeStamp CtApImageProcess_FreeRunning.PpSysManager_VCUInfo_20ms.DeVMS_VCUStatus3.APATrgtEPSStrgWhlAng CtApImageProcess_FreeRunning.PpSysManager_VCUInfo_20ms.DeVMS_VCUStatus3.APATrgtEPSStrgWhlAngV CtApImageProcess_FreeRunning.PpSysManager_VCUInfo_20ms.DeVMS_VCUStatus3.LKAReqToq CtApImageProcess_FreeRunning.PpSysManager_VCUInfo_20ms.DeVMS_VCUStatus3.APASCSAcclReqVal CtApImageProcess_FreeRunning.PpSysManager_VCUInfo_20ms.DeVMS_VCUStatus3.ACCAccReqVal CtApImageProcess_FreeRunning.PpSysManager_VCUInfo_20ms.DeVMS_VCUStatus3.AEBDclReqVal_sech2SecHS2 CtApImageProcess_FreeRunning.PpSysManager_VCUInfo_20ms.DeVMS_VCUStatus3.VSELongtAcc CtApImageProcess_FreeRunning.PpSysManager_VCUInfo_20ms.DeVMS_VCUStatus3.DrvrStrgDlvrdToq CtApImageProcess_FreeRunning.PpSysManager_VCUInfo_20ms.DeVMS_VCUStatus3.ChLKARespToq CtApImageProcess_FreeRunning.PpSysManager_VCUInfo_20ms.DeVMS_VCUStatus3.bkp CtApImageProcess_FreeRunning.PpSysManager_VCUInfo_20ms.DeVMS_VCUStatus3.ACCSysSts CtApImageProcess_FreeRunning.PpSysManager_VCUInfo_20ms.DeVMS_VCUStatus3.TJAICASysSts CtApImageProcess_FreeRunning.PpSysManager_VCUInfo_50ms.DeVMS_VCUStatus4.VehLckngStaHSC4 CtApImageProcess_FreeRunning.PpSysManager_VCUInfo_50ms.DeVMS_VCUStatus4.FrtPsngDoorOpenStsHSC4 CtApImageProcess_FreeRunning.PpSysManager_VCUInfo_50ms.DeVMS_VCUStatus4.DrvrDoorOpenStsHSC4 CtApImageProcess_FreeRunning.PpSysManager_VCUInfo_50ms.DeVMS_VCUStatus4.VehInertiaSwTrigdHSC4 CtApImageProcess_FreeRunning.PpSysManager_VCUInfo_50ms.DeVMS_VCUStatus4.BrkPdlDrvrAppdPrsV_HSC4 CtApImageProcess_FreeRunning.PpSysManager_VCUInfo_50ms.DeVMS_VCUStatus4.BrkPdlDrvrAppdPrsAlvRC_HSC4 CtApImageProcess_FreeRunning.PpSysManager_VCUInfo_50ms.DeVMS_VCUStatus4.BrkPdlDrvrAppdPrs_HSC4 CtApImageProcess_FreeRunning.PpSysManager_VCUInfo_50ms.DeVMS_VCUStatus4.RLDoorOpenStsHS2 CtApImageProcess_FreeRunning.PpSysManager_VCUInfo_50ms.DeVMS_VCUStatus4.RRDoorOpenStsHS2 CtApImageProcess_FreeRunning.PpSysManager_VCUInfo_50ms.DeVMS_VCUStatus4.stHeader.Counter CtApImageProcess_FreeRunning.PpSysManager_VCUInfo_50ms.DeVMS_VCUStatus4.stHeader.FrameID CtApImageProcess_FreeRunning.PpSysManager_VCUInfo_50ms.DeVMS_VCUStatus4.stHeader.TimeStamp CtApImageProcess_FreeRunning.PpSysManager_VCUInfo_50ms.DeVMS_VCUStatus4.BntOpenSts CtApImageProcess_FreeRunning.PpSysManager_VCUInfo_50ms.DeVMS_VCUStatus4.LdSpcOpenSts CtApImageProcess_FreeRunning.PpSysManager_VCUInfo_50ms.DeVMS_VCUStatus4.LongdAccSnsrVal CtApImageProcess_FreeRunning.PpSysManager_VCUInfo_50ms.DeVMS_VCUStatus4.bkp CtApImageProcess_FreeRunning.PpSysManager_VCUStatus1_10ms.DeVMS_VCUStatus1.DrivemModeStssecinfo CtApImageProcess_FreeRunning.PpSysManager_VCUStatus1_10ms.DeVMS_VCUStatus1.DriveModeReqsecinfo CtApImageProcess_FreeRunning.PpSysManager_VCUStatus1_10ms.DeVMS_VCUStatus1.EnSpdsecinfo CtApImageProcess_FreeRunning.PpSysManager_VCUStatus1_10ms.DeVMS_VCUStatus1.keep1secinfo CtApImageProcess_FreeRunning.PpSysManager_VCUStatus1_10ms.DeVMS_VCUStatus1.EPSMotOtptToqsecinfo CtApImageProcess_FreeRunning.PpSysManager_VCUStatus1_10ms.DeVMS_VCUStatus1.SCUShiferLvrPossecinfo CtApImageProcess_FreeRunning.PpSysManager_VCUStatus1_10ms.DeVMS_VCUStatus1.PtBrkPdlDscrtInptStsVsecinfo CtApImageProcess_FreeRunning.PpSysManager_VCUStatus1_10ms.DeVMS_VCUStatus1.PtBrkPdlDscrtInptStssecinfo CtApImageProcess_FreeRunning.PpSysManager_VCUStatus6_50ms.DeVMS_VCUStatus6.WhlGndVelLDrvnVsecinfo CtApImageProcess_FreeRunning.PpSysManager_VCUStatus6_50ms.DeVMS_VCUStatus6.WhlGndVelLDrvnsecinfo CtApImageProcess_FreeRunning.PpSysManager_VCUStatus6_50ms.DeVMS_VCUStatus6.WhlGndVelRDrvnVsecinfo CtApImageProcess_FreeRunning.PpSysManager_VCUStatus6_50ms.DeVMS_VCUStatus6.WhlGndVelRDrvnsecinfo CtApImageProcess_FreeRunning.PpSysManager_VCUStatus6_50ms.DeVMS_VCUStatus6.WhlGndVelLNonDrvnVsecinfo CtApImageProcess_FreeRunning.PpSysManager_VCUStatus6_50ms.DeVMS_VCUStatus6.WhlGndVelLNonDrvnsecinfo CtApImageProcess_FreeRunning.PpSysManager_VCUStatus6_50ms.DeVMS_VCUStatus6.WhlGndVelRNonDrvnVsecinfo CtApImageProcess_FreeRunning.PpSysManager_VCUStatus6_50ms.DeVMS_VCUStatus6.WhlGndVelRNonDrvnsecinfo CtApImageProcess_FreeRunning.PpSysManager_VCUStatus6_50ms.DeVMS_VCUStatus6.DeTimestamp.DeTimestampEGT.DeTimestampHigh CtApImageProcess_FreeRunning.PpSysManager_VCUStatus6_50ms.DeVMS_VCUStatus6.DeTimestamp.DeTimestampEGT.DeTimestampLow CtApImageProcess_FreeRunning.PpSysManager_VCUStatus6_50ms.DeVMS_VCUStatus6.DeTimestamp.DeTimestampMW_RX.DeTimestampHigh CtApImageProcess_FreeRunning.PpSysManager_VCUStatus6_50ms.DeVMS_VCUStatus6.DeTimestamp.DeTimestampMW_RX.DeTimestampLow CtApImageProcess_FreeRunning.PpSysManager_VCUStatus6_50ms.DeVMS_VCUStatus6.DeTimestamp.DeTimestampMW_TX.DeTimestampHigh CtApImageProcess_FreeRunning.PpSysManager_VCUStatus6_50ms.DeVMS_VCUStatus6.DeTimestamp.DeTimestampMW_TX.DeTimestampLow CtApImageProcess_FreeRunning.PpUltrasonicHandler_HSC1_PDC_50ms.DeIECU_HSC1_PDC_FrP00.FrtObsDist_h1HSC1 CtApImageProcess_FreeRunning.PpUltrasonicHandler_HSC1_PDC_50ms.DeIECU_HSC1_PDC_FrP00.RrObsDist_h1HSC1 CtApImageProcess_FreeRunning.PpUltrasonicHandler_PDC_CHCAN_50ms.DePDC_HSC2_FrP00.PDCSysStsHSC2 CtApImageProcess_FreeRunning.PpUltrasonicHandler_PDC_CHCAN_50ms.DePDC_HSC2_FrP00.RrPDCAudWrnngHSC2 CtApImageProcess_FreeRunning.PpUltrasonicHandler_PDC_CHCAN_50ms.DePDC_HSC2_FrP00.FrtPDCAudWrnngHSC2 CtApImageProcess_FreeRunning.PpUltrasonicHandler_PDC_CHCAN_50ms.DePDC_HSC2_FrP00.RrMidRObsRngHSC2 CtApImageProcess_FreeRunning.PpUltrasonicHandler_PDC_CHCAN_50ms.DePDC_HSC2_FrP00.RrMidLObsRngHSC2 CtApImageProcess_FreeRunning.PpUltrasonicHandler_PDC_CHCAN_50ms.DePDC_HSC2_FrP00.FrtMidRObsRngHSC2 CtApImageProcess_FreeRunning.PpUltrasonicHandler_PDC_CHCAN_50ms.DePDC_HSC2_FrP00.FrtMidLObsRngHSC2 CtApImageProcess_FreeRunning.PpUltrasonicHandler_PDC_CHCAN_50ms.DePDC_HSC2_FrP00.RRObsRngHSC2 CtApImageProcess_FreeRunning.PpUltrasonicHandler_PDC_CHCAN_50ms.DePDC_HSC2_FrP00.RLObsRngHSC2 CtApImageProcess_FreeRunning.PpUltrasonicHandler_PDC_CHCAN_50ms.DePDC_HSC2_FrP00.FRObsRngHSC2 CtApImageProcess_FreeRunning.PpUltrasonicHandler_PDC_CHCAN_50ms.DePDC_HSC2_FrP00.FLObsRngHSC2 CtApImageProcess_FreeRunning.PpUltrasonicHandler_PDC_CHCAN_50ms.DePDC_HSC2_FrP00.PDCCofignStsHSC2 CtApImageProcess_FreeRunning.PpUltrasonicHandler_PDC_CHCAN_50ms.DePDC_HSC2_FrP00.FrtObsDist_h2HSC2 CtApImageProcess_FreeRunning.PpUltrasonicHandler_PDC_CHCAN_50ms.DePDC_HSC2_FrP00.RrObsDist_h2HSC2 CtApImageProcess_FreeRunning.PpUltrasonicHandler_PDC_CHCAN_50ms.DePDC_HSC2_FrP01.RRSideObsDistHSC2 CtApImageProcess_FreeRunning.PpUltrasonicHandler_PDC_CHCAN_50ms.DePDC_HSC2_FrP01.RLSideObsDistHSC2 CtApImageProcess_FreeRunning.PpUltrasonicHandler_PDC_CHCAN_50ms.DePDC_HSC2_FrP01.FRSideObsDistHSC2 CtApImageProcess_FreeRunning.PpUltrasonicHandler_PDC_CHCAN_50ms.DePDC_HSC2_FrP01.FLSideObsDistHSC2 CtApImageProcess_FreeRunning.PpUltrasonicProcess_Dists_20ms.DeUltrasonicProcess_BKP.UltrasonicProcess_BKP CtApImageProcess_FreeRunning.PpUltrasonicProcess_Dists_20ms.DeUltrasonicProcess_Dists.stHeader.Counter CtApImageProcess_FreeRunning.PpUltrasonicProcess_Dists_20ms.DeUltrasonicProcess_Dists.stHeader.FrameID CtApImageProcess_FreeRunning.PpUltrasonicProcess_Dists_20ms.DeUltrasonicProcess_Dists.stHeader.TimeStamp CtApImageProcess_FreeRunning.PpUltrasonicProcess_Dists_20ms.DeUltrasonicProcess_Dists.gstProbes[0].ExParam CtApImageProcess_FreeRunning.PpUltrasonicProcess_Dists_20ms.DeUltrasonicProcess_Dists.gstProbes[0].bOutRange CtApImageProcess_FreeRunning.PpUltrasonicProcess_Dists_20ms.DeUltrasonicProcess_Dists.gstProbes[0].fDist CtApImageProcess_FreeRunning.PpUltrasonicProcess_Dists_20ms.DeUltrasonicProcess_Dists.gstProbes[1].ExParam CtApImageProcess_FreeRunning.PpUltrasonicProcess_Dists_20ms.DeUltrasonicProcess_Dists.gstProbes[1].bOutRange CtApImageProcess_FreeRunning.PpUltrasonicProcess_Dists_20ms.DeUltrasonicProcess_Dists.gstProbes[1].fDist CtApImageProcess_FreeRunning.PpUltrasonicProcess_Dists_20ms.DeUltrasonicProcess_Dists.gstProbes[2].ExParam CtApImageProcess_FreeRunning.PpUltrasonicProcess_Dists_20ms.DeUltrasonicProcess_Dists.gstProbes[2].bOutRange CtApImageProcess_FreeRunning.PpUltrasonicProcess_Dists_20ms.DeUltrasonicProcess_Dists.gstProbes[2].fDist CtApImageProcess_FreeRunning.PpUltrasonicProcess_Dists_20ms.DeUltrasonicProcess_Dists.gstProbes[3].ExParam CtApImageProcess_FreeRunning.PpUltrasonicProcess_Dists_20ms.DeUltrasonicProcess_Dists.gstProbes[3].bOutRange CtApImageProcess_FreeRunning.PpUltrasonicProcess_Dists_20ms.DeUltrasonicProcess_Dists.gstProbes[3].fDist CtApImageProcess_FreeRunning.PpUltrasonicProcess_Dists_20ms.DeUltrasonicProcess_Dists.gstProbes[4].ExParam CtApImageProcess_FreeRunning.PpUltrasonicProcess_Dists_20ms.DeUltrasonicProcess_Dists.gstProbes[4].bOutRange CtApImageProcess_FreeRunning.PpUltrasonicProcess_Dists_20ms.DeUltrasonicProcess_Dists.gstProbes[4].fDist CtApImageProcess_FreeRunning.PpUltrasonicProcess_Dists_20ms.DeUltrasonicProcess_Dists.gstProbes[5].ExParam CtApImageProcess_FreeRunning.PpUltrasonicProcess_Dists_20ms.DeUltrasonicProcess_Dists.gstProbes[5].bOutRange CtApImageProcess_FreeRunning.PpUltrasonicProcess_Dists_20ms.DeUltrasonicProcess_Dists.gstProbes[5].fDist CtApImageProcess_FreeRunning.PpUltrasonicProcess_Dists_20ms.DeUltrasonicProcess_Dists.gstProbes[6].ExParam CtApImageProcess_FreeRunning.PpUltrasonicProcess_Dists_20ms.DeUltrasonicProcess_Dists.gstProbes[6].bOutRange CtApImageProcess_FreeRunning.PpUltrasonicProcess_Dists_20ms.DeUltrasonicProcess_Dists.gstProbes[6].fDist CtApImageProcess_FreeRunning.PpUltrasonicProcess_Dists_20ms.DeUltrasonicProcess_Dists.gstProbes[7].ExParam CtApImageProcess_FreeRunning.PpUltrasonicProcess_Dists_20ms.DeUltrasonicProcess_Dists.gstProbes[7].bOutRange CtApImageProcess_FreeRunning.PpUltrasonicProcess_Dists_20ms.DeUltrasonicProcess_Dists.gstProbes[7].fDist CtApImageProcess_FreeRunning.PpUltrasonicProcess_Dists_20ms.DeUltrasonicProcess_Dists.gstProbes[8].ExParam CtApImageProcess_FreeRunning.PpUltrasonicProcess_Dists_20ms.DeUltrasonicProcess_Dists.gstProbes[8].bOutRange CtApImageProcess_FreeRunning.PpUltrasonicProcess_Dists_20ms.DeUltrasonicProcess_Dists.gstProbes[8].fDist CtApImageProcess_FreeRunning.PpUltrasonicProcess_Dists_20ms.DeUltrasonicProcess_Dists.gstProbes[9].ExParam CtApImageProcess_FreeRunning.PpUltrasonicProcess_Dists_20ms.DeUltrasonicProcess_Dists.gstProbes[9].bOutRange CtApImageProcess_FreeRunning.PpUltrasonicProcess_Dists_20ms.DeUltrasonicProcess_Dists.gstProbes[9].fDist CtApImageProcess_FreeRunning.PpUltrasonicProcess_Dists_20ms.DeUltrasonicProcess_Dists.gstProbes[10].ExParam CtApImageProcess_FreeRunning.PpUltrasonicProcess_Dists_20ms.DeUltrasonicProcess_Dists.gstProbes[10].bOutRange CtApImageProcess_FreeRunning.PpUltrasonicProcess_Dists_20ms.DeUltrasonicProcess_Dists.gstProbes[10].fDist CtApImageProcess_FreeRunning.PpUltrasonicProcess_Dists_20ms.DeUltrasonicProcess_Dists.gstProbes[11].ExParam CtApImageProcess_FreeRunning.PpUltrasonicProcess_Dists_20ms.DeUltrasonicProcess_Dists.gstProbes[11].bOutRange CtApImageProcess_FreeRunning.PpUltrasonicProcess_Dists_20ms.DeUltrasonicProcess_Dists.gstProbes[11].fDist CtApImageProcess_FreeRunning.PpVehicleIdentificationNumber.DeVehicleIdentificationNumber /end REF_CHARACTERISTIC
/end GROUP
/begin RECORD_LAYOUT __UBYTE_Z FNC_VALUES 1 UBYTE ROW_DIR DIRECT /end RECORD_LAYOUT
/begin RECORD_LAYOUT __UWORD_Z FNC_VALUES 1 UWORD ROW_DIR DIRECT /end RECORD_LAYOUT
/begin RECORD_LAYOUT __ULONG_Z FNC_VALUES 1 ULONG ROW_DIR DIRECT /end RECORD_LAYOUT
/begin RECORD_LAYOUT __SBYTE_Z FNC_VALUES 1 SBYTE ROW_DIR DIRECT /end RECORD_LAYOUT
/begin RECORD_LAYOUT __SWORD_Z FNC_VALUES 1 SWORD ROW_DIR DIRECT /end RECORD_LAYOUT
/begin RECORD_LAYOUT __SLONG_Z FNC_VALUES 1 SLONG ROW_DIR DIRECT /end RECORD_LAYOUT
/begin RECORD_LAYOUT __FLOAT32_IEEE_Z FNC_VALUES 1 FLOAT32_IEEE ROW_DIR DIRECT /end RECORD_LAYOUT
/begin RECORD_LAYOUT __FLOAT64_IEEE_Z FNC_VALUES 1 FLOAT64_IEEE ROW_DIR DIRECT /end RECORD_LAYOUT
/begin RECORD_LAYOUT __UBYTE_S FNC_VALUES 1 UBYTE COLUMN_DIR DIRECT /end RECORD_LAYOUT
/begin RECORD_LAYOUT __UWORD_S FNC_VALUES 1 UWORD COLUMN_DIR DIRECT /end RECORD_LAYOUT
/begin RECORD_LAYOUT __ULONG_S FNC_VALUES 1 ULONG COLUMN_DIR DIRECT /end RECORD_LAYOUT
/begin RECORD_LAYOUT __SBYTE_S FNC_VALUES 1 SBYTE COLUMN_DIR DIRECT /end RECORD_LAYOUT
/begin RECORD_LAYOUT __SWORD_S FNC_VALUES 1 SWORD COLUMN_DIR DIRECT /end RECORD_LAYOUT
/begin RECORD_LAYOUT __SLONG_S FNC_VALUES 1 SLONG COLUMN_DIR DIRECT /end RECORD_LAYOUT
/begin RECORD_LAYOUT __FLOAT32_IEEE_S FNC_VALUES 1 FLOAT32_IEEE COLUMN_DIR DIRECT /end RECORD_LAYOUT
/begin RECORD_LAYOUT __FLOAT64_IEEE_S FNC_VALUES 1 FLOAT64_IEEE COLUMN_DIR DIRECT /end RECORD_LAYOUT
/begin RECORD_LAYOUT SSV__UBYTE_S AXIS_PTS_X 1 UBYTE INDEX_INCR DIRECT /end RECORD_LAYOUT
/begin RECORD_LAYOUT SSV__UWORD_S AXIS_PTS_X 1 UWORD INDEX_INCR DIRECT /end RECORD_LAYOUT
/begin RECORD_LAYOUT SSV__ULONG_S AXIS_PTS_X 1 ULONG INDEX_INCR DIRECT /end RECORD_LAYOUT
/begin RECORD_LAYOUT SSV__SBYTE_S AXIS_PTS_X 1 SBYTE INDEX_INCR DIRECT /end RECORD_LAYOUT
/begin RECORD_LAYOUT SSV__SWORD_S AXIS_PTS_X 1 SWORD INDEX_INCR DIRECT /end RECORD_LAYOUT
/begin RECORD_LAYOUT SSV__SLONG_S AXIS_PTS_X 1 SLONG INDEX_INCR DIRECT /end RECORD_LAYOUT
/begin RECORD_LAYOUT SSV__FLOAT32_IEEE_S AXIS_PTS_X 1 FLOAT32_IEEE INDEX_INCR DIRECT /end RECORD_LAYOUT
/begin RECORD_LAYOUT SSV__FLOAT64_IEEE_S AXIS_PTS_X 1 FLOAT64_IEEE INDEX_INCR DIRECT /end RECORD_LAYOUT
/begin RECORD_LAYOUT __A_UINT64_Z FNC_VALUES 1 A_UINT64 ROW_DIR DIRECT /end RECORD_LAYOUT
/begin RECORD_LAYOUT __A_INT64_Z FNC_VALUES 1 A_INT64 ROW_DIR DIRECT /end RECORD_LAYOUT
/begin RECORD_LAYOUT __A_UINT64_S FNC_VALUES 1 A_UINT64 COLUMN_DIR DIRECT /end RECORD_LAYOUT
/begin RECORD_LAYOUT __A_INT64_S FNC_VALUES 1 A_INT64 COLUMN_DIR DIRECT /end RECORD_LAYOUT
/begin RECORD_LAYOUT SSV__A_UINT64_S AXIS_PTS_X 1 A_UINT64 INDEX_INCR DIRECT /end RECORD_LAYOUT
/begin RECORD_LAYOUT SSV__A_INT64_S AXIS_PTS_X 1 A_INT64 INDEX_INCR DIRECT /end RECORD_LAYOUT
/end MODULE
/end PROJECT
