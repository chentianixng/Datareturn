ASAP2_VERSION 1 61
/begin PROJECT MotionWise_PerformanceHost00_XCPonEthernet ""
/begin MODULE CPP ""
/begin MOD_COMMON "" BYTE_ORDER MSB_LAST ALIGNMENT_BYTE 1 ALIGNMENT_WORD 2 ALIGNMENT_LONG 4 ALIGNMENT_INT64 1 ALIGNMENT_FLOAT32_IEEE 4 ALIGNMENT_FLOAT64_IEEE 8 /end MOD_COMMON
/begin CHARACTERISTIC CtApImageProcess_FreeRunning.PpDR_Merges_10ms.DeDR_List.DR_List[19].stHeader.TimeStamp "2 uint32 array" VAL_BLK 0x25506c4 __ULONG_S 0 NO_COMPU_METHOD 0 4294967295 ECU_ADDRESS_EXTENSION 0x80 MATRIX_DIM 2 1 1 /end CHARACTERISTIC
/begin CHARACTERISTIC CtApImageProcess_FreeRunning.PpDR_Merges_10ms.DeDR_List.DR_List[19].count "" VALUE 0x25506cc __UBYTE_S 0 NO_COMPU_METHOD 0 255 ECU_ADDRESS_EXTENSION 0x80 /end CHARACTERISTIC
/begin CHARACTERISTIC CtApImageProcess_FreeRunning.PpDR_Merges_10ms.DeDR_List.DR_List[19].time_sec "" VALUE 0x25506d0 __FLOAT64_IEEE_S 0 NO_COMPU_METHOD 0 3.402823e+38 ECU_ADDRESS_EXTENSION 0x80 /end CHARACTERISTIC
/begin CHARACTERISTIC CtApImageProcess_FreeRunning.PpDR_Merges_10ms.DeDR_List.DR_List[19].utm_x "" VALUE 0x25506d8 __FLOAT64_IEEE_S 0 NO_COMPU_METHOD 0 3.402823e+38 ECU_ADDRESS_EXTENSION 0x80 /end CHARACTERISTIC
/begin CHARACTERISTIC CtApImageProcess_FreeRunning.PpDR_Merges_10ms.DeDR_List.DR_List[19].utm_y "" VALUE 0x25506e0 __FLOAT64_IEEE_S 0 NO_COMPU_METHOD 0 3.402823e+38 ECU_ADDRESS_EXTENSION 0x80 /end CHARACTERISTIC
/begin CHARACTERISTIC CtApImageProcess_FreeRunning.PpDR_Merges_10ms.DeDR_List.DR_List[19].utm_z "" VALUE 0x25506e8 __FLOAT32_IEEE_S 0 NO_COMPU_METHOD 0 3.402823e+38 ECU_ADDRESS_EXTENSION 0x80 /end CHARACTERISTIC
/begin CHARACTERISTIC CtApImageProcess_FreeRunning.PpDR_Merges_10ms.DeDR_List.DR_List[19].heading "" VALUE 0x25506ec __FLOAT32_IEEE_S 0 NO_COMPU_METHOD 0 3.402823e+38 ECU_ADDRESS_EXTENSION 0x80 /end CHARACTERISTIC
/begin CHARACTERISTIC CtApImageProcess_FreeRunning.PpDR_Merges_10ms.DeDR_List.DR_List[19].delta_x "" VALUE 0x25506f0 __FLOAT32_IEEE_S 0 NO_COMPU_METHOD 0 3.402823e+38 ECU_ADDRESS_EXTENSION 0x80 /end CHARACTERISTIC
/begin CHARACTERISTIC CtApImageProcess_FreeRunning.PpDR_Merges_10ms.DeDR_List.DR_List[19].delta_y "" VALUE 0x25506f4 __FLOAT32_IEEE_S 0 NO_COMPU_METHOD 0 3.402823e+38 ECU_ADDRESS_EXTENSION 0x80 /end CHARACTERISTIC
/begin CHARACTERISTIC CtApImageProcess_FreeRunning.PpDR_Merges_10ms.DeDR_List.DR_List[19].delta_z "" VALUE 0x25506f8 __FLOAT32_IEEE_S 0 NO_COMPU_METHOD 0 3.402823e+38 ECU_ADDRESS_EXTENSION 0x80 /end CHARACTERISTIC
/begin CHARACTERISTIC CtApImageProcess_FreeRunning.PpDR_Merges_10ms.DeDR_List.DR_List[19].delta_yaw "" VALUE 0x25506fc __FLOAT32_IEEE_S 0 NO_COMPU_METHOD 0 3.402823e+38 ECU_ADDRESS_EXTENSION 0x80 /end CHARACTERISTIC
/begin CHARACTERISTIC CtApImageProcess_FreeRunning.PpDR_Merges_10ms.DeDR_List.DR_List[19].belif "" VALUE 0x2550700 __FLOAT32_IEEE_S 0 NO_COMPU_METHOD 0 3.402823e+38 ECU_ADDRESS_EXTENSION 0x80 /end CHARACTERISTIC
/begin CHARACTERISTIC CtApImageProcess_FreeRunning.PpDR_Merges_10ms.DeDR_List.DR_List[19].reserved_int "5 uint32 array" VAL_BLK 0x2550704 __ULONG_S 0 NO_COMPU_METHOD 0 4294967295 ECU_ADDRESS_EXTENSION 0x80 MATRIX_DIM 5 1 1 /end CHARACTERISTIC
/begin CHARACTERISTIC CtApImageProcess_FreeRunning.PpDR_Merges_10ms.DeDR_List.DR_List[20].stHeader.Counter "" VALUE 0x2550718 __UWORD_S 0 NO_COMPU_METHOD 0 65535 ECU_ADDRESS_EXTENSION 0x80 /end CHARACTERISTIC
/begin CHARACTERISTIC CtApImageProcess_FreeRunning.PpDR_Merges_10ms.DeDR_List.DR_List[20].stHeader.FrameID "" VALUE 0x255071a __UBYTE_S 0 NO_COMPU_METHOD 0 255 ECU_ADDRESS_EXTENSION 0x80 /end CHARACTERISTIC
/begin CHARACTERISTIC CtApImageProcess_FreeRunning.PpDR_Merges_10ms.DeDR_List.DR_List[20].stHeader.TimeStamp "2 uint32 array" VAL_BLK 0x255071c __ULONG_S 0 NO_COMPU_METHOD 0 4294967295 ECU_ADDRESS_EXTENSION 0x80 MATRIX_DIM 2 1 1 /end CHARACTERISTIC
/begin CHARACTERISTIC CtApImageProcess_FreeRunning.PpDR_Merges_10ms.DeDR_List.DR_List[20].count "" VALUE 0x2550724 __UBYTE_S 0 NO_COMPU_METHOD 0 255 ECU_ADDRESS_EXTENSION 0x80 /end CHARACTERISTIC
/begin CHARACTERISTIC CtApImageProcess_FreeRunning.PpDR_Merges_10ms.DeDR_List.DR_List[20].time_sec "" VALUE 0x2550728 __FLOAT64_IEEE_S 0 NO_COMPU_METHOD 0 3.402823e+38 ECU_ADDRESS_EXTENSION 0x80 /end CHARACTERISTIC
/begin CHARACTERISTIC CtApImageProcess_FreeRunning.PpDR_Merges_10ms.DeDR_List.DR_List[20].utm_x "" VALUE 0x2550730 __FLOAT64_IEEE_S 0 NO_COMPU_METHOD 0 3.402823e+38 ECU_ADDRESS_EXTENSION 0x80 /end CHARACTERISTIC
/begin CHARACTERISTIC CtApImageProcess_FreeRunning.PpDR_Merges_10ms.DeDR_List.DR_List[20].utm_y "" VALUE 0x2550738 __FLOAT64_IEEE_S 0 NO_COMPU_METHOD 0 3.402823e+38 ECU_ADDRESS_EXTENSION 0x80 /end CHARACTERISTIC
/begin CHARACTERISTIC CtApImageProcess_FreeRunning.PpDR_Merges_10ms.DeDR_List.DR_List[20].utm_z "" VALUE 0x2550740 __FLOAT32_IEEE_S 0 NO_COMPU_METHOD 0 3.402823e+38 ECU_ADDRESS_EXTENSION 0x80 /end CHARACTERISTIC
/begin CHARACTERISTIC CtApImageProcess_FreeRunning.PpDR_Merges_10ms.DeDR_List.DR_List[20].heading "" VALUE 0x2550744 __FLOAT32_IEEE_S 0 NO_COMPU_METHOD 0 3.402823e+38 ECU_ADDRESS_EXTENSION 0x80 /end CHARACTERISTIC
/begin CHARACTERISTIC CtApImageProcess_FreeRunning.PpDR_Merges_10ms.DeDR_List.DR_List[20].delta_x "" VALUE 0x2550748 __FLOAT32_IEEE_S 0 NO_COMPU_METHOD 0 3.402823e+38 ECU_ADDRESS_EXTENSION 0x80 /end CHARACTERISTIC
/begin CHARACTERISTIC CtApImageProcess_FreeRunning.PpDR_Merges_10ms.DeDR_List.DR_List[20].delta_y "" VALUE 0x255074c __FLOAT32_IEEE_S 0 NO_COMPU_METHOD 0 3.402823e+38 ECU_ADDRESS_EXTENSION 0x80 /end CHARACTERISTIC
/begin CHARACTERISTIC CtApImageProcess_FreeRunning.PpDR_Merges_10ms.DeDR_List.DR_List[20].delta_z "" VALUE 0x2550750 __FLOAT32_IEEE_S 0 NO_COMPU_METHOD 0 3.402823e+38 ECU_ADDRESS_EXTENSION 0x80 /end CHARACTERISTIC
/begin CHARACTERISTIC CtApImageProcess_FreeRunning.PpDR_Merges_10ms.DeDR_List.DR_List[20].delta_yaw "" VALUE 0x2550754 __FLOAT32_IEEE_S 0 NO_COMPU_METHOD 0 3.402823e+38 ECU_ADDRESS_EXTENSION 0x80 /end CHARACTERISTIC
/begin CHARACTERISTIC CtApImageProcess_FreeRunning.PpDR_Merges_10ms.DeDR_List.DR_List[20].belif "" VALUE 0x2550758 __FLOAT32_IEEE_S 0 NO_COMPU_METHOD 0 3.402823e+38 ECU_ADDRESS_EXTENSION 0x80 /end CHARACTERISTIC
/begin CHARACTERISTIC CtApImageProcess_FreeRunning.PpDR_Merges_10ms.DeDR_List.DR_List[20].reserved_int "5 uint32 array" VAL_BLK 0x255075c __ULONG_S 0 NO_COMPU_METHOD 0 4294967295 ECU_ADDRESS_EXTENSION 0x80 MATRIX_DIM 5 1 1 /end CHARACTERISTIC
/begin CHARACTERISTIC CtApImageProcess_FreeRunning.PpDR_Merges_10ms.DeDR_List.DR_List[21].stHeader.Counter "" VALUE 0x2550770 __UWORD_S 0 NO_COMPU_METHOD 0 65535 ECU_ADDRESS_EXTENSION 0x80 /end CHARACTERISTIC
/begin CHARACTERISTIC CtApImageProcess_FreeRunning.PpDR_Merges_10ms.DeDR_List.DR_List[21].stHeader.FrameID "" VALUE 0x2550772 __UBYTE_S 0 NO_COMPU_METHOD 0 255 ECU_ADDRESS_EXTENSION 0x80 /end CHARACTERISTIC
/begin CHARACTERISTIC CtApImageProcess_FreeRunning.PpDR_Merges_10ms.DeDR_List.DR_List[21].stHeader.TimeStamp "2 uint32 array" VAL_BLK 0x2550774 __ULONG_S 0 NO_COMPU_METHOD 0 4294967295 ECU_ADDRESS_EXTENSION 0x80 MATRIX_DIM 2 1 1 /end CHARACTERISTIC
/begin CHARACTERISTIC CtApImageProcess_FreeRunning.PpDR_Merges_10ms.DeDR_List.DR_List[21].count "" VALUE 0x255077c __UBYTE_S 0 NO_COMPU_METHOD 0 255 ECU_ADDRESS_EXTENSION 0x80 /end CHARACTERISTIC
/begin CHARACTERISTIC CtApImageProcess_FreeRunning.PpDR_Merges_10ms.DeDR_List.DR_List[21].time_sec "" VALUE 0x2550780 __FLOAT64_IEEE_S 0 NO_COMPU_METHOD 0 3.402823e+38 ECU_ADDRESS_EXTENSION 0x80 /end CHARACTERISTIC
/begin CHARACTERISTIC CtApImageProcess_FreeRunning.PpDR_Merges_10ms.DeDR_List.DR_List[21].utm_x "" VALUE 0x2550788 __FLOAT64_IEEE_S 0 NO_COMPU_METHOD 0 3.402823e+38 ECU_ADDRESS_EXTENSION 0x80 /end CHARACTERISTIC
/begin CHARACTERISTIC CtApImageProcess_FreeRunning.PpDR_Merges_10ms.DeDR_List.DR_List[21].utm_y "" VALUE 0x2550790 __FLOAT64_IEEE_S 0 NO_COMPU_METHOD 0 3.402823e+38 ECU_ADDRESS_EXTENSION 0x80 /end CHARACTERISTIC
/begin CHARACTERISTIC CtApImageProcess_FreeRunning.PpDR_Merges_10ms.DeDR_List.DR_List[21].utm_z "" VALUE 0x2550798 __FLOAT32_IEEE_S 0 NO_COMPU_METHOD 0 3.402823e+38 ECU_ADDRESS_EXTENSION 0x80 /end CHARACTERISTIC
/begin CHARACTERISTIC CtApImageProcess_FreeRunning.PpDR_Merges_10ms.DeDR_List.DR_List[21].heading "" VALUE 0x255079c __FLOAT32_IEEE_S 0 NO_COMPU_METHOD 0 3.402823e+38 ECU_ADDRESS_EXTENSION 0x80 /end CHARACTERISTIC
/begin CHARACTERISTIC CtApImageProcess_FreeRunning.PpDR_Merges_10ms.DeDR_List.DR_List[21].delta_x "" VALUE 0x25507a0 __FLOAT32_IEEE_S 0 NO_COMPU_METHOD 0 3.402823e+38 ECU_ADDRESS_EXTENSION 0x80 /end CHARACTERISTIC
/begin CHARACTERISTIC CtApImageProcess_FreeRunning.PpDR_Merges_10ms.DeDR_List.DR_List[21].delta_y "" VALUE 0x25507a4 __FLOAT32_IEEE_S 0 NO_COMPU_METHOD 0 3.402823e+38 ECU_ADDRESS_EXTENSION 0x80 /end CHARACTERISTIC
/begin CHARACTERISTIC CtApImageProcess_FreeRunning.PpDR_Merges_10ms.DeDR_List.DR_List[21].delta_z "" VALUE 0x25507a8 __FLOAT32_IEEE_S 0 NO_COMPU_METHOD 0 3.402823e+38 ECU_ADDRESS_EXTENSION 0x80 /end CHARACTERISTIC
/begin CHARACTERISTIC CtApImageProcess_FreeRunning.PpDR_Merges_10ms.DeDR_List.DR_List[21].delta_yaw "" VALUE 0x25507ac __FLOAT32_IEEE_S 0 NO_COMPU_METHOD 0 3.402823e+38 ECU_ADDRESS_EXTENSION 0x80 /end CHARACTERISTIC
/begin CHARACTERISTIC CtApImageProcess_FreeRunning.PpDR_Merges_10ms.DeDR_List.DR_List[21].belif "" VALUE 0x25507b0 __FLOAT32_IEEE_S 0 NO_COMPU_METHOD 0 3.402823e+38 ECU_ADDRESS_EXTENSION 0x80 /end CHARACTERISTIC
/begin CHARACTERISTIC CtApImageProcess_FreeRunning.PpDR_Merges_10ms.DeDR_List.DR_List[21].reserved_int "5 uint32 array" VAL_BLK 0x25507b4 __ULONG_S 0 NO_COMPU_METHOD 0 4294967295 ECU_ADDRESS_EXTENSION 0x80 MATRIX_DIM 5 1 1 /end CHARACTERISTIC
/begin CHARACTERISTIC CtApImageProcess_FreeRunning.PpDR_Merges_10ms.DeDR_List.DR_List[22].stHeader.Counter "" VALUE 0x25507c8 __UWORD_S 0 NO_COMPU_METHOD 0 65535 ECU_ADDRESS_EXTENSION 0x80 /end CHARACTERISTIC
/begin CHARACTERISTIC CtApImageProcess_FreeRunning.PpDR_Merges_10ms.DeDR_List.DR_List[22].stHeader.FrameID "" VALUE 0x25507ca __UBYTE_S 0 NO_COMPU_METHOD 0 255 ECU_ADDRESS_EXTENSION 0x80 /end CHARACTERISTIC
/begin CHARACTERISTIC CtApImageProcess_FreeRunning.PpDR_Merges_10ms.DeDR_List.DR_List[22].stHeader.TimeStamp "2 uint32 array" VAL_BLK 0x25507cc __ULONG_S 0 NO_COMPU_METHOD 0 4294967295 ECU_ADDRESS_EXTENSION 0x80 MATRIX_DIM 2 1 1 /end CHARACTERISTIC
/begin CHARACTERISTIC CtApImageProcess_FreeRunning.PpDR_Merges_10ms.DeDR_List.DR_List[22].count "" VALUE 0x25507d4 __UBYTE_S 0 NO_COMPU_METHOD 0 255 ECU_ADDRESS_EXTENSION 0x80 /end CHARACTERISTIC
/begin CHARACTERISTIC CtApImageProcess_FreeRunning.PpDR_Merges_10ms.DeDR_List.DR_List[22].time_sec "" VALUE 0x25507d8 __FLOAT64_IEEE_S 0 NO_COMPU_METHOD 0 3.402823e+38 ECU_ADDRESS_EXTENSION 0x80 /end CHARACTERISTIC
/begin CHARACTERISTIC CtApImageProcess_FreeRunning.PpDR_Merges_10ms.DeDR_List.DR_List[22].utm_x "" VALUE 0x25507e0 __FLOAT64_IEEE_S 0 NO_COMPU_METHOD 0 3.402823e+38 ECU_ADDRESS_EXTENSION 0x80 /end CHARACTERISTIC
/begin CHARACTERISTIC CtApImageProcess_FreeRunning.PpDR_Merges_10ms.DeDR_List.DR_List[22].utm_y "" VALUE 0x25507e8 __FLOAT64_IEEE_S 0 NO_COMPU_METHOD 0 3.402823e+38 ECU_ADDRESS_EXTENSION 0x80 /end CHARACTERISTIC
/begin CHARACTERISTIC CtApImageProcess_FreeRunning.PpDR_Merges_10ms.DeDR_List.DR_List[22].utm_z "" VALUE 0x25507f0 __FLOAT32_IEEE_S 0 NO_COMPU_METHOD 0 3.402823e+38 ECU_ADDRESS_EXTENSION 0x80 /end CHARACTERISTIC
/begin CHARACTERISTIC CtApImageProcess_FreeRunning.PpDR_Merges_10ms.DeDR_List.DR_List[22].heading "" VALUE 0x25507f4 __FLOAT32_IEEE_S 0 NO_COMPU_METHOD 0 3.402823e+38 ECU_ADDRESS_EXTENSION 0x80 /end CHARACTERISTIC
/begin CHARACTERISTIC CtApImageProcess_FreeRunning.PpDR_Merges_10ms.DeDR_List.DR_List[22].delta_x "" VALUE 0x25507f8 __FLOAT32_IEEE_S 0 NO_COMPU_METHOD 0 3.402823e+38 ECU_ADDRESS_EXTENSION 0x80 /end CHARACTERISTIC
/begin CHARACTERISTIC CtApImageProcess_FreeRunning.PpDR_Merges_10ms.DeDR_List.DR_List[22].delta_y "" VALUE 0x25507fc __FLOAT32_IEEE_S 0 NO_COMPU_METHOD 0 3.402823e+38 ECU_ADDRESS_EXTENSION 0x80 /end CHARACTERISTIC
/begin CHARACTERISTIC CtApImageProcess_FreeRunning.PpDR_Merges_10ms.DeDR_List.DR_List[22].delta_z "" VALUE 0x2550800 __FLOAT32_IEEE_S 0 NO_COMPU_METHOD 0 3.402823e+38 ECU_ADDRESS_EXTENSION 0x80 /end CHARACTERISTIC
/begin CHARACTERISTIC CtApImageProcess_FreeRunning.PpDR_Merges_10ms.DeDR_List.DR_List[22].delta_yaw "" VALUE 0x2550804 __FLOAT32_IEEE_S 0 NO_COMPU_METHOD 0 3.402823e+38 ECU_ADDRESS_EXTENSION 0x80 /end CHARACTERISTIC
/begin CHARACTERISTIC CtApImageProcess_FreeRunning.PpDR_Merges_10ms.DeDR_List.DR_List[22].belif "" VALUE 0x2550808 __FLOAT32_IEEE_S 0 NO_COMPU_METHOD 0 3.402823e+38 ECU_ADDRESS_EXTENSION 0x80 /end CHARACTERISTIC
/begin CHARACTERISTIC CtApImageProcess_FreeRunning.PpDR_Merges_10ms.DeDR_List.DR_List[22].reserved_int "5 uint32 array" VAL_BLK 0x255080c __ULONG_S 0 NO_COMPU_METHOD 0 4294967295 ECU_ADDRESS_EXTENSION 0x80 MATRIX_DIM 5 1 1 /end CHARACTERISTIC
/begin CHARACTERISTIC CtApImageProcess_FreeRunning.PpDR_Merges_10ms.DeDR_List.DR_List[23].stHeader.Counter "" VALUE 0x2550820 __UWORD_S 0 NO_COMPU_METHOD 0 65535 ECU_ADDRESS_EXTENSION 0x80 /end CHARACTERISTIC
/begin CHARACTERISTIC CtApImageProcess_FreeRunning.PpDR_Merges_10ms.DeDR_List.DR_List[23].stHeader.FrameID "" VALUE 0x2550822 __UBYTE_S 0 NO_COMPU_METHOD 0 255 ECU_ADDRESS_EXTENSION 0x80 /end CHARACTERISTIC
/begin CHARACTERISTIC CtApImageProcess_FreeRunning.PpDR_Merges_10ms.DeDR_List.DR_List[23].stHeader.TimeStamp "2 uint32 array" VAL_BLK 0x2550824 __ULONG_S 0 NO_COMPU_METHOD 0 4294967295 ECU_ADDRESS_EXTENSION 0x80 MATRIX_DIM 2 1 1 /end CHARACTERISTIC
/begin CHARACTERISTIC CtApImageProcess_FreeRunning.PpDR_Merges_10ms.DeDR_List.DR_List[23].count "" VALUE 0x255082c __UBYTE_S 0 NO_COMPU_METHOD 0 255 ECU_ADDRESS_EXTENSION 0x80 /end CHARACTERISTIC
/begin CHARACTERISTIC CtApImageProcess_FreeRunning.PpDR_Merges_10ms.DeDR_List.DR_List[23].time_sec "" VALUE 0x2550830 __FLOAT64_IEEE_S 0 NO_COMPU_METHOD 0 3.402823e+38 ECU_ADDRESS_EXTENSION 0x80 /end CHARACTERISTIC
/begin CHARACTERISTIC CtApImageProcess_FreeRunning.PpDR_Merges_10ms.DeDR_List.DR_List[23].utm_x "" VALUE 0x2550838 __FLOAT64_IEEE_S 0 NO_COMPU_METHOD 0 3.402823e+38 ECU_ADDRESS_EXTENSION 0x80 /end CHARACTERISTIC
/begin CHARACTERISTIC CtApImageProcess_FreeRunning.PpDR_Merges_10ms.DeDR_List.DR_List[23].utm_y "" VALUE 0x2550840 __FLOAT64_IEEE_S 0 NO_COMPU_METHOD 0 3.402823e+38 ECU_ADDRESS_EXTENSION 0x80 /end CHARACTERISTIC
/begin CHARACTERISTIC CtApImageProcess_FreeRunning.PpDR_Merges_10ms.DeDR_List.DR_List[23].utm_z "" VALUE 0x2550848 __FLOAT32_IEEE_S 0 NO_COMPU_METHOD 0 3.402823e+38 ECU_ADDRESS_EXTENSION 0x80 /end CHARACTERISTIC
/begin CHARACTERISTIC CtApImageProcess_FreeRunning.PpDR_Merges_10ms.DeDR_List.DR_List[23].heading "" VALUE 0x255084c __FLOAT32_IEEE_S 0 NO_COMPU_METHOD 0 3.402823e+38 ECU_ADDRESS_EXTENSION 0x80 /end CHARACTERISTIC
/begin CHARACTERISTIC CtApImageProcess_FreeRunning.PpDR_Merges_10ms.DeDR_List.DR_List[23].delta_x "" VALUE 0x2550850 __FLOAT32_IEEE_S 0 NO_COMPU_METHOD 0 3.402823e+38 ECU_ADDRESS_EXTENSION 0x80 /end CHARACTERISTIC
/begin CHARACTERISTIC CtApImageProcess_FreeRunning.PpDR_Merges_10ms.DeDR_List.DR_List[23].delta_y "" VALUE 0x2550854 __FLOAT32_IEEE_S 0 NO_COMPU_METHOD 0 3.402823e+38 ECU_ADDRESS_EXTENSION 0x80 /end CHARACTERISTIC
/begin CHARACTERISTIC CtApImageProcess_FreeRunning.PpDR_Merges_10ms.DeDR_List.DR_List[23].delta_z "" VALUE 0x2550858 __FLOAT32_IEEE_S 0 NO_COMPU_METHOD 0 3.402823e+38 ECU_ADDRESS_EXTENSION 0x80 /end CHARACTERISTIC
/begin CHARACTERISTIC CtApImageProcess_FreeRunning.PpDR_Merges_10ms.DeDR_List.DR_List[23].delta_yaw "" VALUE 0x255085c __FLOAT32_IEEE_S 0 NO_COMPU_METHOD 0 3.402823e+38 ECU_ADDRESS_EXTENSION 0x80 /end CHARACTERISTIC
/begin CHARACTERISTIC CtApImageProcess_FreeRunning.PpDR_Merges_10ms.DeDR_List.DR_List[23].belif "" VALUE 0x2550860 __FLOAT32_IEEE_S 0 NO_COMPU_METHOD 0 3.402823e+38 ECU_ADDRESS_EXTENSION 0x80 /end CHARACTERISTIC
/begin CHARACTERISTIC CtApImageProcess_FreeRunning.PpDR_Merges_10ms.DeDR_List.DR_List[23].reserved_int "5 uint32 array" VAL_BLK 0x2550864 __ULONG_S 0 NO_COMPU_METHOD 0 4294967295 ECU_ADDRESS_EXTENSION 0x80 MATRIX_DIM 5 1 1 /end CHARACTERISTIC
/begin CHARACTERISTIC CtApImageProcess_FreeRunning.PpDR_Merges_10ms.DeDR_List.DR_List[24].stHeader.Counter "" VALUE 0x2550878 __UWORD_S 0 NO_COMPU_METHOD 0 65535 ECU_ADDRESS_EXTENSION 0x80 /end CHARACTERISTIC
/begin CHARACTERISTIC CtApImageProcess_FreeRunning.PpDR_Merges_10ms.DeDR_List.DR_List[24].stHeader.FrameID "" VALUE 0x255087a __UBYTE_S 0 NO_COMPU_METHOD 0 255 ECU_ADDRESS_EXTENSION 0x80 /end CHARACTERISTIC
/begin CHARACTERISTIC CtApImageProcess_FreeRunning.PpDR_Merges_10ms.DeDR_List.DR_List[24].stHeader.TimeStamp "2 uint32 array" VAL_BLK 0x255087c __ULONG_S 0 NO_COMPU_METHOD 0 4294967295 ECU_ADDRESS_EXTENSION 0x80 MATRIX_DIM 2 1 1 /end CHARACTERISTIC
/begin CHARACTERISTIC CtApImageProcess_FreeRunning.PpDR_Merges_10ms.DeDR_List.DR_List[24].count "" VALUE 0x2550884 __UBYTE_S 0 NO_COMPU_METHOD 0 255 ECU_ADDRESS_EXTENSION 0x80 /end CHARACTERISTIC
/begin CHARACTERISTIC CtApImageProcess_FreeRunning.PpDR_Merges_10ms.DeDR_List.DR_List[24].time_sec "" VALUE 0x2550888 __FLOAT64_IEEE_S 0 NO_COMPU_METHOD 0 3.402823e+38 ECU_ADDRESS_EXTENSION 0x80 /end CHARACTERISTIC
/begin CHARACTERISTIC CtApImageProcess_FreeRunning.PpDR_Merges_10ms.DeDR_List.DR_List[24].utm_x "" VALUE 0x2550890 __FLOAT64_IEEE_S 0 NO_COMPU_METHOD 0 3.402823e+38 ECU_ADDRESS_EXTENSION 0x80 /end CHARACTERISTIC
/begin CHARACTERISTIC CtApImageProcess_FreeRunning.PpDR_Merges_10ms.DeDR_List.DR_List[24].utm_y "" VALUE 0x2550898 __FLOAT64_IEEE_S 0 NO_COMPU_METHOD 0 3.402823e+38 ECU_ADDRESS_EXTENSION 0x80 /end CHARACTERISTIC
/begin CHARACTERISTIC CtApImageProcess_FreeRunning.PpDR_Merges_10ms.DeDR_List.DR_List[24].utm_z "" VALUE 0x25508a0 __FLOAT32_IEEE_S 0 NO_COMPU_METHOD 0 3.402823e+38 ECU_ADDRESS_EXTENSION 0x80 /end CHARACTERISTIC
/begin CHARACTERISTIC CtApImageProcess_FreeRunning.PpDR_Merges_10ms.DeDR_List.DR_List[24].heading "" VALUE 0x25508a4 __FLOAT32_IEEE_S 0 NO_COMPU_METHOD 0 3.402823e+38 ECU_ADDRESS_EXTENSION 0x80 /end CHARACTERISTIC
/begin CHARACTERISTIC CtApImageProcess_FreeRunning.PpDR_Merges_10ms.DeDR_List.DR_List[24].delta_x "" VALUE 0x25508a8 __FLOAT32_IEEE_S 0 NO_COMPU_METHOD 0 3.402823e+38 ECU_ADDRESS_EXTENSION 0x80 /end CHARACTERISTIC
/begin CHARACTERISTIC CtApImageProcess_FreeRunning.PpDR_Merges_10ms.DeDR_List.DR_List[24].delta_y "" VALUE 0x25508ac __FLOAT32_IEEE_S 0 NO_COMPU_METHOD 0 3.402823e+38 ECU_ADDRESS_EXTENSION 0x80 /end CHARACTERISTIC
/begin CHARACTERISTIC CtApImageProcess_FreeRunning.PpDR_Merges_10ms.DeDR_List.DR_List[24].delta_z "" VALUE 0x25508b0 __FLOAT32_IEEE_S 0 NO_COMPU_METHOD 0 3.402823e+38 ECU_ADDRESS_EXTENSION 0x80 /end CHARACTERISTIC
/begin CHARACTERISTIC CtApImageProcess_FreeRunning.PpDR_Merges_10ms.DeDR_List.DR_List[24].delta_yaw "" VALUE 0x25508b4 __FLOAT32_IEEE_S 0 NO_COMPU_METHOD 0 3.402823e+38 ECU_ADDRESS_EXTENSION 0x80 /end CHARACTERISTIC
/begin CHARACTERISTIC CtApImageProcess_FreeRunning.PpDR_Merges_10ms.DeDR_List.DR_List[24].belif "" VALUE 0x25508b8 __FLOAT32_IEEE_S 0 NO_COMPU_METHOD 0 3.402823e+38 ECU_ADDRESS_EXTENSION 0x80 /end CHARACTERISTIC
/begin CHARACTERISTIC CtApImageProcess_FreeRunning.PpDR_Merges_10ms.DeDR_List.DR_List[24].reserved_int "5 uint32 array" VAL_BLK 0x25508bc __ULONG_S 0 NO_COMPU_METHOD 0 4294967295 ECU_ADDRESS_EXTENSION 0x80 MATRIX_DIM 5 1 1 /end CHARACTERISTIC
/begin CHARACTERISTIC CtApImageProcess_FreeRunning.PpDR_Merges_10ms.DeDR_List.DR_List[25].stHeader.Counter "" VALUE 0x25508d0 __UWORD_S 0 NO_COMPU_METHOD 0 65535 ECU_ADDRESS_EXTENSION 0x80 /end CHARACTERISTIC
/begin CHARACTERISTIC CtApImageProcess_FreeRunning.PpDR_Merges_10ms.DeDR_List.DR_List[25].stHeader.FrameID "" VALUE 0x25508d2 __UBYTE_S 0 NO_COMPU_METHOD 0 255 ECU_ADDRESS_EXTENSION 0x80 /end CHARACTERISTIC
/begin CHARACTERISTIC CtApImageProcess_FreeRunning.PpDR_Merges_10ms.DeDR_List.DR_List[25].stHeader.TimeStamp "2 uint32 array" VAL_BLK 0x25508d4 __ULONG_S 0 NO_COMPU_METHOD 0 4294967295 ECU_ADDRESS_EXTENSION 0x80 MATRIX_DIM 2 1 1 /end CHARACTERISTIC
/begin CHARACTERISTIC CtApImageProcess_FreeRunning.PpDR_Merges_10ms.DeDR_List.DR_List[25].count "" VALUE 0x25508dc __UBYTE_S 0 NO_COMPU_METHOD 0 255 ECU_ADDRESS_EXTENSION 0x80 /end CHARACTERISTIC
/begin CHARACTERISTIC CtApImageProcess_FreeRunning.PpDR_Merges_10ms.DeDR_List.DR_List[25].time_sec "" VALUE 0x25508e0 __FLOAT64_IEEE_S 0 NO_COMPU_METHOD 0 3.402823e+38 ECU_ADDRESS_EXTENSION 0x80 /end CHARACTERISTIC
/begin CHARACTERISTIC CtApImageProcess_FreeRunning.PpDR_Merges_10ms.DeDR_List.DR_List[25].utm_x "" VALUE 0x25508e8 __FLOAT64_IEEE_S 0 NO_COMPU_METHOD 0 3.402823e+38 ECU_ADDRESS_EXTENSION 0x80 /end CHARACTERISTIC
/begin CHARACTERISTIC CtApImageProcess_FreeRunning.PpDR_Merges_10ms.DeDR_List.DR_List[25].utm_y "" VALUE 0x25508f0 __FLOAT64_IEEE_S 0 NO_COMPU_METHOD 0 3.402823e+38 ECU_ADDRESS_EXTENSION 0x80 /end CHARACTERISTIC
/begin CHARACTERISTIC CtApImageProcess_FreeRunning.PpDR_Merges_10ms.DeDR_List.DR_List[25].utm_z "" VALUE 0x25508f8 __FLOAT32_IEEE_S 0 NO_COMPU_METHOD 0 3.402823e+38 ECU_ADDRESS_EXTENSION 0x80 /end CHARACTERISTIC
/begin CHARACTERISTIC CtApImageProcess_FreeRunning.PpDR_Merges_10ms.DeDR_List.DR_List[25].heading "" VALUE 0x25508fc __FLOAT32_IEEE_S 0 NO_COMPU_METHOD 0 3.402823e+38 ECU_ADDRESS_EXTENSION 0x80 /end CHARACTERISTIC
/begin CHARACTERISTIC CtApImageProcess_FreeRunning.PpDR_Merges_10ms.DeDR_List.DR_List[25].delta_x "" VALUE 0x2550900 __FLOAT32_IEEE_S 0 NO_COMPU_METHOD 0 3.402823e+38 ECU_ADDRESS_EXTENSION 0x80 /end CHARACTERISTIC
/begin CHARACTERISTIC CtApImageProcess_FreeRunning.PpDR_Merges_10ms.DeDR_List.DR_List[25].delta_y "" VALUE 0x2550904 __FLOAT32_IEEE_S 0 NO_COMPU_METHOD 0 3.402823e+38 ECU_ADDRESS_EXTENSION 0x80 /end CHARACTERISTIC
/begin CHARACTERISTIC CtApImageProcess_FreeRunning.PpDR_Merges_10ms.DeDR_List.DR_List[25].delta_z "" VALUE 0x2550908 __FLOAT32_IEEE_S 0 NO_COMPU_METHOD 0 3.402823e+38 ECU_ADDRESS_EXTENSION 0x80 /end CHARACTERISTIC
/begin CHARACTERISTIC CtApImageProcess_FreeRunning.PpDR_Merges_10ms.DeDR_List.DR_List[25].delta_yaw "" VALUE 0x255090c __FLOAT32_IEEE_S 0 NO_COMPU_METHOD 0 3.402823e+38 ECU_ADDRESS_EXTENSION 0x80 /end CHARACTERISTIC
/begin CHARACTERISTIC CtApImageProcess_FreeRunning.PpDR_Merges_10ms.DeDR_List.DR_List[25].belif "" VALUE 0x2550910 __FLOAT32_IEEE_S 0 NO_COMPU_METHOD 0 3.402823e+38 ECU_ADDRESS_EXTENSION 0x80 /end CHARACTERISTIC
/begin CHARACTERISTIC CtApImageProcess_FreeRunning.PpDR_Merges_10ms.DeDR_List.DR_List[25].reserved_int "5 uint32 array" VAL_BLK 0x2550914 __ULONG_S 0 NO_COMPU_METHOD 0 4294967295 ECU_ADDRESS_EXTENSION 0x80 MATRIX_DIM 5 1 1 /end CHARACTERISTIC
/begin CHARACTERISTIC CtApImageProcess_FreeRunning.PpDR_Merges_10ms.DeDR_List.DR_List[26].stHeader.Counter "" VALUE 0x2550928 __UWORD_S 0 NO_COMPU_METHOD 0 65535 ECU_ADDRESS_EXTENSION 0x80 /end CHARACTERISTIC
/begin CHARACTERISTIC CtApImageProcess_FreeRunning.PpDR_Merges_10ms.DeDR_List.DR_List[26].stHeader.FrameID "" VALUE 0x255092a __UBYTE_S 0 NO_COMPU_METHOD 0 255 ECU_ADDRESS_EXTENSION 0x80 /end CHARACTERISTIC
/begin CHARACTERISTIC CtApImageProcess_FreeRunning.PpDR_Merges_10ms.DeDR_List.DR_List[26].stHeader.TimeStamp "2 uint32 array" VAL_BLK 0x255092c __ULONG_S 0 NO_COMPU_METHOD 0 4294967295 ECU_ADDRESS_EXTENSION 0x80 MATRIX_DIM 2 1 1 /end CHARACTERISTIC
/begin CHARACTERISTIC CtApImageProcess_FreeRunning.PpDR_Merges_10ms.DeDR_List.DR_List[26].count "" VALUE 0x2550934 __UBYTE_S 0 NO_COMPU_METHOD 0 255 ECU_ADDRESS_EXTENSION 0x80 /end CHARACTERISTIC
/begin CHARACTERISTIC CtApImageProcess_FreeRunning.PpDR_Merges_10ms.DeDR_List.DR_List[26].time_sec "" VALUE 0x2550938 __FLOAT64_IEEE_S 0 NO_COMPU_METHOD 0 3.402823e+38 ECU_ADDRESS_EXTENSION 0x80 /end CHARACTERISTIC
/begin CHARACTERISTIC CtApImageProcess_FreeRunning.PpDR_Merges_10ms.DeDR_List.DR_List[26].utm_x "" VALUE 0x2550940 __FLOAT64_IEEE_S 0 NO_COMPU_METHOD 0 3.402823e+38 ECU_ADDRESS_EXTENSION 0x80 /end CHARACTERISTIC
/begin CHARACTERISTIC CtApImageProcess_FreeRunning.PpDR_Merges_10ms.DeDR_List.DR_List[26].utm_y "" VALUE 0x2550948 __FLOAT64_IEEE_S 0 NO_COMPU_METHOD 0 3.402823e+38 ECU_ADDRESS_EXTENSION 0x80 /end CHARACTERISTIC
/begin CHARACTERISTIC CtApImageProcess_FreeRunning.PpDR_Merges_10ms.DeDR_List.DR_List[26].utm_z "" VALUE 0x2550950 __FLOAT32_IEEE_S 0 NO_COMPU_METHOD 0 3.402823e+38 ECU_ADDRESS_EXTENSION 0x80 /end CHARACTERISTIC
/begin CHARACTERISTIC CtApImageProcess_FreeRunning.PpDR_Merges_10ms.DeDR_List.DR_List[26].heading "" VALUE 0x2550954 __FLOAT32_IEEE_S 0 NO_COMPU_METHOD 0 3.402823e+38 ECU_ADDRESS_EXTENSION 0x80 /end CHARACTERISTIC
/begin CHARACTERISTIC CtApImageProcess_FreeRunning.PpDR_Merges_10ms.DeDR_List.DR_List[26].delta_x "" VALUE 0x2550958 __FLOAT32_IEEE_S 0 NO_COMPU_METHOD 0 3.402823e+38 ECU_ADDRESS_EXTENSION 0x80 /end CHARACTERISTIC
/begin CHARACTERISTIC CtApImageProcess_FreeRunning.PpDR_Merges_10ms.DeDR_List.DR_List[26].delta_y "" VALUE 0x255095c __FLOAT32_IEEE_S 0 NO_COMPU_METHOD 0 3.402823e+38 ECU_ADDRESS_EXTENSION 0x80 /end CHARACTERISTIC
/begin CHARACTERISTIC CtApImageProcess_FreeRunning.PpDR_Merges_10ms.DeDR_List.DR_List[26].delta_z "" VALUE 0x2550960 __FLOAT32_IEEE_S 0 NO_COMPU_METHOD 0 3.402823e+38 ECU_ADDRESS_EXTENSION 0x80 /end CHARACTERISTIC
/begin CHARACTERISTIC CtApImageProcess_FreeRunning.PpDR_Merges_10ms.DeDR_List.DR_List[26].delta_yaw "" VALUE 0x2550964 __FLOAT32_IEEE_S 0 NO_COMPU_METHOD 0 3.402823e+38 ECU_ADDRESS_EXTENSION 0x80 /end CHARACTERISTIC
/begin CHARACTERISTIC CtApImageProcess_FreeRunning.PpDR_Merges_10ms.DeDR_List.DR_List[26].belif "" VALUE 0x2550968 __FLOAT32_IEEE_S 0 NO_COMPU_METHOD 0 3.402823e+38 ECU_ADDRESS_EXTENSION 0x80 /end CHARACTERISTIC
/begin CHARACTERISTIC CtApImageProcess_FreeRunning.PpDR_Merges_10ms.DeDR_List.DR_List[26].reserved_int "5 uint32 array" VAL_BLK 0x255096c __ULONG_S 0 NO_COMPU_METHOD 0 4294967295 ECU_ADDRESS_EXTENSION 0x80 MATRIX_DIM 5 1 1 /end CHARACTERISTIC
/begin CHARACTERISTIC CtApImageProcess_FreeRunning.PpDR_Merges_10ms.DeDR_List.DR_List[27].stHeader.Counter "" VALUE 0x2550980 __UWORD_S 0 NO_COMPU_METHOD 0 65535 ECU_ADDRESS_EXTENSION 0x80 /end CHARACTERISTIC
/begin CHARACTERISTIC CtApImageProcess_FreeRunning.PpDR_Merges_10ms.DeDR_List.DR_List[27].stHeader.FrameID "" VALUE 0x2550982 __UBYTE_S 0 NO_COMPU_METHOD 0 255 ECU_ADDRESS_EXTENSION 0x80 /end CHARACTERISTIC
/begin CHARACTERISTIC CtApImageProcess_FreeRunning.PpDR_Merges_10ms.DeDR_List.DR_List[27].stHeader.TimeStamp "2 uint32 array" VAL_BLK 0x2550984 __ULONG_S 0 NO_COMPU_METHOD 0 4294967295 ECU_ADDRESS_EXTENSION 0x80 MATRIX_DIM 2 1 1 /end CHARACTERISTIC
/begin CHARACTERISTIC CtApImageProcess_FreeRunning.PpDR_Merges_10ms.DeDR_List.DR_List[27].count "" VALUE 0x255098c __UBYTE_S 0 NO_COMPU_METHOD 0 255 ECU_ADDRESS_EXTENSION 0x80 /end CHARACTERISTIC
/begin CHARACTERISTIC CtApImageProcess_FreeRunning.PpDR_Merges_10ms.DeDR_List.DR_List[27].time_sec "" VALUE 0x2550990 __FLOAT64_IEEE_S 0 NO_COMPU_METHOD 0 3.402823e+38 ECU_ADDRESS_EXTENSION 0x80 /end CHARACTERISTIC
/begin CHARACTERISTIC CtApImageProcess_FreeRunning.PpDR_Merges_10ms.DeDR_List.DR_List[27].utm_x "" VALUE 0x2550998 __FLOAT64_IEEE_S 0 NO_COMPU_METHOD 0 3.402823e+38 ECU_ADDRESS_EXTENSION 0x80 /end CHARACTERISTIC
/begin CHARACTERISTIC CtApImageProcess_FreeRunning.PpDR_Merges_10ms.DeDR_List.DR_List[27].utm_y "" VALUE 0x25509a0 __FLOAT64_IEEE_S 0 NO_COMPU_METHOD 0 3.402823e+38 ECU_ADDRESS_EXTENSION 0x80 /end CHARACTERISTIC
/begin CHARACTERISTIC CtApImageProcess_FreeRunning.PpDR_Merges_10ms.DeDR_List.DR_List[27].utm_z "" VALUE 0x25509a8 __FLOAT32_IEEE_S 0 NO_COMPU_METHOD 0 3.402823e+38 ECU_ADDRESS_EXTENSION 0x80 /end CHARACTERISTIC
/begin CHARACTERISTIC CtApImageProcess_FreeRunning.PpDR_Merges_10ms.DeDR_List.DR_List[27].heading "" VALUE 0x25509ac __FLOAT32_IEEE_S 0 NO_COMPU_METHOD 0 3.402823e+38 ECU_ADDRESS_EXTENSION 0x80 /end CHARACTERISTIC
/begin CHARACTERISTIC CtApImageProcess_FreeRunning.PpDR_Merges_10ms.DeDR_List.DR_List[27].delta_x "" VALUE 0x25509b0 __FLOAT32_IEEE_S 0 NO_COMPU_METHOD 0 3.402823e+38 ECU_ADDRESS_EXTENSION 0x80 /end CHARACTERISTIC
/begin CHARACTERISTIC CtApImageProcess_FreeRunning.PpDR_Merges_10ms.DeDR_List.DR_List[27].delta_y "" VALUE 0x25509b4 __FLOAT32_IEEE_S 0 NO_COMPU_METHOD 0 3.402823e+38 ECU_ADDRESS_EXTENSION 0x80 /end CHARACTERISTIC
/begin CHARACTERISTIC CtApImageProcess_FreeRunning.PpDR_Merges_10ms.DeDR_List.DR_List[27].delta_z "" VALUE 0x25509b8 __FLOAT32_IEEE_S 0 NO_COMPU_METHOD 0 3.402823e+38 ECU_ADDRESS_EXTENSION 0x80 /end CHARACTERISTIC
/begin CHARACTERISTIC CtApImageProcess_FreeRunning.PpDR_Merges_10ms.DeDR_List.DR_List[27].delta_yaw "" VALUE 0x25509bc __FLOAT32_IEEE_S 0 NO_COMPU_METHOD 0 3.402823e+38 ECU_ADDRESS_EXTENSION 0x80 /end CHARACTERISTIC
/begin CHARACTERISTIC CtApImageProcess_FreeRunning.PpDR_Merges_10ms.DeDR_List.DR_List[27].belif "" VALUE 0x25509c0 __FLOAT32_IEEE_S 0 NO_COMPU_METHOD 0 3.402823e+38 ECU_ADDRESS_EXTENSION 0x80 /end CHARACTERISTIC
/begin CHARACTERISTIC CtApImageProcess_FreeRunning.PpDR_Merges_10ms.DeDR_List.DR_List[27].reserved_int "5 uint32 array" VAL_BLK 0x25509c4 __ULONG_S 0 NO_COMPU_METHOD 0 4294967295 ECU_ADDRESS_EXTENSION 0x80 MATRIX_DIM 5 1 1 /end CHARACTERISTIC
/begin CHARACTERISTIC CtApImageProcess_FreeRunning.PpDR_Merges_10ms.DeDR_List.DR_List[28].stHeader.Counter "" VALUE 0x25509d8 __UWORD_S 0 NO_COMPU_METHOD 0 65535 ECU_ADDRESS_EXTENSION 0x80 /end CHARACTERISTIC
/begin CHARACTERISTIC CtApImageProcess_FreeRunning.PpDR_Merges_10ms.DeDR_List.DR_List[28].stHeader.FrameID "" VALUE 0x25509da __UBYTE_S 0 NO_COMPU_METHOD 0 255 ECU_ADDRESS_EXTENSION 0x80 /end CHARACTERISTIC
/begin CHARACTERISTIC CtApImageProcess_FreeRunning.PpDR_Merges_10ms.DeDR_List.DR_List[28].stHeader.TimeStamp "2 uint32 array" VAL_BLK 0x25509dc __ULONG_S 0 NO_COMPU_METHOD 0 4294967295 ECU_ADDRESS_EXTENSION 0x80 MATRIX_DIM 2 1 1 /end CHARACTERISTIC
/begin CHARACTERISTIC CtApImageProcess_FreeRunning.PpDR_Merges_10ms.DeDR_List.DR_List[28].count "" VALUE 0x25509e4 __UBYTE_S 0 NO_COMPU_METHOD 0 255 ECU_ADDRESS_EXTENSION 0x80 /end CHARACTERISTIC
/begin CHARACTERISTIC CtApImageProcess_FreeRunning.PpDR_Merges_10ms.DeDR_List.DR_List[28].time_sec "" VALUE 0x25509e8 __FLOAT64_IEEE_S 0 NO_COMPU_METHOD 0 3.402823e+38 ECU_ADDRESS_EXTENSION 0x80 /end CHARACTERISTIC
/begin CHARACTERISTIC CtApImageProcess_FreeRunning.PpDR_Merges_10ms.DeDR_List.DR_List[28].utm_x "" VALUE 0x25509f0 __FLOAT64_IEEE_S 0 NO_COMPU_METHOD 0 3.402823e+38 ECU_ADDRESS_EXTENSION 0x80 /end CHARACTERISTIC
/begin CHARACTERISTIC CtApImageProcess_FreeRunning.PpDR_Merges_10ms.DeDR_List.DR_List[28].utm_y "" VALUE 0x25509f8 __FLOAT64_IEEE_S 0 NO_COMPU_METHOD 0 3.402823e+38 ECU_ADDRESS_EXTENSION 0x80 /end CHARACTERISTIC
/begin CHARACTERISTIC CtApImageProcess_FreeRunning.PpDR_Merges_10ms.DeDR_List.DR_List[28].utm_z "" VALUE 0x2550a00 __FLOAT32_IEEE_S 0 NO_COMPU_METHOD 0 3.402823e+38 ECU_ADDRESS_EXTENSION 0x80 /end CHARACTERISTIC
/begin CHARACTERISTIC CtApImageProcess_FreeRunning.PpDR_Merges_10ms.DeDR_List.DR_List[28].heading "" VALUE 0x2550a04 __FLOAT32_IEEE_S 0 NO_COMPU_METHOD 0 3.402823e+38 ECU_ADDRESS_EXTENSION 0x80 /end CHARACTERISTIC
/begin CHARACTERISTIC CtApImageProcess_FreeRunning.PpDR_Merges_10ms.DeDR_List.DR_List[28].delta_x "" VALUE 0x2550a08 __FLOAT32_IEEE_S 0 NO_COMPU_METHOD 0 3.402823e+38 ECU_ADDRESS_EXTENSION 0x80 /end CHARACTERISTIC
/begin CHARACTERISTIC CtApImageProcess_FreeRunning.PpDR_Merges_10ms.DeDR_List.DR_List[28].delta_y "" VALUE 0x2550a0c __FLOAT32_IEEE_S 0 NO_COMPU_METHOD 0 3.402823e+38 ECU_ADDRESS_EXTENSION 0x80 /end CHARACTERISTIC
/begin CHARACTERISTIC CtApImageProcess_FreeRunning.PpDR_Merges_10ms.DeDR_List.DR_List[28].delta_z "" VALUE 0x2550a10 __FLOAT32_IEEE_S 0 NO_COMPU_METHOD 0 3.402823e+38 ECU_ADDRESS_EXTENSION 0x80 /end CHARACTERISTIC
/begin CHARACTERISTIC CtApImageProcess_FreeRunning.PpDR_Merges_10ms.DeDR_List.DR_List[28].delta_yaw "" VALUE 0x2550a14 __FLOAT32_IEEE_S 0 NO_COMPU_METHOD 0 3.402823e+38 ECU_ADDRESS_EXTENSION 0x80 /end CHARACTERISTIC
/begin CHARACTERISTIC CtApImageProcess_FreeRunning.PpDR_Merges_10ms.DeDR_List.DR_List[28].belif "" VALUE 0x2550a18 __FLOAT32_IEEE_S 0 NO_COMPU_METHOD 0 3.402823e+38 ECU_ADDRESS_EXTENSION 0x80 /end CHARACTERISTIC
/begin CHARACTERISTIC CtApImageProcess_FreeRunning.PpDR_Merges_10ms.DeDR_List.DR_List[28].reserved_int "5 uint32 array" VAL_BLK 0x2550a1c __ULONG_S 0 NO_COMPU_METHOD 0 4294967295 ECU_ADDRESS_EXTENSION 0x80 MATRIX_DIM 5 1 1 /end CHARACTERISTIC
/begin CHARACTERISTIC CtApImageProcess_FreeRunning.PpDR_Merges_10ms.DeDR_List.DR_List[29].stHeader.Counter "" VALUE 0x2550a30 __UWORD_S 0 NO_COMPU_METHOD 0 65535 ECU_ADDRESS_EXTENSION 0x80 /end CHARACTERISTIC
/begin CHARACTERISTIC CtApImageProcess_FreeRunning.PpDR_Merges_10ms.DeDR_List.DR_List[29].stHeader.FrameID "" VALUE 0x2550a32 __UBYTE_S 0 NO_COMPU_METHOD 0 255 ECU_ADDRESS_EXTENSION 0x80 /end CHARACTERISTIC
/begin CHARACTERISTIC CtApImageProcess_FreeRunning.PpDR_Merges_10ms.DeDR_List.DR_List[29].stHeader.TimeStamp "2 uint32 array" VAL_BLK 0x2550a34 __ULONG_S 0 NO_COMPU_METHOD 0 4294967295 ECU_ADDRESS_EXTENSION 0x80 MATRIX_DIM 2 1 1 /end CHARACTERISTIC
/begin CHARACTERISTIC CtApImageProcess_FreeRunning.PpDR_Merges_10ms.DeDR_List.DR_List[29].count "" VALUE 0x2550a3c __UBYTE_S 0 NO_COMPU_METHOD 0 255 ECU_ADDRESS_EXTENSION 0x80 /end CHARACTERISTIC
/begin CHARACTERISTIC CtApImageProcess_FreeRunning.PpDR_Merges_10ms.DeDR_List.DR_List[29].time_sec "" VALUE 0x2550a40 __FLOAT64_IEEE_S 0 NO_COMPU_METHOD 0 3.402823e+38 ECU_ADDRESS_EXTENSION 0x80 /end CHARACTERISTIC
/begin CHARACTERISTIC CtApImageProcess_FreeRunning.PpDR_Merges_10ms.DeDR_List.DR_List[29].utm_x "" VALUE 0x2550a48 __FLOAT64_IEEE_S 0 NO_COMPU_METHOD 0 3.402823e+38 ECU_ADDRESS_EXTENSION 0x80 /end CHARACTERISTIC
/begin CHARACTERISTIC CtApImageProcess_FreeRunning.PpDR_Merges_10ms.DeDR_List.DR_List[29].utm_y "" VALUE 0x2550a50 __FLOAT64_IEEE_S 0 NO_COMPU_METHOD 0 3.402823e+38 ECU_ADDRESS_EXTENSION 0x80 /end CHARACTERISTIC
/begin CHARACTERISTIC CtApImageProcess_FreeRunning.PpDR_Merges_10ms.DeDR_List.DR_List[29].utm_z "" VALUE 0x2550a58 __FLOAT32_IEEE_S 0 NO_COMPU_METHOD 0 3.402823e+38 ECU_ADDRESS_EXTENSION 0x80 /end CHARACTERISTIC
/begin CHARACTERISTIC CtApImageProcess_FreeRunning.PpDR_Merges_10ms.DeDR_List.DR_List[29].heading "" VALUE 0x2550a5c __FLOAT32_IEEE_S 0 NO_COMPU_METHOD 0 3.402823e+38 ECU_ADDRESS_EXTENSION 0x80 /end CHARACTERISTIC
/begin CHARACTERISTIC CtApImageProcess_FreeRunning.PpDR_Merges_10ms.DeDR_List.DR_List[29].delta_x "" VALUE 0x2550a60 __FLOAT32_IEEE_S 0 NO_COMPU_METHOD 0 3.402823e+38 ECU_ADDRESS_EXTENSION 0x80 /end CHARACTERISTIC
/begin CHARACTERISTIC CtApImageProcess_FreeRunning.PpDR_Merges_10ms.DeDR_List.DR_List[29].delta_y "" VALUE 0x2550a64 __FLOAT32_IEEE_S 0 NO_COMPU_METHOD 0 3.402823e+38 ECU_ADDRESS_EXTENSION 0x80 /end CHARACTERISTIC
/begin CHARACTERISTIC CtApImageProcess_FreeRunning.PpDR_Merges_10ms.DeDR_List.DR_List[29].delta_z "" VALUE 0x2550a68 __FLOAT32_IEEE_S 0 NO_COMPU_METHOD 0 3.402823e+38 ECU_ADDRESS_EXTENSION 0x80 /end CHARACTERISTIC
/begin CHARACTERISTIC CtApImageProcess_FreeRunning.PpDR_Merges_10ms.DeDR_List.DR_List[29].delta_yaw "" VALUE 0x2550a6c __FLOAT32_IEEE_S 0 NO_COMPU_METHOD 0 3.402823e+38 ECU_ADDRESS_EXTENSION 0x80 /end CHARACTERISTIC
/begin CHARACTERISTIC CtApImageProcess_FreeRunning.PpDR_Merges_10ms.DeDR_List.DR_List[29].belif "" VALUE 0x2550a70 __FLOAT32_IEEE_S 0 NO_COMPU_METHOD 0 3.402823e+38 ECU_ADDRESS_EXTENSION 0x80 /end CHARACTERISTIC
/begin CHARACTERISTIC CtApImageProcess_FreeRunning.PpDR_Merges_10ms.DeDR_List.DR_List[29].reserved_int "5 uint32 array" VAL_BLK 0x2550a74 __ULONG_S 0 NO_COMPU_METHOD 0 4294967295 ECU_ADDRESS_EXTENSION 0x80 MATRIX_DIM 5 1 1 /end CHARACTERISTIC
/begin CHARACTERISTIC CtApImageProcess_FreeRunning.PpDR_Merges_10ms.DeDR_List.DR_List[30].stHeader.Counter "" VALUE 0x2550a88 __UWORD_S 0 NO_COMPU_METHOD 0 65535 ECU_ADDRESS_EXTENSION 0x80 /end CHARACTERISTIC
/begin CHARACTERISTIC CtApImageProcess_FreeRunning.PpDR_Merges_10ms.DeDR_List.DR_List[30].stHeader.FrameID "" VALUE 0x2550a8a __UBYTE_S 0 NO_COMPU_METHOD 0 255 ECU_ADDRESS_EXTENSION 0x80 /end CHARACTERISTIC
/begin CHARACTERISTIC CtApImageProcess_FreeRunning.PpDR_Merges_10ms.DeDR_List.DR_List[30].stHeader.TimeStamp "2 uint32 array" VAL_BLK 0x2550a8c __ULONG_S 0 NO_COMPU_METHOD 0 4294967295 ECU_ADDRESS_EXTENSION 0x80 MATRIX_DIM 2 1 1 /end CHARACTERISTIC
/begin CHARACTERISTIC CtApImageProcess_FreeRunning.PpDR_Merges_10ms.DeDR_List.DR_List[30].count "" VALUE 0x2550a94 __UBYTE_S 0 NO_COMPU_METHOD 0 255 ECU_ADDRESS_EXTENSION 0x80 /end CHARACTERISTIC
/begin CHARACTERISTIC CtApImageProcess_FreeRunning.PpDR_Merges_10ms.DeDR_List.DR_List[30].time_sec "" VALUE 0x2550a98 __FLOAT64_IEEE_S 0 NO_COMPU_METHOD 0 3.402823e+38 ECU_ADDRESS_EXTENSION 0x80 /end CHARACTERISTIC
/begin CHARACTERISTIC CtApImageProcess_FreeRunning.PpDR_Merges_10ms.DeDR_List.DR_List[30].utm_x "" VALUE 0x2550aa0 __FLOAT64_IEEE_S 0 NO_COMPU_METHOD 0 3.402823e+38 ECU_ADDRESS_EXTENSION 0x80 /end CHARACTERISTIC
/begin CHARACTERISTIC CtApImageProcess_FreeRunning.PpDR_Merges_10ms.DeDR_List.DR_List[30].utm_y "" VALUE 0x2550aa8 __FLOAT64_IEEE_S 0 NO_COMPU_METHOD 0 3.402823e+38 ECU_ADDRESS_EXTENSION 0x80 /end CHARACTERISTIC
/begin CHARACTERISTIC CtApImageProcess_FreeRunning.PpDR_Merges_10ms.DeDR_List.DR_List[30].utm_z "" VALUE 0x2550ab0 __FLOAT32_IEEE_S 0 NO_COMPU_METHOD 0 3.402823e+38 ECU_ADDRESS_EXTENSION 0x80 /end CHARACTERISTIC
/begin CHARACTERISTIC CtApImageProcess_FreeRunning.PpDR_Merges_10ms.DeDR_List.DR_List[30].heading "" VALUE 0x2550ab4 __FLOAT32_IEEE_S 0 NO_COMPU_METHOD 0 3.402823e+38 ECU_ADDRESS_EXTENSION 0x80 /end CHARACTERISTIC
/begin CHARACTERISTIC CtApImageProcess_FreeRunning.PpDR_Merges_10ms.DeDR_List.DR_List[30].delta_x "" VALUE 0x2550ab8 __FLOAT32_IEEE_S 0 NO_COMPU_METHOD 0 3.402823e+38 ECU_ADDRESS_EXTENSION 0x80 /end CHARACTERISTIC
/begin CHARACTERISTIC CtApImageProcess_FreeRunning.PpDR_Merges_10ms.DeDR_List.DR_List[30].delta_y "" VALUE 0x2550abc __FLOAT32_IEEE_S 0 NO_COMPU_METHOD 0 3.402823e+38 ECU_ADDRESS_EXTENSION 0x80 /end CHARACTERISTIC
/begin CHARACTERISTIC CtApImageProcess_FreeRunning.PpDR_Merges_10ms.DeDR_List.DR_List[30].delta_z "" VALUE 0x2550ac0 __FLOAT32_IEEE_S 0 NO_COMPU_METHOD 0 3.402823e+38 ECU_ADDRESS_EXTENSION 0x80 /end CHARACTERISTIC
/begin CHARACTERISTIC CtApImageProcess_FreeRunning.PpDR_Merges_10ms.DeDR_List.DR_List[30].delta_yaw "" VALUE 0x2550ac4 __FLOAT32_IEEE_S 0 NO_COMPU_METHOD 0 3.402823e+38 ECU_ADDRESS_EXTENSION 0x80 /end CHARACTERISTIC
/begin CHARACTERISTIC CtApImageProcess_FreeRunning.PpDR_Merges_10ms.DeDR_List.DR_List[30].belif "" VALUE 0x2550ac8 __FLOAT32_IEEE_S 0 NO_COMPU_METHOD 0 3.402823e+38 ECU_ADDRESS_EXTENSION 0x80 /end CHARACTERISTIC
/begin CHARACTERISTIC CtApImageProcess_FreeRunning.PpDR_Merges_10ms.DeDR_List.DR_List[30].reserved_int "5 uint32 array" VAL_BLK 0x2550acc __ULONG_S 0 NO_COMPU_METHOD 0 4294967295 ECU_ADDRESS_EXTENSION 0x80 MATRIX_DIM 5 1 1 /end CHARACTERISTIC
/begin CHARACTERISTIC CtApImageProcess_FreeRunning.PpDR_Merges_10ms.DeDR_List.DR_List[31].stHeader.Counter "" VALUE 0x2550ae0 __UWORD_S 0 NO_COMPU_METHOD 0 65535 ECU_ADDRESS_EXTENSION 0x80 /end CHARACTERISTIC
/begin CHARACTERISTIC CtApImageProcess_FreeRunning.PpDR_Merges_10ms.DeDR_List.DR_List[31].stHeader.FrameID "" VALUE 0x2550ae2 __UBYTE_S 0 NO_COMPU_METHOD 0 255 ECU_ADDRESS_EXTENSION 0x80 /end CHARACTERISTIC
/begin CHARACTERISTIC CtApImageProcess_FreeRunning.PpDR_Merges_10ms.DeDR_List.DR_List[31].stHeader.TimeStamp "2 uint32 array" VAL_BLK 0x2550ae4 __ULONG_S 0 NO_COMPU_METHOD 0 4294967295 ECU_ADDRESS_EXTENSION 0x80 MATRIX_DIM 2 1 1 /end CHARACTERISTIC
/begin CHARACTERISTIC CtApImageProcess_FreeRunning.PpDR_Merges_10ms.DeDR_List.DR_List[31].count "" VALUE 0x2550aec __UBYTE_S 0 NO_COMPU_METHOD 0 255 ECU_ADDRESS_EXTENSION 0x80 /end CHARACTERISTIC
/begin CHARACTERISTIC CtApImageProcess_FreeRunning.PpDR_Merges_10ms.DeDR_List.DR_List[31].time_sec "" VALUE 0x2550af0 __FLOAT64_IEEE_S 0 NO_COMPU_METHOD 0 3.402823e+38 ECU_ADDRESS_EXTENSION 0x80 /end CHARACTERISTIC
/begin CHARACTERISTIC CtApImageProcess_FreeRunning.PpDR_Merges_10ms.DeDR_List.DR_List[31].utm_x "" VALUE 0x2550af8 __FLOAT64_IEEE_S 0 NO_COMPU_METHOD 0 3.402823e+38 ECU_ADDRESS_EXTENSION 0x80 /end CHARACTERISTIC
/begin CHARACTERISTIC CtApImageProcess_FreeRunning.PpDR_Merges_10ms.DeDR_List.DR_List[31].utm_y "" VALUE 0x2550b00 __FLOAT64_IEEE_S 0 NO_COMPU_METHOD 0 3.402823e+38 ECU_ADDRESS_EXTENSION 0x80 /end CHARACTERISTIC
/begin CHARACTERISTIC CtApImageProcess_FreeRunning.PpDR_Merges_10ms.DeDR_List.DR_List[31].utm_z "" VALUE 0x2550b08 __FLOAT32_IEEE_S 0 NO_COMPU_METHOD 0 3.402823e+38 ECU_ADDRESS_EXTENSION 0x80 /end CHARACTERISTIC
/begin CHARACTERISTIC CtApImageProcess_FreeRunning.PpDR_Merges_10ms.DeDR_List.DR_List[31].heading "" VALUE 0x2550b0c __FLOAT32_IEEE_S 0 NO_COMPU_METHOD 0 3.402823e+38 ECU_ADDRESS_EXTENSION 0x80 /end CHARACTERISTIC
/begin CHARACTERISTIC CtApImageProcess_FreeRunning.PpDR_Merges_10ms.DeDR_List.DR_List[31].delta_x "" VALUE 0x2550b10 __FLOAT32_IEEE_S 0 NO_COMPU_METHOD 0 3.402823e+38 ECU_ADDRESS_EXTENSION 0x80 /end CHARACTERISTIC
/begin CHARACTERISTIC CtApImageProcess_FreeRunning.PpDR_Merges_10ms.DeDR_List.DR_List[31].delta_y "" VALUE 0x2550b14 __FLOAT32_IEEE_S 0 NO_COMPU_METHOD 0 3.402823e+38 ECU_ADDRESS_EXTENSION 0x80 /end CHARACTERISTIC
/begin CHARACTERISTIC CtApImageProcess_FreeRunning.PpDR_Merges_10ms.DeDR_List.DR_List[31].delta_z "" VALUE 0x2550b18 __FLOAT32_IEEE_S 0 NO_COMPU_METHOD 0 3.402823e+38 ECU_ADDRESS_EXTENSION 0x80 /end CHARACTERISTIC
/begin CHARACTERISTIC CtApImageProcess_FreeRunning.PpDR_Merges_10ms.DeDR_List.DR_List[31].delta_yaw "" VALUE 0x2550b1c __FLOAT32_IEEE_S 0 NO_COMPU_METHOD 0 3.402823e+38 ECU_ADDRESS_EXTENSION 0x80 /end CHARACTERISTIC
/begin CHARACTERISTIC CtApImageProcess_FreeRunning.PpDR_Merges_10ms.DeDR_List.DR_List[31].belif "" VALUE 0x2550b20 __FLOAT32_IEEE_S 0 NO_COMPU_METHOD 0 3.402823e+38 ECU_ADDRESS_EXTENSION 0x80 /end CHARACTERISTIC
/begin CHARACTERISTIC CtApImageProcess_FreeRunning.PpDR_Merges_10ms.DeDR_List.DR_List[31].reserved_int "5 uint32 array" VAL_BLK 0x2550b24 __ULONG_S 0 NO_COMPU_METHOD 0 4294967295 ECU_ADDRESS_EXTENSION 0x80 MATRIX_DIM 5 1 1 /end CHARACTERISTIC
/begin CHARACTERISTIC CtApImageProcess_FreeRunning.PpDR_Merges_10ms.DeDR_List.DR_List[32].stHeader.Counter "" VALUE 0x2550b38 __UWORD_S 0 NO_COMPU_METHOD 0 65535 ECU_ADDRESS_EXTENSION 0x80 /end CHARACTERISTIC
/begin CHARACTERISTIC CtApImageProcess_FreeRunning.PpDR_Merges_10ms.DeDR_List.DR_List[32].stHeader.FrameID "" VALUE 0x2550b3a __UBYTE_S 0 NO_COMPU_METHOD 0 255 ECU_ADDRESS_EXTENSION 0x80 /end CHARACTERISTIC
/begin CHARACTERISTIC CtApImageProcess_FreeRunning.PpDR_Merges_10ms.DeDR_List.DR_List[32].stHeader.TimeStamp "2 uint32 array" VAL_BLK 0x2550b3c __ULONG_S 0 NO_COMPU_METHOD 0 4294967295 ECU_ADDRESS_EXTENSION 0x80 MATRIX_DIM 2 1 1 /end CHARACTERISTIC
/begin CHARACTERISTIC CtApImageProcess_FreeRunning.PpDR_Merges_10ms.DeDR_List.DR_List[32].count "" VALUE 0x2550b44 __UBYTE_S 0 NO_COMPU_METHOD 0 255 ECU_ADDRESS_EXTENSION 0x80 /end CHARACTERISTIC
/begin CHARACTERISTIC CtApImageProcess_FreeRunning.PpDR_Merges_10ms.DeDR_List.DR_List[32].time_sec "" VALUE 0x2550b48 __FLOAT64_IEEE_S 0 NO_COMPU_METHOD 0 3.402823e+38 ECU_ADDRESS_EXTENSION 0x80 /end CHARACTERISTIC
/begin CHARACTERISTIC CtApImageProcess_FreeRunning.PpDR_Merges_10ms.DeDR_List.DR_List[32].utm_x "" VALUE 0x2550b50 __FLOAT64_IEEE_S 0 NO_COMPU_METHOD 0 3.402823e+38 ECU_ADDRESS_EXTENSION 0x80 /end CHARACTERISTIC
/begin CHARACTERISTIC CtApImageProcess_FreeRunning.PpDR_Merges_10ms.DeDR_List.DR_List[32].utm_y "" VALUE 0x2550b58 __FLOAT64_IEEE_S 0 NO_COMPU_METHOD 0 3.402823e+38 ECU_ADDRESS_EXTENSION 0x80 /end CHARACTERISTIC
/begin CHARACTERISTIC CtApImageProcess_FreeRunning.PpDR_Merges_10ms.DeDR_List.DR_List[32].utm_z "" VALUE 0x2550b60 __FLOAT32_IEEE_S 0 NO_COMPU_METHOD 0 3.402823e+38 ECU_ADDRESS_EXTENSION 0x80 /end CHARACTERISTIC
/begin CHARACTERISTIC CtApImageProcess_FreeRunning.PpDR_Merges_10ms.DeDR_List.DR_List[32].heading "" VALUE 0x2550b64 __FLOAT32_IEEE_S 0 NO_COMPU_METHOD 0 3.402823e+38 ECU_ADDRESS_EXTENSION 0x80 /end CHARACTERISTIC
/begin CHARACTERISTIC CtApImageProcess_FreeRunning.PpDR_Merges_10ms.DeDR_List.DR_List[32].delta_x "" VALUE 0x2550b68 __FLOAT32_IEEE_S 0 NO_COMPU_METHOD 0 3.402823e+38 ECU_ADDRESS_EXTENSION 0x80 /end CHARACTERISTIC
/begin CHARACTERISTIC CtApImageProcess_FreeRunning.PpDR_Merges_10ms.DeDR_List.DR_List[32].delta_y "" VALUE 0x2550b6c __FLOAT32_IEEE_S 0 NO_COMPU_METHOD 0 3.402823e+38 ECU_ADDRESS_EXTENSION 0x80 /end CHARACTERISTIC
/begin CHARACTERISTIC CtApImageProcess_FreeRunning.PpDR_Merges_10ms.DeDR_List.DR_List[32].delta_z "" VALUE 0x2550b70 __FLOAT32_IEEE_S 0 NO_COMPU_METHOD 0 3.402823e+38 ECU_ADDRESS_EXTENSION 0x80 /end CHARACTERISTIC
/begin CHARACTERISTIC CtApImageProcess_FreeRunning.PpDR_Merges_10ms.DeDR_List.DR_List[32].delta_yaw "" VALUE 0x2550b74 __FLOAT32_IEEE_S 0 NO_COMPU_METHOD 0 3.402823e+38 ECU_ADDRESS_EXTENSION 0x80 /end CHARACTERISTIC
/begin CHARACTERISTIC CtApImageProcess_FreeRunning.PpDR_Merges_10ms.DeDR_List.DR_List[32].belif "" VALUE 0x2550b78 __FLOAT32_IEEE_S 0 NO_COMPU_METHOD 0 3.402823e+38 ECU_ADDRESS_EXTENSION 0x80 /end CHARACTERISTIC
/begin CHARACTERISTIC CtApImageProcess_FreeRunning.PpDR_Merges_10ms.DeDR_List.DR_List[32].reserved_int "5 uint32 array" VAL_BLK 0x2550b7c __ULONG_S 0 NO_COMPU_METHOD 0 4294967295 ECU_ADDRESS_EXTENSION 0x80 MATRIX_DIM 5 1 1 /end CHARACTERISTIC
/begin CHARACTERISTIC CtApImageProcess_FreeRunning.PpDR_Merges_10ms.DeDR_List.DR_List[33].stHeader.Counter "" VALUE 0x2550b90 __UWORD_S 0 NO_COMPU_METHOD 0 65535 ECU_ADDRESS_EXTENSION 0x80 /end CHARACTERISTIC
/begin CHARACTERISTIC CtApImageProcess_FreeRunning.PpDR_Merges_10ms.DeDR_List.DR_List[33].stHeader.FrameID "" VALUE 0x2550b92 __UBYTE_S 0 NO_COMPU_METHOD 0 255 ECU_ADDRESS_EXTENSION 0x80 /end CHARACTERISTIC
/begin CHARACTERISTIC CtApImageProcess_FreeRunning.PpDR_Merges_10ms.DeDR_List.DR_List[33].stHeader.TimeStamp "2 uint32 array" VAL_BLK 0x2550b94 __ULONG_S 0 NO_COMPU_METHOD 0 4294967295 ECU_ADDRESS_EXTENSION 0x80 MATRIX_DIM 2 1 1 /end CHARACTERISTIC
/begin CHARACTERISTIC CtApImageProcess_FreeRunning.PpDR_Merges_10ms.DeDR_List.DR_List[33].count "" VALUE 0x2550b9c __UBYTE_S 0 NO_COMPU_METHOD 0 255 ECU_ADDRESS_EXTENSION 0x80 /end CHARACTERISTIC
/begin CHARACTERISTIC CtApImageProcess_FreeRunning.PpDR_Merges_10ms.DeDR_List.DR_List[33].time_sec "" VALUE 0x2550ba0 __FLOAT64_IEEE_S 0 NO_COMPU_METHOD 0 3.402823e+38 ECU_ADDRESS_EXTENSION 0x80 /end CHARACTERISTIC
/begin CHARACTERISTIC CtApImageProcess_FreeRunning.PpDR_Merges_10ms.DeDR_List.DR_List[33].utm_x "" VALUE 0x2550ba8 __FLOAT64_IEEE_S 0 NO_COMPU_METHOD 0 3.402823e+38 ECU_ADDRESS_EXTENSION 0x80 /end CHARACTERISTIC
/begin CHARACTERISTIC CtApImageProcess_FreeRunning.PpDR_Merges_10ms.DeDR_List.DR_List[33].utm_y "" VALUE 0x2550bb0 __FLOAT64_IEEE_S 0 NO_COMPU_METHOD 0 3.402823e+38 ECU_ADDRESS_EXTENSION 0x80 /end CHARACTERISTIC
/begin CHARACTERISTIC CtApImageProcess_FreeRunning.PpDR_Merges_10ms.DeDR_List.DR_List[33].utm_z "" VALUE 0x2550bb8 __FLOAT32_IEEE_S 0 NO_COMPU_METHOD 0 3.402823e+38 ECU_ADDRESS_EXTENSION 0x80 /end CHARACTERISTIC
/begin CHARACTERISTIC CtApImageProcess_FreeRunning.PpDR_Merges_10ms.DeDR_List.DR_List[33].heading "" VALUE 0x2550bbc __FLOAT32_IEEE_S 0 NO_COMPU_METHOD 0 3.402823e+38 ECU_ADDRESS_EXTENSION 0x80 /end CHARACTERISTIC
/begin CHARACTERISTIC CtApImageProcess_FreeRunning.PpDR_Merges_10ms.DeDR_List.DR_List[33].delta_x "" VALUE 0x2550bc0 __FLOAT32_IEEE_S 0 NO_COMPU_METHOD 0 3.402823e+38 ECU_ADDRESS_EXTENSION 0x80 /end CHARACTERISTIC
/begin CHARACTERISTIC CtApImageProcess_FreeRunning.PpDR_Merges_10ms.DeDR_List.DR_List[33].delta_y "" VALUE 0x2550bc4 __FLOAT32_IEEE_S 0 NO_COMPU_METHOD 0 3.402823e+38 ECU_ADDRESS_EXTENSION 0x80 /end CHARACTERISTIC
/begin CHARACTERISTIC CtApImageProcess_FreeRunning.PpDR_Merges_10ms.DeDR_List.DR_List[33].delta_z "" VALUE 0x2550bc8 __FLOAT32_IEEE_S 0 NO_COMPU_METHOD 0 3.402823e+38 ECU_ADDRESS_EXTENSION 0x80 /end CHARACTERISTIC
/begin CHARACTERISTIC CtApImageProcess_FreeRunning.PpDR_Merges_10ms.DeDR_List.DR_List[33].delta_yaw "" VALUE 0x2550bcc __FLOAT32_IEEE_S 0 NO_COMPU_METHOD 0 3.402823e+38 ECU_ADDRESS_EXTENSION 0x80 /end CHARACTERISTIC
/begin CHARACTERISTIC CtApImageProcess_FreeRunning.PpDR_Merges_10ms.DeDR_List.DR_List[33].belif "" VALUE 0x2550bd0 __FLOAT32_IEEE_S 0 NO_COMPU_METHOD 0 3.402823e+38 ECU_ADDRESS_EXTENSION 0x80 /end CHARACTERISTIC
/begin CHARACTERISTIC CtApImageProcess_FreeRunning.PpDR_Merges_10ms.DeDR_List.DR_List[33].reserved_int "5 uint32 array" VAL_BLK 0x2550bd4 __ULONG_S 0 NO_COMPU_METHOD 0 4294967295 ECU_ADDRESS_EXTENSION 0x80 MATRIX_DIM 5 1 1 /end CHARACTERISTIC
/begin CHARACTERISTIC CtApImageProcess_FreeRunning.PpDR_Merges_10ms.DeDR_List.DR_List[34].stHeader.Counter "" VALUE 0x2550be8 __UWORD_S 0 NO_COMPU_METHOD 0 65535 ECU_ADDRESS_EXTENSION 0x80 /end CHARACTERISTIC
/begin CHARACTERISTIC CtApImageProcess_FreeRunning.PpDR_Merges_10ms.DeDR_List.DR_List[34].stHeader.FrameID "" VALUE 0x2550bea __UBYTE_S 0 NO_COMPU_METHOD 0 255 ECU_ADDRESS_EXTENSION 0x80 /end CHARACTERISTIC
/begin CHARACTERISTIC CtApImageProcess_FreeRunning.PpDR_Merges_10ms.DeDR_List.DR_List[34].stHeader.TimeStamp "2 uint32 array" VAL_BLK 0x2550bec __ULONG_S 0 NO_COMPU_METHOD 0 4294967295 ECU_ADDRESS_EXTENSION 0x80 MATRIX_DIM 2 1 1 /end CHARACTERISTIC
/begin CHARACTERISTIC CtApImageProcess_FreeRunning.PpDR_Merges_10ms.DeDR_List.DR_List[34].count "" VALUE 0x2550bf4 __UBYTE_S 0 NO_COMPU_METHOD 0 255 ECU_ADDRESS_EXTENSION 0x80 /end CHARACTERISTIC
/begin CHARACTERISTIC CtApImageProcess_FreeRunning.PpDR_Merges_10ms.DeDR_List.DR_List[34].time_sec "" VALUE 0x2550bf8 __FLOAT64_IEEE_S 0 NO_COMPU_METHOD 0 3.402823e+38 ECU_ADDRESS_EXTENSION 0x80 /end CHARACTERISTIC
/begin CHARACTERISTIC CtApImageProcess_FreeRunning.PpDR_Merges_10ms.DeDR_List.DR_List[34].utm_x "" VALUE 0x2550c00 __FLOAT64_IEEE_S 0 NO_COMPU_METHOD 0 3.402823e+38 ECU_ADDRESS_EXTENSION 0x80 /end CHARACTERISTIC
/begin CHARACTERISTIC CtApImageProcess_FreeRunning.PpDR_Merges_10ms.DeDR_List.DR_List[34].utm_y "" VALUE 0x2550c08 __FLOAT64_IEEE_S 0 NO_COMPU_METHOD 0 3.402823e+38 ECU_ADDRESS_EXTENSION 0x80 /end CHARACTERISTIC
/begin CHARACTERISTIC CtApImageProcess_FreeRunning.PpDR_Merges_10ms.DeDR_List.DR_List[34].utm_z "" VALUE 0x2550c10 __FLOAT32_IEEE_S 0 NO_COMPU_METHOD 0 3.402823e+38 ECU_ADDRESS_EXTENSION 0x80 /end CHARACTERISTIC
/begin CHARACTERISTIC CtApImageProcess_FreeRunning.PpDR_Merges_10ms.DeDR_List.DR_List[34].heading "" VALUE 0x2550c14 __FLOAT32_IEEE_S 0 NO_COMPU_METHOD 0 3.402823e+38 ECU_ADDRESS_EXTENSION 0x80 /end CHARACTERISTIC
/begin CHARACTERISTIC CtApImageProcess_FreeRunning.PpDR_Merges_10ms.DeDR_List.DR_List[34].delta_x "" VALUE 0x2550c18 __FLOAT32_IEEE_S 0 NO_COMPU_METHOD 0 3.402823e+38 ECU_ADDRESS_EXTENSION 0x80 /end CHARACTERISTIC
/begin CHARACTERISTIC CtApImageProcess_FreeRunning.PpDR_Merges_10ms.DeDR_List.DR_List[34].delta_y "" VALUE 0x2550c1c __FLOAT32_IEEE_S 0 NO_COMPU_METHOD 0 3.402823e+38 ECU_ADDRESS_EXTENSION 0x80 /end CHARACTERISTIC
/begin CHARACTERISTIC CtApImageProcess_FreeRunning.PpDR_Merges_10ms.DeDR_List.DR_List[34].delta_z "" VALUE 0x2550c20 __FLOAT32_IEEE_S 0 NO_COMPU_METHOD 0 3.402823e+38 ECU_ADDRESS_EXTENSION 0x80 /end CHARACTERISTIC
/begin CHARACTERISTIC CtApImageProcess_FreeRunning.PpDR_Merges_10ms.DeDR_List.DR_List[34].delta_yaw "" VALUE 0x2550c24 __FLOAT32_IEEE_S 0 NO_COMPU_METHOD 0 3.402823e+38 ECU_ADDRESS_EXTENSION 0x80 /end CHARACTERISTIC
/begin CHARACTERISTIC CtApImageProcess_FreeRunning.PpDR_Merges_10ms.DeDR_List.DR_List[34].belif "" VALUE 0x2550c28 __FLOAT32_IEEE_S 0 NO_COMPU_METHOD 0 3.402823e+38 ECU_ADDRESS_EXTENSION 0x80 /end CHARACTERISTIC
/begin CHARACTERISTIC CtApImageProcess_FreeRunning.PpDR_Merges_10ms.DeDR_List.DR_List[34].reserved_int "5 uint32 array" VAL_BLK 0x2550c2c __ULONG_S 0 NO_COMPU_METHOD 0 4294967295 ECU_ADDRESS_EXTENSION 0x80 MATRIX_DIM 5 1 1 /end CHARACTERISTIC
/begin CHARACTERISTIC CtApImageProcess_FreeRunning.PpDR_Merges_10ms.DeDR_List.DR_List[35].stHeader.Counter "" VALUE 0x2550c40 __UWORD_S 0 NO_COMPU_METHOD 0 65535 ECU_ADDRESS_EXTENSION 0x80 /end CHARACTERISTIC
/begin CHARACTERISTIC CtApImageProcess_FreeRunning.PpDR_Merges_10ms.DeDR_List.DR_List[35].stHeader.FrameID "" VALUE 0x2550c42 __UBYTE_S 0 NO_COMPU_METHOD 0 255 ECU_ADDRESS_EXTENSION 0x80 /end CHARACTERISTIC
/begin CHARACTERISTIC CtApImageProcess_FreeRunning.PpDR_Merges_10ms.DeDR_List.DR_List[35].stHeader.TimeStamp "2 uint32 array" VAL_BLK 0x2550c44 __ULONG_S 0 NO_COMPU_METHOD 0 4294967295 ECU_ADDRESS_EXTENSION 0x80 MATRIX_DIM 2 1 1 /end CHARACTERISTIC
/begin CHARACTERISTIC CtApImageProcess_FreeRunning.PpDR_Merges_10ms.DeDR_List.DR_List[35].count "" VALUE 0x2550c4c __UBYTE_S 0 NO_COMPU_METHOD 0 255 ECU_ADDRESS_EXTENSION 0x80 /end CHARACTERISTIC
/begin CHARACTERISTIC CtApImageProcess_FreeRunning.PpDR_Merges_10ms.DeDR_List.DR_List[35].time_sec "" VALUE 0x2550c50 __FLOAT64_IEEE_S 0 NO_COMPU_METHOD 0 3.402823e+38 ECU_ADDRESS_EXTENSION 0x80 /end CHARACTERISTIC
/begin CHARACTERISTIC CtApImageProcess_FreeRunning.PpDR_Merges_10ms.DeDR_List.DR_List[35].utm_x "" VALUE 0x2550c58 __FLOAT64_IEEE_S 0 NO_COMPU_METHOD 0 3.402823e+38 ECU_ADDRESS_EXTENSION 0x80 /end CHARACTERISTIC
/begin CHARACTERISTIC CtApImageProcess_FreeRunning.PpDR_Merges_10ms.DeDR_List.DR_List[35].utm_y "" VALUE 0x2550c60 __FLOAT64_IEEE_S 0 NO_COMPU_METHOD 0 3.402823e+38 ECU_ADDRESS_EXTENSION 0x80 /end CHARACTERISTIC
/begin CHARACTERISTIC CtApImageProcess_FreeRunning.PpDR_Merges_10ms.DeDR_List.DR_List[35].utm_z "" VALUE 0x2550c68 __FLOAT32_IEEE_S 0 NO_COMPU_METHOD 0 3.402823e+38 ECU_ADDRESS_EXTENSION 0x80 /end CHARACTERISTIC
/begin CHARACTERISTIC CtApImageProcess_FreeRunning.PpDR_Merges_10ms.DeDR_List.DR_List[35].heading "" VALUE 0x2550c6c __FLOAT32_IEEE_S 0 NO_COMPU_METHOD 0 3.402823e+38 ECU_ADDRESS_EXTENSION 0x80 /end CHARACTERISTIC
/begin CHARACTERISTIC CtApImageProcess_FreeRunning.PpDR_Merges_10ms.DeDR_List.DR_List[35].delta_x "" VALUE 0x2550c70 __FLOAT32_IEEE_S 0 NO_COMPU_METHOD 0 3.402823e+38 ECU_ADDRESS_EXTENSION 0x80 /end CHARACTERISTIC
/begin CHARACTERISTIC CtApImageProcess_FreeRunning.PpDR_Merges_10ms.DeDR_List.DR_List[35].delta_y "" VALUE 0x2550c74 __FLOAT32_IEEE_S 0 NO_COMPU_METHOD 0 3.402823e+38 ECU_ADDRESS_EXTENSION 0x80 /end CHARACTERISTIC
/begin CHARACTERISTIC CtApImageProcess_FreeRunning.PpDR_Merges_10ms.DeDR_List.DR_List[35].delta_z "" VALUE 0x2550c78 __FLOAT32_IEEE_S 0 NO_COMPU_METHOD 0 3.402823e+38 ECU_ADDRESS_EXTENSION 0x80 /end CHARACTERISTIC
/begin CHARACTERISTIC CtApImageProcess_FreeRunning.PpDR_Merges_10ms.DeDR_List.DR_List[35].delta_yaw "" VALUE 0x2550c7c __FLOAT32_IEEE_S 0 NO_COMPU_METHOD 0 3.402823e+38 ECU_ADDRESS_EXTENSION 0x80 /end CHARACTERISTIC
/begin CHARACTERISTIC CtApImageProcess_FreeRunning.PpDR_Merges_10ms.DeDR_List.DR_List[35].belif "" VALUE 0x2550c80 __FLOAT32_IEEE_S 0 NO_COMPU_METHOD 0 3.402823e+38 ECU_ADDRESS_EXTENSION 0x80 /end CHARACTERISTIC
/begin CHARACTERISTIC CtApImageProcess_FreeRunning.PpDR_Merges_10ms.DeDR_List.DR_List[35].reserved_int "5 uint32 array" VAL_BLK 0x2550c84 __ULONG_S 0 NO_COMPU_METHOD 0 4294967295 ECU_ADDRESS_EXTENSION 0x80 MATRIX_DIM 5 1 1 /end CHARACTERISTIC
/begin CHARACTERISTIC CtApImageProcess_FreeRunning.PpDR_Merges_10ms.DeDR_List.DR_List[36].stHeader.Counter "" VALUE 0x2550c98 __UWORD_S 0 NO_COMPU_METHOD 0 65535 ECU_ADDRESS_EXTENSION 0x80 /end CHARACTERISTIC
/begin CHARACTERISTIC CtApImageProcess_FreeRunning.PpDR_Merges_10ms.DeDR_List.DR_List[36].stHeader.FrameID "" VALUE 0x2550c9a __UBYTE_S 0 NO_COMPU_METHOD 0 255 ECU_ADDRESS_EXTENSION 0x80 /end CHARACTERISTIC
/begin CHARACTERISTIC CtApImageProcess_FreeRunning.PpDR_Merges_10ms.DeDR_List.DR_List[36].stHeader.TimeStamp "2 uint32 array" VAL_BLK 0x2550c9c __ULONG_S 0 NO_COMPU_METHOD 0 4294967295 ECU_ADDRESS_EXTENSION 0x80 MATRIX_DIM 2 1 1 /end CHARACTERISTIC
/begin CHARACTERISTIC CtApImageProcess_FreeRunning.PpDR_Merges_10ms.DeDR_List.DR_List[36].count "" VALUE 0x2550ca4 __UBYTE_S 0 NO_COMPU_METHOD 0 255 ECU_ADDRESS_EXTENSION 0x80 /end CHARACTERISTIC
/begin CHARACTERISTIC CtApImageProcess_FreeRunning.PpDR_Merges_10ms.DeDR_List.DR_List[36].time_sec "" VALUE 0x2550ca8 __FLOAT64_IEEE_S 0 NO_COMPU_METHOD 0 3.402823e+38 ECU_ADDRESS_EXTENSION 0x80 /end CHARACTERISTIC
/begin CHARACTERISTIC CtApImageProcess_FreeRunning.PpDR_Merges_10ms.DeDR_List.DR_List[36].utm_x "" VALUE 0x2550cb0 __FLOAT64_IEEE_S 0 NO_COMPU_METHOD 0 3.402823e+38 ECU_ADDRESS_EXTENSION 0x80 /end CHARACTERISTIC
/begin CHARACTERISTIC CtApImageProcess_FreeRunning.PpDR_Merges_10ms.DeDR_List.DR_List[36].utm_y "" VALUE 0x2550cb8 __FLOAT64_IEEE_S 0 NO_COMPU_METHOD 0 3.402823e+38 ECU_ADDRESS_EXTENSION 0x80 /end CHARACTERISTIC
/begin CHARACTERISTIC CtApImageProcess_FreeRunning.PpDR_Merges_10ms.DeDR_List.DR_List[36].utm_z "" VALUE 0x2550cc0 __FLOAT32_IEEE_S 0 NO_COMPU_METHOD 0 3.402823e+38 ECU_ADDRESS_EXTENSION 0x80 /end CHARACTERISTIC
/begin CHARACTERISTIC CtApImageProcess_FreeRunning.PpDR_Merges_10ms.DeDR_List.DR_List[36].heading "" VALUE 0x2550cc4 __FLOAT32_IEEE_S 0 NO_COMPU_METHOD 0 3.402823e+38 ECU_ADDRESS_EXTENSION 0x80 /end CHARACTERISTIC
/begin CHARACTERISTIC CtApImageProcess_FreeRunning.PpDR_Merges_10ms.DeDR_List.DR_List[36].delta_x "" VALUE 0x2550cc8 __FLOAT32_IEEE_S 0 NO_COMPU_METHOD 0 3.402823e+38 ECU_ADDRESS_EXTENSION 0x80 /end CHARACTERISTIC
/begin CHARACTERISTIC CtApImageProcess_FreeRunning.PpDR_Merges_10ms.DeDR_List.DR_List[36].delta_y "" VALUE 0x2550ccc __FLOAT32_IEEE_S 0 NO_COMPU_METHOD 0 3.402823e+38 ECU_ADDRESS_EXTENSION 0x80 /end CHARACTERISTIC
/begin CHARACTERISTIC CtApImageProcess_FreeRunning.PpDR_Merges_10ms.DeDR_List.DR_List[36].delta_z "" VALUE 0x2550cd0 __FLOAT32_IEEE_S 0 NO_COMPU_METHOD 0 3.402823e+38 ECU_ADDRESS_EXTENSION 0x80 /end CHARACTERISTIC
/begin CHARACTERISTIC CtApImageProcess_FreeRunning.PpDR_Merges_10ms.DeDR_List.DR_List[36].delta_yaw "" VALUE 0x2550cd4 __FLOAT32_IEEE_S 0 NO_COMPU_METHOD 0 3.402823e+38 ECU_ADDRESS_EXTENSION 0x80 /end CHARACTERISTIC
/begin CHARACTERISTIC CtApImageProcess_FreeRunning.PpDR_Merges_10ms.DeDR_List.DR_List[36].belif "" VALUE 0x2550cd8 __FLOAT32_IEEE_S 0 NO_COMPU_METHOD 0 3.402823e+38 ECU_ADDRESS_EXTENSION 0x80 /end CHARACTERISTIC
/begin CHARACTERISTIC CtApImageProcess_FreeRunning.PpDR_Merges_10ms.DeDR_List.DR_List[36].reserved_int "5 uint32 array" VAL_BLK 0x2550cdc __ULONG_S 0 NO_COMPU_METHOD 0 4294967295 ECU_ADDRESS_EXTENSION 0x80 MATRIX_DIM 5 1 1 /end CHARACTERISTIC
/begin CHARACTERISTIC CtApImageProcess_FreeRunning.PpDR_Merges_10ms.DeDR_List.DR_List[37].stHeader.Counter "" VALUE 0x2550cf0 __UWORD_S 0 NO_COMPU_METHOD 0 65535 ECU_ADDRESS_EXTENSION 0x80 /end CHARACTERISTIC
/begin CHARACTERISTIC CtApImageProcess_FreeRunning.PpDR_Merges_10ms.DeDR_List.DR_List[37].stHeader.FrameID "" VALUE 0x2550cf2 __UBYTE_S 0 NO_COMPU_METHOD 0 255 ECU_ADDRESS_EXTENSION 0x80 /end CHARACTERISTIC
/begin CHARACTERISTIC CtApImageProcess_FreeRunning.PpDR_Merges_10ms.DeDR_List.DR_List[37].stHeader.TimeStamp "2 uint32 array" VAL_BLK 0x2550cf4 __ULONG_S 0 NO_COMPU_METHOD 0 4294967295 ECU_ADDRESS_EXTENSION 0x80 MATRIX_DIM 2 1 1 /end CHARACTERISTIC
/begin CHARACTERISTIC CtApImageProcess_FreeRunning.PpDR_Merges_10ms.DeDR_List.DR_List[37].count "" VALUE 0x2550cfc __UBYTE_S 0 NO_COMPU_METHOD 0 255 ECU_ADDRESS_EXTENSION 0x80 /end CHARACTERISTIC
/begin CHARACTERISTIC CtApImageProcess_FreeRunning.PpDR_Merges_10ms.DeDR_List.DR_List[37].time_sec "" VALUE 0x2550d00 __FLOAT64_IEEE_S 0 NO_COMPU_METHOD 0 3.402823e+38 ECU_ADDRESS_EXTENSION 0x80 /end CHARACTERISTIC
/begin CHARACTERISTIC CtApImageProcess_FreeRunning.PpDR_Merges_10ms.DeDR_List.DR_List[37].utm_x "" VALUE 0x2550d08 __FLOAT64_IEEE_S 0 NO_COMPU_METHOD 0 3.402823e+38 ECU_ADDRESS_EXTENSION 0x80 /end CHARACTERISTIC
/begin CHARACTERISTIC CtApImageProcess_FreeRunning.PpDR_Merges_10ms.DeDR_List.DR_List[37].utm_y "" VALUE 0x2550d10 __FLOAT64_IEEE_S 0 NO_COMPU_METHOD 0 3.402823e+38 ECU_ADDRESS_EXTENSION 0x80 /end CHARACTERISTIC
/begin CHARACTERISTIC CtApImageProcess_FreeRunning.PpDR_Merges_10ms.DeDR_List.DR_List[37].utm_z "" VALUE 0x2550d18 __FLOAT32_IEEE_S 0 NO_COMPU_METHOD 0 3.402823e+38 ECU_ADDRESS_EXTENSION 0x80 /end CHARACTERISTIC
/begin CHARACTERISTIC CtApImageProcess_FreeRunning.PpDR_Merges_10ms.DeDR_List.DR_List[37].heading "" VALUE 0x2550d1c __FLOAT32_IEEE_S 0 NO_COMPU_METHOD 0 3.402823e+38 ECU_ADDRESS_EXTENSION 0x80 /end CHARACTERISTIC
/begin CHARACTERISTIC CtApImageProcess_FreeRunning.PpDR_Merges_10ms.DeDR_List.DR_List[37].delta_x "" VALUE 0x2550d20 __FLOAT32_IEEE_S 0 NO_COMPU_METHOD 0 3.402823e+38 ECU_ADDRESS_EXTENSION 0x80 /end CHARACTERISTIC
/begin CHARACTERISTIC CtApImageProcess_FreeRunning.PpDR_Merges_10ms.DeDR_List.DR_List[37].delta_y "" VALUE 0x2550d24 __FLOAT32_IEEE_S 0 NO_COMPU_METHOD 0 3.402823e+38 ECU_ADDRESS_EXTENSION 0x80 /end CHARACTERISTIC
/begin CHARACTERISTIC CtApImageProcess_FreeRunning.PpDR_Merges_10ms.DeDR_List.DR_List[37].delta_z "" VALUE 0x2550d28 __FLOAT32_IEEE_S 0 NO_COMPU_METHOD 0 3.402823e+38 ECU_ADDRESS_EXTENSION 0x80 /end CHARACTERISTIC
/begin CHARACTERISTIC CtApImageProcess_FreeRunning.PpDR_Merges_10ms.DeDR_List.DR_List[37].delta_yaw "" VALUE 0x2550d2c __FLOAT32_IEEE_S 0 NO_COMPU_METHOD 0 3.402823e+38 ECU_ADDRESS_EXTENSION 0x80 /end CHARACTERISTIC
/begin CHARACTERISTIC CtApImageProcess_FreeRunning.PpDR_Merges_10ms.DeDR_List.DR_List[37].belif "" VALUE 0x2550d30 __FLOAT32_IEEE_S 0 NO_COMPU_METHOD 0 3.402823e+38 ECU_ADDRESS_EXTENSION 0x80 /end CHARACTERISTIC
/begin CHARACTERISTIC CtApImageProcess_FreeRunning.PpDR_Merges_10ms.DeDR_List.DR_List[37].reserved_int "5 uint32 array" VAL_BLK 0x2550d34 __ULONG_S 0 NO_COMPU_METHOD 0 4294967295 ECU_ADDRESS_EXTENSION 0x80 MATRIX_DIM 5 1 1 /end CHARACTERISTIC
/begin CHARACTERISTIC CtApImageProcess_FreeRunning.PpDR_Merges_10ms.DeDR_List.DR_List[38].stHeader.Counter "" VALUE 0x2550d48 __UWORD_S 0 NO_COMPU_METHOD 0 65535 ECU_ADDRESS_EXTENSION 0x80 /end CHARACTERISTIC
/begin CHARACTERISTIC CtApImageProcess_FreeRunning.PpDR_Merges_10ms.DeDR_List.DR_List[38].stHeader.FrameID "" VALUE 0x2550d4a __UBYTE_S 0 NO_COMPU_METHOD 0 255 ECU_ADDRESS_EXTENSION 0x80 /end CHARACTERISTIC
/begin CHARACTERISTIC CtApImageProcess_FreeRunning.PpDR_Merges_10ms.DeDR_List.DR_List[38].stHeader.TimeStamp "2 uint32 array" VAL_BLK 0x2550d4c __ULONG_S 0 NO_COMPU_METHOD 0 4294967295 ECU_ADDRESS_EXTENSION 0x80 MATRIX_DIM 2 1 1 /end CHARACTERISTIC
/begin CHARACTERISTIC CtApImageProcess_FreeRunning.PpDR_Merges_10ms.DeDR_List.DR_List[38].count "" VALUE 0x2550d54 __UBYTE_S 0 NO_COMPU_METHOD 0 255 ECU_ADDRESS_EXTENSION 0x80 /end CHARACTERISTIC
/begin CHARACTERISTIC CtApImageProcess_FreeRunning.PpDR_Merges_10ms.DeDR_List.DR_List[38].time_sec "" VALUE 0x2550d58 __FLOAT64_IEEE_S 0 NO_COMPU_METHOD 0 3.402823e+38 ECU_ADDRESS_EXTENSION 0x80 /end CHARACTERISTIC
/begin CHARACTERISTIC CtApImageProcess_FreeRunning.PpDR_Merges_10ms.DeDR_List.DR_List[38].utm_x "" VALUE 0x2550d60 __FLOAT64_IEEE_S 0 NO_COMPU_METHOD 0 3.402823e+38 ECU_ADDRESS_EXTENSION 0x80 /end CHARACTERISTIC
/begin CHARACTERISTIC CtApImageProcess_FreeRunning.PpDR_Merges_10ms.DeDR_List.DR_List[38].utm_y "" VALUE 0x2550d68 __FLOAT64_IEEE_S 0 NO_COMPU_METHOD 0 3.402823e+38 ECU_ADDRESS_EXTENSION 0x80 /end CHARACTERISTIC
/begin CHARACTERISTIC CtApImageProcess_FreeRunning.PpDR_Merges_10ms.DeDR_List.DR_List[38].utm_z "" VALUE 0x2550d70 __FLOAT32_IEEE_S 0 NO_COMPU_METHOD 0 3.402823e+38 ECU_ADDRESS_EXTENSION 0x80 /end CHARACTERISTIC
/begin CHARACTERISTIC CtApImageProcess_FreeRunning.PpDR_Merges_10ms.DeDR_List.DR_List[38].heading "" VALUE 0x2550d74 __FLOAT32_IEEE_S 0 NO_COMPU_METHOD 0 3.402823e+38 ECU_ADDRESS_EXTENSION 0x80 /end CHARACTERISTIC
/begin CHARACTERISTIC CtApImageProcess_FreeRunning.PpDR_Merges_10ms.DeDR_List.DR_List[38].delta_x "" VALUE 0x2550d78 __FLOAT32_IEEE_S 0 NO_COMPU_METHOD 0 3.402823e+38 ECU_ADDRESS_EXTENSION 0x80 /end CHARACTERISTIC
/begin CHARACTERISTIC CtApImageProcess_FreeRunning.PpDR_Merges_10ms.DeDR_List.DR_List[38].delta_y "" VALUE 0x2550d7c __FLOAT32_IEEE_S 0 NO_COMPU_METHOD 0 3.402823e+38 ECU_ADDRESS_EXTENSION 0x80 /end CHARACTERISTIC
/begin CHARACTERISTIC CtApImageProcess_FreeRunning.PpDR_Merges_10ms.DeDR_List.DR_List[38].delta_z "" VALUE 0x2550d80 __FLOAT32_IEEE_S 0 NO_COMPU_METHOD 0 3.402823e+38 ECU_ADDRESS_EXTENSION 0x80 /end CHARACTERISTIC
/begin CHARACTERISTIC CtApImageProcess_FreeRunning.PpDR_Merges_10ms.DeDR_List.DR_List[38].delta_yaw "" VALUE 0x2550d84 __FLOAT32_IEEE_S 0 NO_COMPU_METHOD 0 3.402823e+38 ECU_ADDRESS_EXTENSION 0x80 /end CHARACTERISTIC
/begin CHARACTERISTIC CtApImageProcess_FreeRunning.PpDR_Merges_10ms.DeDR_List.DR_List[38].belif "" VALUE 0x2550d88 __FLOAT32_IEEE_S 0 NO_COMPU_METHOD 0 3.402823e+38 ECU_ADDRESS_EXTENSION 0x80 /end CHARACTERISTIC
/begin CHARACTERISTIC CtApImageProcess_FreeRunning.PpDR_Merges_10ms.DeDR_List.DR_List[38].reserved_int "5 uint32 array" VAL_BLK 0x2550d8c __ULONG_S 0 NO_COMPU_METHOD 0 4294967295 ECU_ADDRESS_EXTENSION 0x80 MATRIX_DIM 5 1 1 /end CHARACTERISTIC
/begin CHARACTERISTIC CtApImageProcess_FreeRunning.PpDR_Merges_10ms.DeDR_List.DR_List[39].stHeader.Counter "" VALUE 0x2550da0 __UWORD_S 0 NO_COMPU_METHOD 0 65535 ECU_ADDRESS_EXTENSION 0x80 /end CHARACTERISTIC
/begin CHARACTERISTIC CtApImageProcess_FreeRunning.PpDR_Merges_10ms.DeDR_List.DR_List[39].stHeader.FrameID "" VALUE 0x2550da2 __UBYTE_S 0 NO_COMPU_METHOD 0 255 ECU_ADDRESS_EXTENSION 0x80 /end CHARACTERISTIC
/begin CHARACTERISTIC CtApImageProcess_FreeRunning.PpDR_Merges_10ms.DeDR_List.DR_List[39].stHeader.TimeStamp "2 uint32 array" VAL_BLK 0x2550da4 __ULONG_S 0 NO_COMPU_METHOD 0 4294967295 ECU_ADDRESS_EXTENSION 0x80 MATRIX_DIM 2 1 1 /end CHARACTERISTIC
/begin CHARACTERISTIC CtApImageProcess_FreeRunning.PpDR_Merges_10ms.DeDR_List.DR_List[39].count "" VALUE 0x2550dac __UBYTE_S 0 NO_COMPU_METHOD 0 255 ECU_ADDRESS_EXTENSION 0x80 /end CHARACTERISTIC
/begin CHARACTERISTIC CtApImageProcess_FreeRunning.PpDR_Merges_10ms.DeDR_List.DR_List[39].time_sec "" VALUE 0x2550db0 __FLOAT64_IEEE_S 0 NO_COMPU_METHOD 0 3.402823e+38 ECU_ADDRESS_EXTENSION 0x80 /end CHARACTERISTIC
/begin CHARACTERISTIC CtApImageProcess_FreeRunning.PpDR_Merges_10ms.DeDR_List.DR_List[39].utm_x "" VALUE 0x2550db8 __FLOAT64_IEEE_S 0 NO_COMPU_METHOD 0 3.402823e+38 ECU_ADDRESS_EXTENSION 0x80 /end CHARACTERISTIC
/begin CHARACTERISTIC CtApImageProcess_FreeRunning.PpDR_Merges_10ms.DeDR_List.DR_List[39].utm_y "" VALUE 0x2550dc0 __FLOAT64_IEEE_S 0 NO_COMPU_METHOD 0 3.402823e+38 ECU_ADDRESS_EXTENSION 0x80 /end CHARACTERISTIC
/begin CHARACTERISTIC CtApImageProcess_FreeRunning.PpDR_Merges_10ms.DeDR_List.DR_List[39].utm_z "" VALUE 0x2550dc8 __FLOAT32_IEEE_S 0 NO_COMPU_METHOD 0 3.402823e+38 ECU_ADDRESS_EXTENSION 0x80 /end CHARACTERISTIC
/begin CHARACTERISTIC CtApImageProcess_FreeRunning.PpDR_Merges_10ms.DeDR_List.DR_List[39].heading "" VALUE 0x2550dcc __FLOAT32_IEEE_S 0 NO_COMPU_METHOD 0 3.402823e+38 ECU_ADDRESS_EXTENSION 0x80 /end CHARACTERISTIC
/begin CHARACTERISTIC CtApImageProcess_FreeRunning.PpDR_Merges_10ms.DeDR_List.DR_List[39].delta_x "" VALUE 0x2550dd0 __FLOAT32_IEEE_S 0 NO_COMPU_METHOD 0 3.402823e+38 ECU_ADDRESS_EXTENSION 0x80 /end CHARACTERISTIC
/begin CHARACTERISTIC CtApImageProcess_FreeRunning.PpDR_Merges_10ms.DeDR_List.DR_List[39].delta_y "" VALUE 0x2550dd4 __FLOAT32_IEEE_S 0 NO_COMPU_METHOD 0 3.402823e+38 ECU_ADDRESS_EXTENSION 0x80 /end CHARACTERISTIC
/begin CHARACTERISTIC CtApImageProcess_FreeRunning.PpDR_Merges_10ms.DeDR_List.DR_List[39].delta_z "" VALUE 0x2550dd8 __FLOAT32_IEEE_S 0 NO_COMPU_METHOD 0 3.402823e+38 ECU_ADDRESS_EXTENSION 0x80 /end CHARACTERISTIC
/begin CHARACTERISTIC CtApImageProcess_FreeRunning.PpDR_Merges_10ms.DeDR_List.DR_List[39].delta_yaw "" VALUE 0x2550ddc __FLOAT32_IEEE_S 0 NO_COMPU_METHOD 0 3.402823e+38 ECU_ADDRESS_EXTENSION 0x80 /end CHARACTERISTIC
/begin CHARACTERISTIC CtApImageProcess_FreeRunning.PpDR_Merges_10ms.DeDR_List.DR_List[39].belif "" VALUE 0x2550de0 __FLOAT32_IEEE_S 0 NO_COMPU_METHOD 0 3.402823e+38 ECU_ADDRESS_EXTENSION 0x80 /end CHARACTERISTIC
/begin CHARACTERISTIC CtApImageProcess_FreeRunning.PpDR_Merges_10ms.DeDR_List.DR_List[39].reserved_int "5 uint32 array" VAL_BLK 0x2550de4 __ULONG_S 0 NO_COMPU_METHOD 0 4294967295 ECU_ADDRESS_EXTENSION 0x80 MATRIX_DIM 5 1 1 /end CHARACTERISTIC
/begin CHARACTERISTIC CtApImageProcess_FreeRunning.PpDR_Merges_10ms.DeDR_List.DR_List[40].stHeader.Counter "" VALUE 0x2550df8 __UWORD_S 0 NO_COMPU_METHOD 0 65535 ECU_ADDRESS_EXTENSION 0x80 /end CHARACTERISTIC
/begin CHARACTERISTIC CtApImageProcess_FreeRunning.PpDR_Merges_10ms.DeDR_List.DR_List[40].stHeader.FrameID "" VALUE 0x2550dfa __UBYTE_S 0 NO_COMPU_METHOD 0 255 ECU_ADDRESS_EXTENSION 0x80 /end CHARACTERISTIC
/begin CHARACTERISTIC CtApImageProcess_FreeRunning.PpDR_Merges_10ms.DeDR_List.DR_List[40].stHeader.TimeStamp "2 uint32 array" VAL_BLK 0x2550dfc __ULONG_S 0 NO_COMPU_METHOD 0 4294967295 ECU_ADDRESS_EXTENSION 0x80 MATRIX_DIM 2 1 1 /end CHARACTERISTIC
/begin CHARACTERISTIC CtApImageProcess_FreeRunning.PpDR_Merges_10ms.DeDR_List.DR_List[40].count "" VALUE 0x2550e04 __UBYTE_S 0 NO_COMPU_METHOD 0 255 ECU_ADDRESS_EXTENSION 0x80 /end CHARACTERISTIC
/begin CHARACTERISTIC CtApImageProcess_FreeRunning.PpDR_Merges_10ms.DeDR_List.DR_List[40].time_sec "" VALUE 0x2550e08 __FLOAT64_IEEE_S 0 NO_COMPU_METHOD 0 3.402823e+38 ECU_ADDRESS_EXTENSION 0x80 /end CHARACTERISTIC
/begin CHARACTERISTIC CtApImageProcess_FreeRunning.PpDR_Merges_10ms.DeDR_List.DR_List[40].utm_x "" VALUE 0x2550e10 __FLOAT64_IEEE_S 0 NO_COMPU_METHOD 0 3.402823e+38 ECU_ADDRESS_EXTENSION 0x80 /end CHARACTERISTIC
/begin CHARACTERISTIC CtApImageProcess_FreeRunning.PpDR_Merges_10ms.DeDR_List.DR_List[40].utm_y "" VALUE 0x2550e18 __FLOAT64_IEEE_S 0 NO_COMPU_METHOD 0 3.402823e+38 ECU_ADDRESS_EXTENSION 0x80 /end CHARACTERISTIC
/begin CHARACTERISTIC CtApImageProcess_FreeRunning.PpDR_Merges_10ms.DeDR_List.DR_List[40].utm_z "" VALUE 0x2550e20 __FLOAT32_IEEE_S 0 NO_COMPU_METHOD 0 3.402823e+38 ECU_ADDRESS_EXTENSION 0x80 /end CHARACTERISTIC
/begin CHARACTERISTIC CtApImageProcess_FreeRunning.PpDR_Merges_10ms.DeDR_List.DR_List[40].heading "" VALUE 0x2550e24 __FLOAT32_IEEE_S 0 NO_COMPU_METHOD 0 3.402823e+38 ECU_ADDRESS_EXTENSION 0x80 /end CHARACTERISTIC
/begin CHARACTERISTIC CtApImageProcess_FreeRunning.PpDR_Merges_10ms.DeDR_List.DR_List[40].delta_x "" VALUE 0x2550e28 __FLOAT32_IEEE_S 0 NO_COMPU_METHOD 0 3.402823e+38 ECU_ADDRESS_EXTENSION 0x80 /end CHARACTERISTIC
/begin CHARACTERISTIC CtApImageProcess_FreeRunning.PpDR_Merges_10ms.DeDR_List.DR_List[40].delta_y "" VALUE 0x2550e2c __FLOAT32_IEEE_S 0 NO_COMPU_METHOD 0 3.402823e+38 ECU_ADDRESS_EXTENSION 0x80 /end CHARACTERISTIC
/begin CHARACTERISTIC CtApImageProcess_FreeRunning.PpDR_Merges_10ms.DeDR_List.DR_List[40].delta_z "" VALUE 0x2550e30 __FLOAT32_IEEE_S 0 NO_COMPU_METHOD 0 3.402823e+38 ECU_ADDRESS_EXTENSION 0x80 /end CHARACTERISTIC
/begin CHARACTERISTIC CtApImageProcess_FreeRunning.PpDR_Merges_10ms.DeDR_List.DR_List[40].delta_yaw "" VALUE 0x2550e34 __FLOAT32_IEEE_S 0 NO_COMPU_METHOD 0 3.402823e+38 ECU_ADDRESS_EXTENSION 0x80 /end CHARACTERISTIC
/begin CHARACTERISTIC CtApImageProcess_FreeRunning.PpDR_Merges_10ms.DeDR_List.DR_List[40].belif "" VALUE 0x2550e38 __FLOAT32_IEEE_S 0 NO_COMPU_METHOD 0 3.402823e+38 ECU_ADDRESS_EXTENSION 0x80 /end CHARACTERISTIC
/begin CHARACTERISTIC CtApImageProcess_FreeRunning.PpDR_Merges_10ms.DeDR_List.DR_List[40].reserved_int "5 uint32 array" VAL_BLK 0x2550e3c __ULONG_S 0 NO_COMPU_METHOD 0 4294967295 ECU_ADDRESS_EXTENSION 0x80 MATRIX_DIM 5 1 1 /end CHARACTERISTIC
/begin CHARACTERISTIC CtApImageProcess_FreeRunning.PpDR_Merges_10ms.DeDR_List.DR_List[41].stHeader.Counter "" VALUE 0x2550e50 __UWORD_S 0 NO_COMPU_METHOD 0 65535 ECU_ADDRESS_EXTENSION 0x80 /end CHARACTERISTIC
/begin CHARACTERISTIC CtApImageProcess_FreeRunning.PpDR_Merges_10ms.DeDR_List.DR_List[41].stHeader.FrameID "" VALUE 0x2550e52 __UBYTE_S 0 NO_COMPU_METHOD 0 255 ECU_ADDRESS_EXTENSION 0x80 /end CHARACTERISTIC
/begin CHARACTERISTIC CtApImageProcess_FreeRunning.PpDR_Merges_10ms.DeDR_List.DR_List[41].stHeader.TimeStamp "2 uint32 array" VAL_BLK 0x2550e54 __ULONG_S 0 NO_COMPU_METHOD 0 4294967295 ECU_ADDRESS_EXTENSION 0x80 MATRIX_DIM 2 1 1 /end CHARACTERISTIC
/begin CHARACTERISTIC CtApImageProcess_FreeRunning.PpDR_Merges_10ms.DeDR_List.DR_List[41].count "" VALUE 0x2550e5c __UBYTE_S 0 NO_COMPU_METHOD 0 255 ECU_ADDRESS_EXTENSION 0x80 /end CHARACTERISTIC
/begin CHARACTERISTIC CtApImageProcess_FreeRunning.PpDR_Merges_10ms.DeDR_List.DR_List[41].time_sec "" VALUE 0x2550e60 __FLOAT64_IEEE_S 0 NO_COMPU_METHOD 0 3.402823e+38 ECU_ADDRESS_EXTENSION 0x80 /end CHARACTERISTIC
/begin CHARACTERISTIC CtApImageProcess_FreeRunning.PpDR_Merges_10ms.DeDR_List.DR_List[41].utm_x "" VALUE 0x2550e68 __FLOAT64_IEEE_S 0 NO_COMPU_METHOD 0 3.402823e+38 ECU_ADDRESS_EXTENSION 0x80 /end CHARACTERISTIC
/begin CHARACTERISTIC CtApImageProcess_FreeRunning.PpDR_Merges_10ms.DeDR_List.DR_List[41].utm_y "" VALUE 0x2550e70 __FLOAT64_IEEE_S 0 NO_COMPU_METHOD 0 3.402823e+38 ECU_ADDRESS_EXTENSION 0x80 /end CHARACTERISTIC
/begin CHARACTERISTIC CtApImageProcess_FreeRunning.PpDR_Merges_10ms.DeDR_List.DR_List[41].utm_z "" VALUE 0x2550e78 __FLOAT32_IEEE_S 0 NO_COMPU_METHOD 0 3.402823e+38 ECU_ADDRESS_EXTENSION 0x80 /end CHARACTERISTIC
/begin CHARACTERISTIC CtApImageProcess_FreeRunning.PpDR_Merges_10ms.DeDR_List.DR_List[41].heading "" VALUE 0x2550e7c __FLOAT32_IEEE_S 0 NO_COMPU_METHOD 0 3.402823e+38 ECU_ADDRESS_EXTENSION 0x80 /end CHARACTERISTIC
/begin CHARACTERISTIC CtApImageProcess_FreeRunning.PpDR_Merges_10ms.DeDR_List.DR_List[41].delta_x "" VALUE 0x2550e80 __FLOAT32_IEEE_S 0 NO_COMPU_METHOD 0 3.402823e+38 ECU_ADDRESS_EXTENSION 0x80 /end CHARACTERISTIC
/begin CHARACTERISTIC CtApImageProcess_FreeRunning.PpDR_Merges_10ms.DeDR_List.DR_List[41].delta_y "" VALUE 0x2550e84 __FLOAT32_IEEE_S 0 NO_COMPU_METHOD 0 3.402823e+38 ECU_ADDRESS_EXTENSION 0x80 /end CHARACTERISTIC
/begin CHARACTERISTIC CtApImageProcess_FreeRunning.PpDR_Merges_10ms.DeDR_List.DR_List[41].delta_z "" VALUE 0x2550e88 __FLOAT32_IEEE_S 0 NO_COMPU_METHOD 0 3.402823e+38 ECU_ADDRESS_EXTENSION 0x80 /end CHARACTERISTIC
/begin CHARACTERISTIC CtApImageProcess_FreeRunning.PpDR_Merges_10ms.DeDR_List.DR_List[41].delta_yaw "" VALUE 0x2550e8c __FLOAT32_IEEE_S 0 NO_COMPU_METHOD 0 3.402823e+38 ECU_ADDRESS_EXTENSION 0x80 /end CHARACTERISTIC
/begin CHARACTERISTIC CtApImageProcess_FreeRunning.PpDR_Merges_10ms.DeDR_List.DR_List[41].belif "" VALUE 0x2550e90 __FLOAT32_IEEE_S 0 NO_COMPU_METHOD 0 3.402823e+38 ECU_ADDRESS_EXTENSION 0x80 /end CHARACTERISTIC
/begin CHARACTERISTIC CtApImageProcess_FreeRunning.PpDR_Merges_10ms.DeDR_List.DR_List[41].reserved_int "5 uint32 array" VAL_BLK 0x2550e94 __ULONG_S 0 NO_COMPU_METHOD 0 4294967295 ECU_ADDRESS_EXTENSION 0x80 MATRIX_DIM 5 1 1 /end CHARACTERISTIC
/begin CHARACTERISTIC CtApImageProcess_FreeRunning.PpDR_Merges_10ms.DeDR_List.DR_List[42].stHeader.Counter "" VALUE 0x2550ea8 __UWORD_S 0 NO_COMPU_METHOD 0 65535 ECU_ADDRESS_EXTENSION 0x80 /end CHARACTERISTIC
/begin CHARACTERISTIC CtApImageProcess_FreeRunning.PpDR_Merges_10ms.DeDR_List.DR_List[42].stHeader.FrameID "" VALUE 0x2550eaa __UBYTE_S 0 NO_COMPU_METHOD 0 255 ECU_ADDRESS_EXTENSION 0x80 /end CHARACTERISTIC
/begin CHARACTERISTIC CtApImageProcess_FreeRunning.PpDR_Merges_10ms.DeDR_List.DR_List[42].stHeader.TimeStamp "2 uint32 array" VAL_BLK 0x2550eac __ULONG_S 0 NO_COMPU_METHOD 0 4294967295 ECU_ADDRESS_EXTENSION 0x80 MATRIX_DIM 2 1 1 /end CHARACTERISTIC
/begin CHARACTERISTIC CtApImageProcess_FreeRunning.PpDR_Merges_10ms.DeDR_List.DR_List[42].count "" VALUE 0x2550eb4 __UBYTE_S 0 NO_COMPU_METHOD 0 255 ECU_ADDRESS_EXTENSION 0x80 /end CHARACTERISTIC
/begin CHARACTERISTIC CtApImageProcess_FreeRunning.PpDR_Merges_10ms.DeDR_List.DR_List[42].time_sec "" VALUE 0x2550eb8 __FLOAT64_IEEE_S 0 NO_COMPU_METHOD 0 3.402823e+38 ECU_ADDRESS_EXTENSION 0x80 /end CHARACTERISTIC
/begin CHARACTERISTIC CtApImageProcess_FreeRunning.PpDR_Merges_10ms.DeDR_List.DR_List[42].utm_x "" VALUE 0x2550ec0 __FLOAT64_IEEE_S 0 NO_COMPU_METHOD 0 3.402823e+38 ECU_ADDRESS_EXTENSION 0x80 /end CHARACTERISTIC
/begin CHARACTERISTIC CtApImageProcess_FreeRunning.PpDR_Merges_10ms.DeDR_List.DR_List[42].utm_y "" VALUE 0x2550ec8 __FLOAT64_IEEE_S 0 NO_COMPU_METHOD 0 3.402823e+38 ECU_ADDRESS_EXTENSION 0x80 /end CHARACTERISTIC
/begin CHARACTERISTIC CtApImageProcess_FreeRunning.PpDR_Merges_10ms.DeDR_List.DR_List[42].utm_z "" VALUE 0x2550ed0 __FLOAT32_IEEE_S 0 NO_COMPU_METHOD 0 3.402823e+38 ECU_ADDRESS_EXTENSION 0x80 /end CHARACTERISTIC
/begin CHARACTERISTIC CtApImageProcess_FreeRunning.PpDR_Merges_10ms.DeDR_List.DR_List[42].heading "" VALUE 0x2550ed4 __FLOAT32_IEEE_S 0 NO_COMPU_METHOD 0 3.402823e+38 ECU_ADDRESS_EXTENSION 0x80 /end CHARACTERISTIC
/begin CHARACTERISTIC CtApImageProcess_FreeRunning.PpDR_Merges_10ms.DeDR_List.DR_List[42].delta_x "" VALUE 0x2550ed8 __FLOAT32_IEEE_S 0 NO_COMPU_METHOD 0 3.402823e+38 ECU_ADDRESS_EXTENSION 0x80 /end CHARACTERISTIC
/begin CHARACTERISTIC CtApImageProcess_FreeRunning.PpDR_Merges_10ms.DeDR_List.DR_List[42].delta_y "" VALUE 0x2550edc __FLOAT32_IEEE_S 0 NO_COMPU_METHOD 0 3.402823e+38 ECU_ADDRESS_EXTENSION 0x80 /end CHARACTERISTIC
/begin CHARACTERISTIC CtApImageProcess_FreeRunning.PpDR_Merges_10ms.DeDR_List.DR_List[42].delta_z "" VALUE 0x2550ee0 __FLOAT32_IEEE_S 0 NO_COMPU_METHOD 0 3.402823e+38 ECU_ADDRESS_EXTENSION 0x80 /end CHARACTERISTIC
/begin CHARACTERISTIC CtApImageProcess_FreeRunning.PpDR_Merges_10ms.DeDR_List.DR_List[42].delta_yaw "" VALUE 0x2550ee4 __FLOAT32_IEEE_S 0 NO_COMPU_METHOD 0 3.402823e+38 ECU_ADDRESS_EXTENSION 0x80 /end CHARACTERISTIC
/begin CHARACTERISTIC CtApImageProcess_FreeRunning.PpDR_Merges_10ms.DeDR_List.DR_List[42].belif "" VALUE 0x2550ee8 __FLOAT32_IEEE_S 0 NO_COMPU_METHOD 0 3.402823e+38 ECU_ADDRESS_EXTENSION 0x80 /end CHARACTERISTIC
/begin CHARACTERISTIC CtApImageProcess_FreeRunning.PpDR_Merges_10ms.DeDR_List.DR_List[42].reserved_int "5 uint32 array" VAL_BLK 0x2550eec __ULONG_S 0 NO_COMPU_METHOD 0 4294967295 ECU_ADDRESS_EXTENSION 0x80 MATRIX_DIM 5 1 1 /end CHARACTERISTIC
/begin CHARACTERISTIC CtApImageProcess_FreeRunning.PpDR_Merges_10ms.DeDR_List.DR_List[43].stHeader.Counter "" VALUE 0x2550f00 __UWORD_S 0 NO_COMPU_METHOD 0 65535 ECU_ADDRESS_EXTENSION 0x80 /end CHARACTERISTIC
/begin CHARACTERISTIC CtApImageProcess_FreeRunning.PpDR_Merges_10ms.DeDR_List.DR_List[43].stHeader.FrameID "" VALUE 0x2550f02 __UBYTE_S 0 NO_COMPU_METHOD 0 255 ECU_ADDRESS_EXTENSION 0x80 /end CHARACTERISTIC
/begin CHARACTERISTIC CtApImageProcess_FreeRunning.PpDR_Merges_10ms.DeDR_List.DR_List[43].stHeader.TimeStamp "2 uint32 array" VAL_BLK 0x2550f04 __ULONG_S 0 NO_COMPU_METHOD 0 4294967295 ECU_ADDRESS_EXTENSION 0x80 MATRIX_DIM 2 1 1 /end CHARACTERISTIC
/begin CHARACTERISTIC CtApImageProcess_FreeRunning.PpDR_Merges_10ms.DeDR_List.DR_List[43].count "" VALUE 0x2550f0c __UBYTE_S 0 NO_COMPU_METHOD 0 255 ECU_ADDRESS_EXTENSION 0x80 /end CHARACTERISTIC
/begin CHARACTERISTIC CtApImageProcess_FreeRunning.PpDR_Merges_10ms.DeDR_List.DR_List[43].time_sec "" VALUE 0x2550f10 __FLOAT64_IEEE_S 0 NO_COMPU_METHOD 0 3.402823e+38 ECU_ADDRESS_EXTENSION 0x80 /end CHARACTERISTIC
/begin CHARACTERISTIC CtApImageProcess_FreeRunning.PpDR_Merges_10ms.DeDR_List.DR_List[43].utm_x "" VALUE 0x2550f18 __FLOAT64_IEEE_S 0 NO_COMPU_METHOD 0 3.402823e+38 ECU_ADDRESS_EXTENSION 0x80 /end CHARACTERISTIC
/begin CHARACTERISTIC CtApImageProcess_FreeRunning.PpDR_Merges_10ms.DeDR_List.DR_List[43].utm_y "" VALUE 0x2550f20 __FLOAT64_IEEE_S 0 NO_COMPU_METHOD 0 3.402823e+38 ECU_ADDRESS_EXTENSION 0x80 /end CHARACTERISTIC
/begin CHARACTERISTIC CtApImageProcess_FreeRunning.PpDR_Merges_10ms.DeDR_List.DR_List[43].utm_z "" VALUE 0x2550f28 __FLOAT32_IEEE_S 0 NO_COMPU_METHOD 0 3.402823e+38 ECU_ADDRESS_EXTENSION 0x80 /end CHARACTERISTIC
/begin CHARACTERISTIC CtApImageProcess_FreeRunning.PpDR_Merges_10ms.DeDR_List.DR_List[43].heading "" VALUE 0x2550f2c __FLOAT32_IEEE_S 0 NO_COMPU_METHOD 0 3.402823e+38 ECU_ADDRESS_EXTENSION 0x80 /end CHARACTERISTIC
/begin CHARACTERISTIC CtApImageProcess_FreeRunning.PpDR_Merges_10ms.DeDR_List.DR_List[43].delta_x "" VALUE 0x2550f30 __FLOAT32_IEEE_S 0 NO_COMPU_METHOD 0 3.402823e+38 ECU_ADDRESS_EXTENSION 0x80 /end CHARACTERISTIC
/begin CHARACTERISTIC CtApImageProcess_FreeRunning.PpDR_Merges_10ms.DeDR_List.DR_List[43].delta_y "" VALUE 0x2550f34 __FLOAT32_IEEE_S 0 NO_COMPU_METHOD 0 3.402823e+38 ECU_ADDRESS_EXTENSION 0x80 /end CHARACTERISTIC
/begin CHARACTERISTIC CtApImageProcess_FreeRunning.PpDR_Merges_10ms.DeDR_List.DR_List[43].delta_z "" VALUE 0x2550f38 __FLOAT32_IEEE_S 0 NO_COMPU_METHOD 0 3.402823e+38 ECU_ADDRESS_EXTENSION 0x80 /end CHARACTERISTIC
/begin CHARACTERISTIC CtApImageProcess_FreeRunning.PpDR_Merges_10ms.DeDR_List.DR_List[43].delta_yaw "" VALUE 0x2550f3c __FLOAT32_IEEE_S 0 NO_COMPU_METHOD 0 3.402823e+38 ECU_ADDRESS_EXTENSION 0x80 /end CHARACTERISTIC
/begin CHARACTERISTIC CtApImageProcess_FreeRunning.PpDR_Merges_10ms.DeDR_List.DR_List[43].belif "" VALUE 0x2550f40 __FLOAT32_IEEE_S 0 NO_COMPU_METHOD 0 3.402823e+38 ECU_ADDRESS_EXTENSION 0x80 /end CHARACTERISTIC
/begin CHARACTERISTIC CtApImageProcess_FreeRunning.PpDR_Merges_10ms.DeDR_List.DR_List[43].reserved_int "5 uint32 array" VAL_BLK 0x2550f44 __ULONG_S 0 NO_COMPU_METHOD 0 4294967295 ECU_ADDRESS_EXTENSION 0x80 MATRIX_DIM 5 1 1 /end CHARACTERISTIC
/begin CHARACTERISTIC CtApImageProcess_FreeRunning.PpDR_Merges_10ms.DeDR_List.DR_List[44].stHeader.Counter "" VALUE 0x2550f58 __UWORD_S 0 NO_COMPU_METHOD 0 65535 ECU_ADDRESS_EXTENSION 0x80 /end CHARACTERISTIC
/begin CHARACTERISTIC CtApImageProcess_FreeRunning.PpDR_Merges_10ms.DeDR_List.DR_List[44].stHeader.FrameID "" VALUE 0x2550f5a __UBYTE_S 0 NO_COMPU_METHOD 0 255 ECU_ADDRESS_EXTENSION 0x80 /end CHARACTERISTIC
/begin CHARACTERISTIC CtApImageProcess_FreeRunning.PpDR_Merges_10ms.DeDR_List.DR_List[44].stHeader.TimeStamp "2 uint32 array" VAL_BLK 0x2550f5c __ULONG_S 0 NO_COMPU_METHOD 0 4294967295 ECU_ADDRESS_EXTENSION 0x80 MATRIX_DIM 2 1 1 /end CHARACTERISTIC
/begin CHARACTERISTIC CtApImageProcess_FreeRunning.PpDR_Merges_10ms.DeDR_List.DR_List[44].count "" VALUE 0x2550f64 __UBYTE_S 0 NO_COMPU_METHOD 0 255 ECU_ADDRESS_EXTENSION 0x80 /end CHARACTERISTIC
/begin CHARACTERISTIC CtApImageProcess_FreeRunning.PpDR_Merges_10ms.DeDR_List.DR_List[44].time_sec "" VALUE 0x2550f68 __FLOAT64_IEEE_S 0 NO_COMPU_METHOD 0 3.402823e+38 ECU_ADDRESS_EXTENSION 0x80 /end CHARACTERISTIC
/begin CHARACTERISTIC CtApImageProcess_FreeRunning.PpDR_Merges_10ms.DeDR_List.DR_List[44].utm_x "" VALUE 0x2550f70 __FLOAT64_IEEE_S 0 NO_COMPU_METHOD 0 3.402823e+38 ECU_ADDRESS_EXTENSION 0x80 /end CHARACTERISTIC
/begin CHARACTERISTIC CtApImageProcess_FreeRunning.PpDR_Merges_10ms.DeDR_List.DR_List[44].utm_y "" VALUE 0x2550f78 __FLOAT64_IEEE_S 0 NO_COMPU_METHOD 0 3.402823e+38 ECU_ADDRESS_EXTENSION 0x80 /end CHARACTERISTIC
/begin CHARACTERISTIC CtApImageProcess_FreeRunning.PpDR_Merges_10ms.DeDR_List.DR_List[44].utm_z "" VALUE 0x2550f80 __FLOAT32_IEEE_S 0 NO_COMPU_METHOD 0 3.402823e+38 ECU_ADDRESS_EXTENSION 0x80 /end CHARACTERISTIC
/begin CHARACTERISTIC CtApImageProcess_FreeRunning.PpDR_Merges_10ms.DeDR_List.DR_List[44].heading "" VALUE 0x2550f84 __FLOAT32_IEEE_S 0 NO_COMPU_METHOD 0 3.402823e+38 ECU_ADDRESS_EXTENSION 0x80 /end CHARACTERISTIC
/begin CHARACTERISTIC CtApImageProcess_FreeRunning.PpDR_Merges_10ms.DeDR_List.DR_List[44].delta_x "" VALUE 0x2550f88 __FLOAT32_IEEE_S 0 NO_COMPU_METHOD 0 3.402823e+38 ECU_ADDRESS_EXTENSION 0x80 /end CHARACTERISTIC
/begin CHARACTERISTIC CtApImageProcess_FreeRunning.PpDR_Merges_10ms.DeDR_List.DR_List[44].delta_y "" VALUE 0x2550f8c __FLOAT32_IEEE_S 0 NO_COMPU_METHOD 0 3.402823e+38 ECU_ADDRESS_EXTENSION 0x80 /end CHARACTERISTIC
/begin CHARACTERISTIC CtApImageProcess_FreeRunning.PpDR_Merges_10ms.DeDR_List.DR_List[44].delta_z "" VALUE 0x2550f90 __FLOAT32_IEEE_S 0 NO_COMPU_METHOD 0 3.402823e+38 ECU_ADDRESS_EXTENSION 0x80 /end CHARACTERISTIC
/begin CHARACTERISTIC CtApImageProcess_FreeRunning.PpDR_Merges_10ms.DeDR_List.DR_List[44].delta_yaw "" VALUE 0x2550f94 __FLOAT32_IEEE_S 0 NO_COMPU_METHOD 0 3.402823e+38 ECU_ADDRESS_EXTENSION 0x80 /end CHARACTERISTIC
/begin CHARACTERISTIC CtApImageProcess_FreeRunning.PpDR_Merges_10ms.DeDR_List.DR_List[44].belif "" VALUE 0x2550f98 __FLOAT32_IEEE_S 0 NO_COMPU_METHOD 0 3.402823e+38 ECU_ADDRESS_EXTENSION 0x80 /end CHARACTERISTIC
/begin CHARACTERISTIC CtApImageProcess_FreeRunning.PpDR_Merges_10ms.DeDR_List.DR_List[44].reserved_int "5 uint32 array" VAL_BLK 0x2550f9c __ULONG_S 0 NO_COMPU_METHOD 0 4294967295 ECU_ADDRESS_EXTENSION 0x80 MATRIX_DIM 5 1 1 /end CHARACTERISTIC
/begin CHARACTERISTIC CtApImageProcess_FreeRunning.PpDR_Merges_10ms.DeDR_List.DR_List[45].stHeader.Counter "" VALUE 0x2550fb0 __UWORD_S 0 NO_COMPU_METHOD 0 65535 ECU_ADDRESS_EXTENSION 0x80 /end CHARACTERISTIC
/begin CHARACTERISTIC CtApImageProcess_FreeRunning.PpDR_Merges_10ms.DeDR_List.DR_List[45].stHeader.FrameID "" VALUE 0x2550fb2 __UBYTE_S 0 NO_COMPU_METHOD 0 255 ECU_ADDRESS_EXTENSION 0x80 /end CHARACTERISTIC
/begin CHARACTERISTIC CtApImageProcess_FreeRunning.PpDR_Merges_10ms.DeDR_List.DR_List[45].stHeader.TimeStamp "2 uint32 array" VAL_BLK 0x2550fb4 __ULONG_S 0 NO_COMPU_METHOD 0 4294967295 ECU_ADDRESS_EXTENSION 0x80 MATRIX_DIM 2 1 1 /end CHARACTERISTIC
/begin CHARACTERISTIC CtApImageProcess_FreeRunning.PpDR_Merges_10ms.DeDR_List.DR_List[45].count "" VALUE 0x2550fbc __UBYTE_S 0 NO_COMPU_METHOD 0 255 ECU_ADDRESS_EXTENSION 0x80 /end CHARACTERISTIC
/begin CHARACTERISTIC CtApImageProcess_FreeRunning.PpDR_Merges_10ms.DeDR_List.DR_List[45].time_sec "" VALUE 0x2550fc0 __FLOAT64_IEEE_S 0 NO_COMPU_METHOD 0 3.402823e+38 ECU_ADDRESS_EXTENSION 0x80 /end CHARACTERISTIC
/begin CHARACTERISTIC CtApImageProcess_FreeRunning.PpDR_Merges_10ms.DeDR_List.DR_List[45].utm_x "" VALUE 0x2550fc8 __FLOAT64_IEEE_S 0 NO_COMPU_METHOD 0 3.402823e+38 ECU_ADDRESS_EXTENSION 0x80 /end CHARACTERISTIC
/begin CHARACTERISTIC CtApImageProcess_FreeRunning.PpDR_Merges_10ms.DeDR_List.DR_List[45].utm_y "" VALUE 0x2550fd0 __FLOAT64_IEEE_S 0 NO_COMPU_METHOD 0 3.402823e+38 ECU_ADDRESS_EXTENSION 0x80 /end CHARACTERISTIC
/begin CHARACTERISTIC CtApImageProcess_FreeRunning.PpDR_Merges_10ms.DeDR_List.DR_List[45].utm_z "" VALUE 0x2550fd8 __FLOAT32_IEEE_S 0 NO_COMPU_METHOD 0 3.402823e+38 ECU_ADDRESS_EXTENSION 0x80 /end CHARACTERISTIC
/begin CHARACTERISTIC CtApImageProcess_FreeRunning.PpDR_Merges_10ms.DeDR_List.DR_List[45].heading "" VALUE 0x2550fdc __FLOAT32_IEEE_S 0 NO_COMPU_METHOD 0 3.402823e+38 ECU_ADDRESS_EXTENSION 0x80 /end CHARACTERISTIC
/begin CHARACTERISTIC CtApImageProcess_FreeRunning.PpDR_Merges_10ms.DeDR_List.DR_List[45].delta_x "" VALUE 0x2550fe0 __FLOAT32_IEEE_S 0 NO_COMPU_METHOD 0 3.402823e+38 ECU_ADDRESS_EXTENSION 0x80 /end CHARACTERISTIC
/begin CHARACTERISTIC CtApImageProcess_FreeRunning.PpDR_Merges_10ms.DeDR_List.DR_List[45].delta_y "" VALUE 0x2550fe4 __FLOAT32_IEEE_S 0 NO_COMPU_METHOD 0 3.402823e+38 ECU_ADDRESS_EXTENSION 0x80 /end CHARACTERISTIC
/begin CHARACTERISTIC CtApImageProcess_FreeRunning.PpDR_Merges_10ms.DeDR_List.DR_List[45].delta_z "" VALUE 0x2550fe8 __FLOAT32_IEEE_S 0 NO_COMPU_METHOD 0 3.402823e+38 ECU_ADDRESS_EXTENSION 0x80 /end CHARACTERISTIC
/begin CHARACTERISTIC CtApImageProcess_FreeRunning.PpDR_Merges_10ms.DeDR_List.DR_List[45].delta_yaw "" VALUE 0x2550fec __FLOAT32_IEEE_S 0 NO_COMPU_METHOD 0 3.402823e+38 ECU_ADDRESS_EXTENSION 0x80 /end CHARACTERISTIC
/begin CHARACTERISTIC CtApImageProcess_FreeRunning.PpDR_Merges_10ms.DeDR_List.DR_List[45].belif "" VALUE 0x2550ff0 __FLOAT32_IEEE_S 0 NO_COMPU_METHOD 0 3.402823e+38 ECU_ADDRESS_EXTENSION 0x80 /end CHARACTERISTIC
/begin CHARACTERISTIC CtApImageProcess_FreeRunning.PpDR_Merges_10ms.DeDR_List.DR_List[45].reserved_int "5 uint32 array" VAL_BLK 0x2550ff4 __ULONG_S 0 NO_COMPU_METHOD 0 4294967295 ECU_ADDRESS_EXTENSION 0x80 MATRIX_DIM 5 1 1 /end CHARACTERISTIC
/begin CHARACTERISTIC CtApImageProcess_FreeRunning.PpDR_Merges_10ms.DeDR_List.DR_List[46].stHeader.Counter "" VALUE 0x2551008 __UWORD_S 0 NO_COMPU_METHOD 0 65535 ECU_ADDRESS_EXTENSION 0x80 /end CHARACTERISTIC
/begin CHARACTERISTIC CtApImageProcess_FreeRunning.PpDR_Merges_10ms.DeDR_List.DR_List[46].stHeader.FrameID "" VALUE 0x255100a __UBYTE_S 0 NO_COMPU_METHOD 0 255 ECU_ADDRESS_EXTENSION 0x80 /end CHARACTERISTIC
/begin CHARACTERISTIC CtApImageProcess_FreeRunning.PpDR_Merges_10ms.DeDR_List.DR_List[46].stHeader.TimeStamp "2 uint32 array" VAL_BLK 0x255100c __ULONG_S 0 NO_COMPU_METHOD 0 4294967295 ECU_ADDRESS_EXTENSION 0x80 MATRIX_DIM 2 1 1 /end CHARACTERISTIC
/begin CHARACTERISTIC CtApImageProcess_FreeRunning.PpDR_Merges_10ms.DeDR_List.DR_List[46].count "" VALUE 0x2551014 __UBYTE_S 0 NO_COMPU_METHOD 0 255 ECU_ADDRESS_EXTENSION 0x80 /end CHARACTERISTIC
/begin CHARACTERISTIC CtApImageProcess_FreeRunning.PpDR_Merges_10ms.DeDR_List.DR_List[46].time_sec "" VALUE 0x2551018 __FLOAT64_IEEE_S 0 NO_COMPU_METHOD 0 3.402823e+38 ECU_ADDRESS_EXTENSION 0x80 /end CHARACTERISTIC
/begin CHARACTERISTIC CtApImageProcess_FreeRunning.PpDR_Merges_10ms.DeDR_List.DR_List[46].utm_x "" VALUE 0x2551020 __FLOAT64_IEEE_S 0 NO_COMPU_METHOD 0 3.402823e+38 ECU_ADDRESS_EXTENSION 0x80 /end CHARACTERISTIC
/begin CHARACTERISTIC CtApImageProcess_FreeRunning.PpDR_Merges_10ms.DeDR_List.DR_List[46].utm_y "" VALUE 0x2551028 __FLOAT64_IEEE_S 0 NO_COMPU_METHOD 0 3.402823e+38 ECU_ADDRESS_EXTENSION 0x80 /end CHARACTERISTIC
/begin CHARACTERISTIC CtApImageProcess_FreeRunning.PpDR_Merges_10ms.DeDR_List.DR_List[46].utm_z "" VALUE 0x2551030 __FLOAT32_IEEE_S 0 NO_COMPU_METHOD 0 3.402823e+38 ECU_ADDRESS_EXTENSION 0x80 /end CHARACTERISTIC
/begin CHARACTERISTIC CtApImageProcess_FreeRunning.PpDR_Merges_10ms.DeDR_List.DR_List[46].heading "" VALUE 0x2551034 __FLOAT32_IEEE_S 0 NO_COMPU_METHOD 0 3.402823e+38 ECU_ADDRESS_EXTENSION 0x80 /end CHARACTERISTIC
/begin CHARACTERISTIC CtApImageProcess_FreeRunning.PpDR_Merges_10ms.DeDR_List.DR_List[46].delta_x "" VALUE 0x2551038 __FLOAT32_IEEE_S 0 NO_COMPU_METHOD 0 3.402823e+38 ECU_ADDRESS_EXTENSION 0x80 /end CHARACTERISTIC
/begin CHARACTERISTIC CtApImageProcess_FreeRunning.PpDR_Merges_10ms.DeDR_List.DR_List[46].delta_y "" VALUE 0x255103c __FLOAT32_IEEE_S 0 NO_COMPU_METHOD 0 3.402823e+38 ECU_ADDRESS_EXTENSION 0x80 /end CHARACTERISTIC
/begin CHARACTERISTIC CtApImageProcess_FreeRunning.PpDR_Merges_10ms.DeDR_List.DR_List[46].delta_z "" VALUE 0x2551040 __FLOAT32_IEEE_S 0 NO_COMPU_METHOD 0 3.402823e+38 ECU_ADDRESS_EXTENSION 0x80 /end CHARACTERISTIC
/begin CHARACTERISTIC CtApImageProcess_FreeRunning.PpDR_Merges_10ms.DeDR_List.DR_List[46].delta_yaw "" VALUE 0x2551044 __FLOAT32_IEEE_S 0 NO_COMPU_METHOD 0 3.402823e+38 ECU_ADDRESS_EXTENSION 0x80 /end CHARACTERISTIC
/begin CHARACTERISTIC CtApImageProcess_FreeRunning.PpDR_Merges_10ms.DeDR_List.DR_List[46].belif "" VALUE 0x2551048 __FLOAT32_IEEE_S 0 NO_COMPU_METHOD 0 3.402823e+38 ECU_ADDRESS_EXTENSION 0x80 /end CHARACTERISTIC
/begin CHARACTERISTIC CtApImageProcess_FreeRunning.PpDR_Merges_10ms.DeDR_List.DR_List[46].reserved_int "5 uint32 array" VAL_BLK 0x255104c __ULONG_S 0 NO_COMPU_METHOD 0 4294967295 ECU_ADDRESS_EXTENSION 0x80 MATRIX_DIM 5 1 1 /end CHARACTERISTIC
/begin CHARACTERISTIC CtApImageProcess_FreeRunning.PpDR_Merges_10ms.DeDR_List.DR_List[47].stHeader.Counter "" VALUE 0x2551060 __UWORD_S 0 NO_COMPU_METHOD 0 65535 ECU_ADDRESS_EXTENSION 0x80 /end CHARACTERISTIC
/begin CHARACTERISTIC CtApImageProcess_FreeRunning.PpDR_Merges_10ms.DeDR_List.DR_List[47].stHeader.FrameID "" VALUE 0x2551062 __UBYTE_S 0 NO_COMPU_METHOD 0 255 ECU_ADDRESS_EXTENSION 0x80 /end CHARACTERISTIC
/begin CHARACTERISTIC CtApImageProcess_FreeRunning.PpDR_Merges_10ms.DeDR_List.DR_List[47].stHeader.TimeStamp "2 uint32 array" VAL_BLK 0x2551064 __ULONG_S 0 NO_COMPU_METHOD 0 4294967295 ECU_ADDRESS_EXTENSION 0x80 MATRIX_DIM 2 1 1 /end CHARACTERISTIC
/begin CHARACTERISTIC CtApImageProcess_FreeRunning.PpDR_Merges_10ms.DeDR_List.DR_List[47].count "" VALUE 0x255106c __UBYTE_S 0 NO_COMPU_METHOD 0 255 ECU_ADDRESS_EXTENSION 0x80 /end CHARACTERISTIC
/begin CHARACTERISTIC CtApImageProcess_FreeRunning.PpDR_Merges_10ms.DeDR_List.DR_List[47].time_sec "" VALUE 0x2551070 __FLOAT64_IEEE_S 0 NO_COMPU_METHOD 0 3.402823e+38 ECU_ADDRESS_EXTENSION 0x80 /end CHARACTERISTIC
/begin CHARACTERISTIC CtApImageProcess_FreeRunning.PpDR_Merges_10ms.DeDR_List.DR_List[47].utm_x "" VALUE 0x2551078 __FLOAT64_IEEE_S 0 NO_COMPU_METHOD 0 3.402823e+38 ECU_ADDRESS_EXTENSION 0x80 /end CHARACTERISTIC
/begin CHARACTERISTIC CtApImageProcess_FreeRunning.PpDR_Merges_10ms.DeDR_List.DR_List[47].utm_y "" VALUE 0x2551080 __FLOAT64_IEEE_S 0 NO_COMPU_METHOD 0 3.402823e+38 ECU_ADDRESS_EXTENSION 0x80 /end CHARACTERISTIC
/begin CHARACTERISTIC CtApImageProcess_FreeRunning.PpDR_Merges_10ms.DeDR_List.DR_List[47].utm_z "" VALUE 0x2551088 __FLOAT32_IEEE_S 0 NO_COMPU_METHOD 0 3.402823e+38 ECU_ADDRESS_EXTENSION 0x80 /end CHARACTERISTIC
/begin CHARACTERISTIC CtApImageProcess_FreeRunning.PpDR_Merges_10ms.DeDR_List.DR_List[47].heading "" VALUE 0x255108c __FLOAT32_IEEE_S 0 NO_COMPU_METHOD 0 3.402823e+38 ECU_ADDRESS_EXTENSION 0x80 /end CHARACTERISTIC
/begin CHARACTERISTIC CtApImageProcess_FreeRunning.PpDR_Merges_10ms.DeDR_List.DR_List[47].delta_x "" VALUE 0x2551090 __FLOAT32_IEEE_S 0 NO_COMPU_METHOD 0 3.402823e+38 ECU_ADDRESS_EXTENSION 0x80 /end CHARACTERISTIC
/begin CHARACTERISTIC CtApImageProcess_FreeRunning.PpDR_Merges_10ms.DeDR_List.DR_List[47].delta_y "" VALUE 0x2551094 __FLOAT32_IEEE_S 0 NO_COMPU_METHOD 0 3.402823e+38 ECU_ADDRESS_EXTENSION 0x80 /end CHARACTERISTIC
/begin CHARACTERISTIC CtApImageProcess_FreeRunning.PpDR_Merges_10ms.DeDR_List.DR_List[47].delta_z "" VALUE 0x2551098 __FLOAT32_IEEE_S 0 NO_COMPU_METHOD 0 3.402823e+38 ECU_ADDRESS_EXTENSION 0x80 /end CHARACTERISTIC
/begin CHARACTERISTIC CtApImageProcess_FreeRunning.PpDR_Merges_10ms.DeDR_List.DR_List[47].delta_yaw "" VALUE 0x255109c __FLOAT32_IEEE_S 0 NO_COMPU_METHOD 0 3.402823e+38 ECU_ADDRESS_EXTENSION 0x80 /end CHARACTERISTIC
/begin CHARACTERISTIC CtApImageProcess_FreeRunning.PpDR_Merges_10ms.DeDR_List.DR_List[47].belif "" VALUE 0x25510a0 __FLOAT32_IEEE_S 0 NO_COMPU_METHOD 0 3.402823e+38 ECU_ADDRESS_EXTENSION 0x80 /end CHARACTERISTIC
/begin CHARACTERISTIC CtApImageProcess_FreeRunning.PpDR_Merges_10ms.DeDR_List.DR_List[47].reserved_int "5 uint32 array" VAL_BLK 0x25510a4 __ULONG_S 0 NO_COMPU_METHOD 0 4294967295 ECU_ADDRESS_EXTENSION 0x80 MATRIX_DIM 5 1 1 /end CHARACTERISTIC
/begin CHARACTERISTIC CtApImageProcess_FreeRunning.PpDR_Merges_10ms.DeDR_List.DR_List[48].stHeader.Counter "" VALUE 0x25510b8 __UWORD_S 0 NO_COMPU_METHOD 0 65535 ECU_ADDRESS_EXTENSION 0x80 /end CHARACTERISTIC
/begin CHARACTERISTIC CtApImageProcess_FreeRunning.PpDR_Merges_10ms.DeDR_List.DR_List[48].stHeader.FrameID "" VALUE 0x25510ba __UBYTE_S 0 NO_COMPU_METHOD 0 255 ECU_ADDRESS_EXTENSION 0x80 /end CHARACTERISTIC
/begin CHARACTERISTIC CtApImageProcess_FreeRunning.PpDR_Merges_10ms.DeDR_List.DR_List[48].stHeader.TimeStamp "2 uint32 array" VAL_BLK 0x25510bc __ULONG_S 0 NO_COMPU_METHOD 0 4294967295 ECU_ADDRESS_EXTENSION 0x80 MATRIX_DIM 2 1 1 /end CHARACTERISTIC
/begin CHARACTERISTIC CtApImageProcess_FreeRunning.PpDR_Merges_10ms.DeDR_List.DR_List[48].count "" VALUE 0x25510c4 __UBYTE_S 0 NO_COMPU_METHOD 0 255 ECU_ADDRESS_EXTENSION 0x80 /end CHARACTERISTIC
/begin CHARACTERISTIC CtApImageProcess_FreeRunning.PpDR_Merges_10ms.DeDR_List.DR_List[48].time_sec "" VALUE 0x25510c8 __FLOAT64_IEEE_S 0 NO_COMPU_METHOD 0 3.402823e+38 ECU_ADDRESS_EXTENSION 0x80 /end CHARACTERISTIC
/begin CHARACTERISTIC CtApImageProcess_FreeRunning.PpDR_Merges_10ms.DeDR_List.DR_List[48].utm_x "" VALUE 0x25510d0 __FLOAT64_IEEE_S 0 NO_COMPU_METHOD 0 3.402823e+38 ECU_ADDRESS_EXTENSION 0x80 /end CHARACTERISTIC
/begin CHARACTERISTIC CtApImageProcess_FreeRunning.PpDR_Merges_10ms.DeDR_List.DR_List[48].utm_y "" VALUE 0x25510d8 __FLOAT64_IEEE_S 0 NO_COMPU_METHOD 0 3.402823e+38 ECU_ADDRESS_EXTENSION 0x80 /end CHARACTERISTIC
/begin CHARACTERISTIC CtApImageProcess_FreeRunning.PpDR_Merges_10ms.DeDR_List.DR_List[48].utm_z "" VALUE 0x25510e0 __FLOAT32_IEEE_S 0 NO_COMPU_METHOD 0 3.402823e+38 ECU_ADDRESS_EXTENSION 0x80 /end CHARACTERISTIC
/begin CHARACTERISTIC CtApImageProcess_FreeRunning.PpDR_Merges_10ms.DeDR_List.DR_List[48].heading "" VALUE 0x25510e4 __FLOAT32_IEEE_S 0 NO_COMPU_METHOD 0 3.402823e+38 ECU_ADDRESS_EXTENSION 0x80 /end CHARACTERISTIC
/begin CHARACTERISTIC CtApImageProcess_FreeRunning.PpDR_Merges_10ms.DeDR_List.DR_List[48].delta_x "" VALUE 0x25510e8 __FLOAT32_IEEE_S 0 NO_COMPU_METHOD 0 3.402823e+38 ECU_ADDRESS_EXTENSION 0x80 /end CHARACTERISTIC
/begin CHARACTERISTIC CtApImageProcess_FreeRunning.PpDR_Merges_10ms.DeDR_List.DR_List[48].delta_y "" VALUE 0x25510ec __FLOAT32_IEEE_S 0 NO_COMPU_METHOD 0 3.402823e+38 ECU_ADDRESS_EXTENSION 0x80 /end CHARACTERISTIC
/begin CHARACTERISTIC CtApImageProcess_FreeRunning.PpDR_Merges_10ms.DeDR_List.DR_List[48].delta_z "" VALUE 0x25510f0 __FLOAT32_IEEE_S 0 NO_COMPU_METHOD 0 3.402823e+38 ECU_ADDRESS_EXTENSION 0x80 /end CHARACTERISTIC
/begin CHARACTERISTIC CtApImageProcess_FreeRunning.PpDR_Merges_10ms.DeDR_List.DR_List[48].delta_yaw "" VALUE 0x25510f4 __FLOAT32_IEEE_S 0 NO_COMPU_METHOD 0 3.402823e+38 ECU_ADDRESS_EXTENSION 0x80 /end CHARACTERISTIC
/begin CHARACTERISTIC CtApImageProcess_FreeRunning.PpDR_Merges_10ms.DeDR_List.DR_List[48].belif "" VALUE 0x25510f8 __FLOAT32_IEEE_S 0 NO_COMPU_METHOD 0 3.402823e+38 ECU_ADDRESS_EXTENSION 0x80 /end CHARACTERISTIC
/begin CHARACTERISTIC CtApImageProcess_FreeRunning.PpDR_Merges_10ms.DeDR_List.DR_List[48].reserved_int "5 uint32 array" VAL_BLK 0x25510fc __ULONG_S 0 NO_COMPU_METHOD 0 4294967295 ECU_ADDRESS_EXTENSION 0x80 MATRIX_DIM 5 1 1 /end CHARACTERISTIC
/begin CHARACTERISTIC CtApImageProcess_FreeRunning.PpDR_Merges_10ms.DeDR_List.DR_List[49].stHeader.Counter "" VALUE 0x2551110 __UWORD_S 0 NO_COMPU_METHOD 0 65535 ECU_ADDRESS_EXTENSION 0x80 /end CHARACTERISTIC
/begin CHARACTERISTIC CtApImageProcess_FreeRunning.PpDR_Merges_10ms.DeDR_List.DR_List[49].stHeader.FrameID "" VALUE 0x2551112 __UBYTE_S 0 NO_COMPU_METHOD 0 255 ECU_ADDRESS_EXTENSION 0x80 /end CHARACTERISTIC
/begin CHARACTERISTIC CtApImageProcess_FreeRunning.PpDR_Merges_10ms.DeDR_List.DR_List[49].stHeader.TimeStamp "2 uint32 array" VAL_BLK 0x2551114 __ULONG_S 0 NO_COMPU_METHOD 0 4294967295 ECU_ADDRESS_EXTENSION 0x80 MATRIX_DIM 2 1 1 /end CHARACTERISTIC
/begin CHARACTERISTIC CtApImageProcess_FreeRunning.PpDR_Merges_10ms.DeDR_List.DR_List[49].count "" VALUE 0x255111c __UBYTE_S 0 NO_COMPU_METHOD 0 255 ECU_ADDRESS_EXTENSION 0x80 /end CHARACTERISTIC
/begin CHARACTERISTIC CtApImageProcess_FreeRunning.PpDR_Merges_10ms.DeDR_List.DR_List[49].time_sec "" VALUE 0x2551120 __FLOAT64_IEEE_S 0 NO_COMPU_METHOD 0 3.402823e+38 ECU_ADDRESS_EXTENSION 0x80 /end CHARACTERISTIC
/begin CHARACTERISTIC CtApImageProcess_FreeRunning.PpDR_Merges_10ms.DeDR_List.DR_List[49].utm_x "" VALUE 0x2551128 __FLOAT64_IEEE_S 0 NO_COMPU_METHOD 0 3.402823e+38 ECU_ADDRESS_EXTENSION 0x80 /end CHARACTERISTIC
/begin CHARACTERISTIC CtApImageProcess_FreeRunning.PpDR_Merges_10ms.DeDR_List.DR_List[49].utm_y "" VALUE 0x2551130 __FLOAT64_IEEE_S 0 NO_COMPU_METHOD 0 3.402823e+38 ECU_ADDRESS_EXTENSION 0x80 /end CHARACTERISTIC
/begin CHARACTERISTIC CtApImageProcess_FreeRunning.PpDR_Merges_10ms.DeDR_List.DR_List[49].utm_z "" VALUE 0x2551138 __FLOAT32_IEEE_S 0 NO_COMPU_METHOD 0 3.402823e+38 ECU_ADDRESS_EXTENSION 0x80 /end CHARACTERISTIC
/begin CHARACTERISTIC CtApImageProcess_FreeRunning.PpDR_Merges_10ms.DeDR_List.DR_List[49].heading "" VALUE 0x255113c __FLOAT32_IEEE_S 0 NO_COMPU_METHOD 0 3.402823e+38 ECU_ADDRESS_EXTENSION 0x80 /end CHARACTERISTIC
/begin CHARACTERISTIC CtApImageProcess_FreeRunning.PpDR_Merges_10ms.DeDR_List.DR_List[49].delta_x "" VALUE 0x2551140 __FLOAT32_IEEE_S 0 NO_COMPU_METHOD 0 3.402823e+38 ECU_ADDRESS_EXTENSION 0x80 /end CHARACTERISTIC
/begin CHARACTERISTIC CtApImageProcess_FreeRunning.PpDR_Merges_10ms.DeDR_List.DR_List[49].delta_y "" VALUE 0x2551144 __FLOAT32_IEEE_S 0 NO_COMPU_METHOD 0 3.402823e+38 ECU_ADDRESS_EXTENSION 0x80 /end CHARACTERISTIC
/begin CHARACTERISTIC CtApImageProcess_FreeRunning.PpDR_Merges_10ms.DeDR_List.DR_List[49].delta_z "" VALUE 0x2551148 __FLOAT32_IEEE_S 0 NO_COMPU_METHOD 0 3.402823e+38 ECU_ADDRESS_EXTENSION 0x80 /end CHARACTERISTIC
/begin CHARACTERISTIC CtApImageProcess_FreeRunning.PpDR_Merges_10ms.DeDR_List.DR_List[49].delta_yaw "" VALUE 0x255114c __FLOAT32_IEEE_S 0 NO_COMPU_METHOD 0 3.402823e+38 ECU_ADDRESS_EXTENSION 0x80 /end CHARACTERISTIC
/begin CHARACTERISTIC CtApImageProcess_FreeRunning.PpDR_Merges_10ms.DeDR_List.DR_List[49].belif "" VALUE 0x2551150 __FLOAT32_IEEE_S 0 NO_COMPU_METHOD 0 3.402823e+38 ECU_ADDRESS_EXTENSION 0x80 /end CHARACTERISTIC
/begin CHARACTERISTIC CtApImageProcess_FreeRunning.PpDR_Merges_10ms.DeDR_List.DR_List[49].reserved_int "5 uint32 array" VAL_BLK 0x2551154 __ULONG_S 0 NO_COMPU_METHOD 0 4294967295 ECU_ADDRESS_EXTENSION 0x80 MATRIX_DIM 5 1 1 /end CHARACTERISTIC
/begin CHARACTERISTIC CtApImageProcess_FreeRunning.PpDR_Merges_10ms.DeDR_List.DR_List[50].stHeader.Counter "" VALUE 0x2551168 __UWORD_S 0 NO_COMPU_METHOD 0 65535 ECU_ADDRESS_EXTENSION 0x80 /end CHARACTERISTIC
/begin CHARACTERISTIC CtApImageProcess_FreeRunning.PpDR_Merges_10ms.DeDR_List.DR_List[50].stHeader.FrameID "" VALUE 0x255116a __UBYTE_S 0 NO_COMPU_METHOD 0 255 ECU_ADDRESS_EXTENSION 0x80 /end CHARACTERISTIC
/begin CHARACTERISTIC CtApImageProcess_FreeRunning.PpDR_Merges_10ms.DeDR_List.DR_List[50].stHeader.TimeStamp "2 uint32 array" VAL_BLK 0x255116c __ULONG_S 0 NO_COMPU_METHOD 0 4294967295 ECU_ADDRESS_EXTENSION 0x80 MATRIX_DIM 2 1 1 /end CHARACTERISTIC
/begin CHARACTERISTIC CtApImageProcess_FreeRunning.PpDR_Merges_10ms.DeDR_List.DR_List[50].count "" VALUE 0x2551174 __UBYTE_S 0 NO_COMPU_METHOD 0 255 ECU_ADDRESS_EXTENSION 0x80 /end CHARACTERISTIC
/begin CHARACTERISTIC CtApImageProcess_FreeRunning.PpDR_Merges_10ms.DeDR_List.DR_List[50].time_sec "" VALUE 0x2551178 __FLOAT64_IEEE_S 0 NO_COMPU_METHOD 0 3.402823e+38 ECU_ADDRESS_EXTENSION 0x80 /end CHARACTERISTIC
/begin CHARACTERISTIC CtApImageProcess_FreeRunning.PpDR_Merges_10ms.DeDR_List.DR_List[50].utm_x "" VALUE 0x2551180 __FLOAT64_IEEE_S 0 NO_COMPU_METHOD 0 3.402823e+38 ECU_ADDRESS_EXTENSION 0x80 /end CHARACTERISTIC
/begin CHARACTERISTIC CtApImageProcess_FreeRunning.PpDR_Merges_10ms.DeDR_List.DR_List[50].utm_y "" VALUE 0x2551188 __FLOAT64_IEEE_S 0 NO_COMPU_METHOD 0 3.402823e+38 ECU_ADDRESS_EXTENSION 0x80 /end CHARACTERISTIC
/begin CHARACTERISTIC CtApImageProcess_FreeRunning.PpDR_Merges_10ms.DeDR_List.DR_List[50].utm_z "" VALUE 0x2551190 __FLOAT32_IEEE_S 0 NO_COMPU_METHOD 0 3.402823e+38 ECU_ADDRESS_EXTENSION 0x80 /end CHARACTERISTIC
/begin CHARACTERISTIC CtApImageProcess_FreeRunning.PpDR_Merges_10ms.DeDR_List.DR_List[50].heading "" VALUE 0x2551194 __FLOAT32_IEEE_S 0 NO_COMPU_METHOD 0 3.402823e+38 ECU_ADDRESS_EXTENSION 0x80 /end CHARACTERISTIC
/begin CHARACTERISTIC CtApImageProcess_FreeRunning.PpDR_Merges_10ms.DeDR_List.DR_List[50].delta_x "" VALUE 0x2551198 __FLOAT32_IEEE_S 0 NO_COMPU_METHOD 0 3.402823e+38 ECU_ADDRESS_EXTENSION 0x80 /end CHARACTERISTIC
/begin CHARACTERISTIC CtApImageProcess_FreeRunning.PpDR_Merges_10ms.DeDR_List.DR_List[50].delta_y "" VALUE 0x255119c __FLOAT32_IEEE_S 0 NO_COMPU_METHOD 0 3.402823e+38 ECU_ADDRESS_EXTENSION 0x80 /end CHARACTERISTIC
/begin CHARACTERISTIC CtApImageProcess_FreeRunning.PpDR_Merges_10ms.DeDR_List.DR_List[50].delta_z "" VALUE 0x25511a0 __FLOAT32_IEEE_S 0 NO_COMPU_METHOD 0 3.402823e+38 ECU_ADDRESS_EXTENSION 0x80 /end CHARACTERISTIC
/begin CHARACTERISTIC CtApImageProcess_FreeRunning.PpDR_Merges_10ms.DeDR_List.DR_List[50].delta_yaw "" VALUE 0x25511a4 __FLOAT32_IEEE_S 0 NO_COMPU_METHOD 0 3.402823e+38 ECU_ADDRESS_EXTENSION 0x80 /end CHARACTERISTIC
/begin CHARACTERISTIC CtApImageProcess_FreeRunning.PpDR_Merges_10ms.DeDR_List.DR_List[50].belif "" VALUE 0x25511a8 __FLOAT32_IEEE_S 0 NO_COMPU_METHOD 0 3.402823e+38 ECU_ADDRESS_EXTENSION 0x80 /end CHARACTERISTIC
/begin CHARACTERISTIC CtApImageProcess_FreeRunning.PpDR_Merges_10ms.DeDR_List.DR_List[50].reserved_int "5 uint32 array" VAL_BLK 0x25511ac __ULONG_S 0 NO_COMPU_METHOD 0 4294967295 ECU_ADDRESS_EXTENSION 0x80 MATRIX_DIM 5 1 1 /end CHARACTERISTIC
/begin CHARACTERISTIC CtApImageProcess_FreeRunning.PpDR_Merges_10ms.DeDR_List.DR_List[51].stHeader.Counter "" VALUE 0x25511c0 __UWORD_S 0 NO_COMPU_METHOD 0 65535 ECU_ADDRESS_EXTENSION 0x80 /end CHARACTERISTIC
/begin CHARACTERISTIC CtApImageProcess_FreeRunning.PpDR_Merges_10ms.DeDR_List.DR_List[51].stHeader.FrameID "" VALUE 0x25511c2 __UBYTE_S 0 NO_COMPU_METHOD 0 255 ECU_ADDRESS_EXTENSION 0x80 /end CHARACTERISTIC
/begin CHARACTERISTIC CtApImageProcess_FreeRunning.PpDR_Merges_10ms.DeDR_List.DR_List[51].stHeader.TimeStamp "2 uint32 array" VAL_BLK 0x25511c4 __ULONG_S 0 NO_COMPU_METHOD 0 4294967295 ECU_ADDRESS_EXTENSION 0x80 MATRIX_DIM 2 1 1 /end CHARACTERISTIC
/begin CHARACTERISTIC CtApImageProcess_FreeRunning.PpDR_Merges_10ms.DeDR_List.DR_List[51].count "" VALUE 0x25511cc __UBYTE_S 0 NO_COMPU_METHOD 0 255 ECU_ADDRESS_EXTENSION 0x80 /end CHARACTERISTIC
/begin CHARACTERISTIC CtApImageProcess_FreeRunning.PpDR_Merges_10ms.DeDR_List.DR_List[51].time_sec "" VALUE 0x25511d0 __FLOAT64_IEEE_S 0 NO_COMPU_METHOD 0 3.402823e+38 ECU_ADDRESS_EXTENSION 0x80 /end CHARACTERISTIC
/begin CHARACTERISTIC CtApImageProcess_FreeRunning.PpDR_Merges_10ms.DeDR_List.DR_List[51].utm_x "" VALUE 0x25511d8 __FLOAT64_IEEE_S 0 NO_COMPU_METHOD 0 3.402823e+38 ECU_ADDRESS_EXTENSION 0x80 /end CHARACTERISTIC
/begin CHARACTERISTIC CtApImageProcess_FreeRunning.PpDR_Merges_10ms.DeDR_List.DR_List[51].utm_y "" VALUE 0x25511e0 __FLOAT64_IEEE_S 0 NO_COMPU_METHOD 0 3.402823e+38 ECU_ADDRESS_EXTENSION 0x80 /end CHARACTERISTIC
/begin CHARACTERISTIC CtApImageProcess_FreeRunning.PpDR_Merges_10ms.DeDR_List.DR_List[51].utm_z "" VALUE 0x25511e8 __FLOAT32_IEEE_S 0 NO_COMPU_METHOD 0 3.402823e+38 ECU_ADDRESS_EXTENSION 0x80 /end CHARACTERISTIC
/begin CHARACTERISTIC CtApImageProcess_FreeRunning.PpDR_Merges_10ms.DeDR_List.DR_List[51].heading "" VALUE 0x25511ec __FLOAT32_IEEE_S 0 NO_COMPU_METHOD 0 3.402823e+38 ECU_ADDRESS_EXTENSION 0x80 /end CHARACTERISTIC
/begin CHARACTERISTIC CtApImageProcess_FreeRunning.PpDR_Merges_10ms.DeDR_List.DR_List[51].delta_x "" VALUE 0x25511f0 __FLOAT32_IEEE_S 0 NO_COMPU_METHOD 0 3.402823e+38 ECU_ADDRESS_EXTENSION 0x80 /end CHARACTERISTIC
/begin CHARACTERISTIC CtApImageProcess_FreeRunning.PpDR_Merges_10ms.DeDR_List.DR_List[51].delta_y "" VALUE 0x25511f4 __FLOAT32_IEEE_S 0 NO_COMPU_METHOD 0 3.402823e+38 ECU_ADDRESS_EXTENSION 0x80 /end CHARACTERISTIC
/begin CHARACTERISTIC CtApImageProcess_FreeRunning.PpDR_Merges_10ms.DeDR_List.DR_List[51].delta_z "" VALUE 0x25511f8 __FLOAT32_IEEE_S 0 NO_COMPU_METHOD 0 3.402823e+38 ECU_ADDRESS_EXTENSION 0x80 /end CHARACTERISTIC
/begin CHARACTERISTIC CtApImageProcess_FreeRunning.PpDR_Merges_10ms.DeDR_List.DR_List[51].delta_yaw "" VALUE 0x25511fc __FLOAT32_IEEE_S 0 NO_COMPU_METHOD 0 3.402823e+38 ECU_ADDRESS_EXTENSION 0x80 /end CHARACTERISTIC
/begin CHARACTERISTIC CtApImageProcess_FreeRunning.PpDR_Merges_10ms.DeDR_List.DR_List[51].belif "" VALUE 0x2551200 __FLOAT32_IEEE_S 0 NO_COMPU_METHOD 0 3.402823e+38 ECU_ADDRESS_EXTENSION 0x80 /end CHARACTERISTIC
/begin CHARACTERISTIC CtApImageProcess_FreeRunning.PpDR_Merges_10ms.DeDR_List.DR_List[51].reserved_int "5 uint32 array" VAL_BLK 0x2551204 __ULONG_S 0 NO_COMPU_METHOD 0 4294967295 ECU_ADDRESS_EXTENSION 0x80 MATRIX_DIM 5 1 1 /end CHARACTERISTIC
/begin CHARACTERISTIC CtApImageProcess_FreeRunning.PpDR_Merges_10ms.DeDR_List.DR_List[52].stHeader.Counter "" VALUE 0x2551218 __UWORD_S 0 NO_COMPU_METHOD 0 65535 ECU_ADDRESS_EXTENSION 0x80 /end CHARACTERISTIC
/begin CHARACTERISTIC CtApImageProcess_FreeRunning.PpDR_Merges_10ms.DeDR_List.DR_List[52].stHeader.FrameID "" VALUE 0x255121a __UBYTE_S 0 NO_COMPU_METHOD 0 255 ECU_ADDRESS_EXTENSION 0x80 /end CHARACTERISTIC
/begin CHARACTERISTIC CtApImageProcess_FreeRunning.PpDR_Merges_10ms.DeDR_List.DR_List[52].stHeader.TimeStamp "2 uint32 array" VAL_BLK 0x255121c __ULONG_S 0 NO_COMPU_METHOD 0 4294967295 ECU_ADDRESS_EXTENSION 0x80 MATRIX_DIM 2 1 1 /end CHARACTERISTIC
/begin CHARACTERISTIC CtApImageProcess_FreeRunning.PpDR_Merges_10ms.DeDR_List.DR_List[52].count "" VALUE 0x2551224 __UBYTE_S 0 NO_COMPU_METHOD 0 255 ECU_ADDRESS_EXTENSION 0x80 /end CHARACTERISTIC
/begin CHARACTERISTIC CtApImageProcess_FreeRunning.PpDR_Merges_10ms.DeDR_List.DR_List[52].time_sec "" VALUE 0x2551228 __FLOAT64_IEEE_S 0 NO_COMPU_METHOD 0 3.402823e+38 ECU_ADDRESS_EXTENSION 0x80 /end CHARACTERISTIC
/begin CHARACTERISTIC CtApImageProcess_FreeRunning.PpDR_Merges_10ms.DeDR_List.DR_List[52].utm_x "" VALUE 0x2551230 __FLOAT64_IEEE_S 0 NO_COMPU_METHOD 0 3.402823e+38 ECU_ADDRESS_EXTENSION 0x80 /end CHARACTERISTIC
/begin CHARACTERISTIC CtApImageProcess_FreeRunning.PpDR_Merges_10ms.DeDR_List.DR_List[52].utm_y "" VALUE 0x2551238 __FLOAT64_IEEE_S 0 NO_COMPU_METHOD 0 3.402823e+38 ECU_ADDRESS_EXTENSION 0x80 /end CHARACTERISTIC
/begin CHARACTERISTIC CtApImageProcess_FreeRunning.PpDR_Merges_10ms.DeDR_List.DR_List[52].utm_z "" VALUE 0x2551240 __FLOAT32_IEEE_S 0 NO_COMPU_METHOD 0 3.402823e+38 ECU_ADDRESS_EXTENSION 0x80 /end CHARACTERISTIC
/begin CHARACTERISTIC CtApImageProcess_FreeRunning.PpDR_Merges_10ms.DeDR_List.DR_List[52].heading "" VALUE 0x2551244 __FLOAT32_IEEE_S 0 NO_COMPU_METHOD 0 3.402823e+38 ECU_ADDRESS_EXTENSION 0x80 /end CHARACTERISTIC
/begin CHARACTERISTIC CtApImageProcess_FreeRunning.PpDR_Merges_10ms.DeDR_List.DR_List[52].delta_x "" VALUE 0x2551248 __FLOAT32_IEEE_S 0 NO_COMPU_METHOD 0 3.402823e+38 ECU_ADDRESS_EXTENSION 0x80 /end CHARACTERISTIC
/begin CHARACTERISTIC CtApImageProcess_FreeRunning.PpDR_Merges_10ms.DeDR_List.DR_List[52].delta_y "" VALUE 0x255124c __FLOAT32_IEEE_S 0 NO_COMPU_METHOD 0 3.402823e+38 ECU_ADDRESS_EXTENSION 0x80 /end CHARACTERISTIC
/begin CHARACTERISTIC CtApImageProcess_FreeRunning.PpDR_Merges_10ms.DeDR_List.DR_List[52].delta_z "" VALUE 0x2551250 __FLOAT32_IEEE_S 0 NO_COMPU_METHOD 0 3.402823e+38 ECU_ADDRESS_EXTENSION 0x80 /end CHARACTERISTIC
/begin CHARACTERISTIC CtApImageProcess_FreeRunning.PpDR_Merges_10ms.DeDR_List.DR_List[52].delta_yaw "" VALUE 0x2551254 __FLOAT32_IEEE_S 0 NO_COMPU_METHOD 0 3.402823e+38 ECU_ADDRESS_EXTENSION 0x80 /end CHARACTERISTIC
/begin CHARACTERISTIC CtApImageProcess_FreeRunning.PpDR_Merges_10ms.DeDR_List.DR_List[52].belif "" VALUE 0x2551258 __FLOAT32_IEEE_S 0 NO_COMPU_METHOD 0 3.402823e+38 ECU_ADDRESS_EXTENSION 0x80 /end CHARACTERISTIC
/begin CHARACTERISTIC CtApImageProcess_FreeRunning.PpDR_Merges_10ms.DeDR_List.DR_List[52].reserved_int "5 uint32 array" VAL_BLK 0x255125c __ULONG_S 0 NO_COMPU_METHOD 0 4294967295 ECU_ADDRESS_EXTENSION 0x80 MATRIX_DIM 5 1 1 /end CHARACTERISTIC
/begin CHARACTERISTIC CtApImageProcess_FreeRunning.PpDR_Merges_10ms.DeDR_List.DR_List[53].stHeader.Counter "" VALUE 0x2551270 __UWORD_S 0 NO_COMPU_METHOD 0 65535 ECU_ADDRESS_EXTENSION 0x80 /end CHARACTERISTIC
/begin CHARACTERISTIC CtApImageProcess_FreeRunning.PpDR_Merges_10ms.DeDR_List.DR_List[53].stHeader.FrameID "" VALUE 0x2551272 __UBYTE_S 0 NO_COMPU_METHOD 0 255 ECU_ADDRESS_EXTENSION 0x80 /end CHARACTERISTIC
/begin CHARACTERISTIC CtApImageProcess_FreeRunning.PpDR_Merges_10ms.DeDR_List.DR_List[53].stHeader.TimeStamp "2 uint32 array" VAL_BLK 0x2551274 __ULONG_S 0 NO_COMPU_METHOD 0 4294967295 ECU_ADDRESS_EXTENSION 0x80 MATRIX_DIM 2 1 1 /end CHARACTERISTIC
/begin CHARACTERISTIC CtApImageProcess_FreeRunning.PpDR_Merges_10ms.DeDR_List.DR_List[53].count "" VALUE 0x255127c __UBYTE_S 0 NO_COMPU_METHOD 0 255 ECU_ADDRESS_EXTENSION 0x80 /end CHARACTERISTIC
/begin CHARACTERISTIC CtApImageProcess_FreeRunning.PpDR_Merges_10ms.DeDR_List.DR_List[53].time_sec "" VALUE 0x2551280 __FLOAT64_IEEE_S 0 NO_COMPU_METHOD 0 3.402823e+38 ECU_ADDRESS_EXTENSION 0x80 /end CHARACTERISTIC
/begin CHARACTERISTIC CtApImageProcess_FreeRunning.PpDR_Merges_10ms.DeDR_List.DR_List[53].utm_x "" VALUE 0x2551288 __FLOAT64_IEEE_S 0 NO_COMPU_METHOD 0 3.402823e+38 ECU_ADDRESS_EXTENSION 0x80 /end CHARACTERISTIC
/begin CHARACTERISTIC CtApImageProcess_FreeRunning.PpDR_Merges_10ms.DeDR_List.DR_List[53].utm_y "" VALUE 0x2551290 __FLOAT64_IEEE_S 0 NO_COMPU_METHOD 0 3.402823e+38 ECU_ADDRESS_EXTENSION 0x80 /end CHARACTERISTIC
/begin CHARACTERISTIC CtApImageProcess_FreeRunning.PpDR_Merges_10ms.DeDR_List.DR_List[53].utm_z "" VALUE 0x2551298 __FLOAT32_IEEE_S 0 NO_COMPU_METHOD 0 3.402823e+38 ECU_ADDRESS_EXTENSION 0x80 /end CHARACTERISTIC
/begin CHARACTERISTIC CtApImageProcess_FreeRunning.PpDR_Merges_10ms.DeDR_List.DR_List[53].heading "" VALUE 0x255129c __FLOAT32_IEEE_S 0 NO_COMPU_METHOD 0 3.402823e+38 ECU_ADDRESS_EXTENSION 0x80 /end CHARACTERISTIC
/begin CHARACTERISTIC CtApImageProcess_FreeRunning.PpDR_Merges_10ms.DeDR_List.DR_List[53].delta_x "" VALUE 0x25512a0 __FLOAT32_IEEE_S 0 NO_COMPU_METHOD 0 3.402823e+38 ECU_ADDRESS_EXTENSION 0x80 /end CHARACTERISTIC
/begin CHARACTERISTIC CtApImageProcess_FreeRunning.PpDR_Merges_10ms.DeDR_List.DR_List[53].delta_y "" VALUE 0x25512a4 __FLOAT32_IEEE_S 0 NO_COMPU_METHOD 0 3.402823e+38 ECU_ADDRESS_EXTENSION 0x80 /end CHARACTERISTIC
/begin CHARACTERISTIC CtApImageProcess_FreeRunning.PpDR_Merges_10ms.DeDR_List.DR_List[53].delta_z "" VALUE 0x25512a8 __FLOAT32_IEEE_S 0 NO_COMPU_METHOD 0 3.402823e+38 ECU_ADDRESS_EXTENSION 0x80 /end CHARACTERISTIC
/begin CHARACTERISTIC CtApImageProcess_FreeRunning.PpDR_Merges_10ms.DeDR_List.DR_List[53].delta_yaw "" VALUE 0x25512ac __FLOAT32_IEEE_S 0 NO_COMPU_METHOD 0 3.402823e+38 ECU_ADDRESS_EXTENSION 0x80 /end CHARACTERISTIC
/begin CHARACTERISTIC CtApImageProcess_FreeRunning.PpDR_Merges_10ms.DeDR_List.DR_List[53].belif "" VALUE 0x25512b0 __FLOAT32_IEEE_S 0 NO_COMPU_METHOD 0 3.402823e+38 ECU_ADDRESS_EXTENSION 0x80 /end CHARACTERISTIC
/begin CHARACTERISTIC CtApImageProcess_FreeRunning.PpDR_Merges_10ms.DeDR_List.DR_List[53].reserved_int "5 uint32 array" VAL_BLK 0x25512b4 __ULONG_S 0 NO_COMPU_METHOD 0 4294967295 ECU_ADDRESS_EXTENSION 0x80 MATRIX_DIM 5 1 1 /end CHARACTERISTIC
/begin CHARACTERISTIC CtApImageProcess_FreeRunning.PpDR_Merges_10ms.DeDR_List.DR_List[54].stHeader.Counter "" VALUE 0x25512c8 __UWORD_S 0 NO_COMPU_METHOD 0 65535 ECU_ADDRESS_EXTENSION 0x80 /end CHARACTERISTIC
/begin CHARACTERISTIC CtApImageProcess_FreeRunning.PpDR_Merges_10ms.DeDR_List.DR_List[54].stHeader.FrameID "" VALUE 0x25512ca __UBYTE_S 0 NO_COMPU_METHOD 0 255 ECU_ADDRESS_EXTENSION 0x80 /end CHARACTERISTIC
/begin CHARACTERISTIC CtApImageProcess_FreeRunning.PpDR_Merges_10ms.DeDR_List.DR_List[54].stHeader.TimeStamp "2 uint32 array" VAL_BLK 0x25512cc __ULONG_S 0 NO_COMPU_METHOD 0 4294967295 ECU_ADDRESS_EXTENSION 0x80 MATRIX_DIM 2 1 1 /end CHARACTERISTIC
/begin CHARACTERISTIC CtApImageProcess_FreeRunning.PpDR_Merges_10ms.DeDR_List.DR_List[54].count "" VALUE 0x25512d4 __UBYTE_S 0 NO_COMPU_METHOD 0 255 ECU_ADDRESS_EXTENSION 0x80 /end CHARACTERISTIC
/begin CHARACTERISTIC CtApImageProcess_FreeRunning.PpDR_Merges_10ms.DeDR_List.DR_List[54].time_sec "" VALUE 0x25512d8 __FLOAT64_IEEE_S 0 NO_COMPU_METHOD 0 3.402823e+38 ECU_ADDRESS_EXTENSION 0x80 /end CHARACTERISTIC
/begin CHARACTERISTIC CtApImageProcess_FreeRunning.PpDR_Merges_10ms.DeDR_List.DR_List[54].utm_x "" VALUE 0x25512e0 __FLOAT64_IEEE_S 0 NO_COMPU_METHOD 0 3.402823e+38 ECU_ADDRESS_EXTENSION 0x80 /end CHARACTERISTIC
/begin CHARACTERISTIC CtApImageProcess_FreeRunning.PpDR_Merges_10ms.DeDR_List.DR_List[54].utm_y "" VALUE 0x25512e8 __FLOAT64_IEEE_S 0 NO_COMPU_METHOD 0 3.402823e+38 ECU_ADDRESS_EXTENSION 0x80 /end CHARACTERISTIC
/begin CHARACTERISTIC CtApImageProcess_FreeRunning.PpDR_Merges_10ms.DeDR_List.DR_List[54].utm_z "" VALUE 0x25512f0 __FLOAT32_IEEE_S 0 NO_COMPU_METHOD 0 3.402823e+38 ECU_ADDRESS_EXTENSION 0x80 /end CHARACTERISTIC
/begin CHARACTERISTIC CtApImageProcess_FreeRunning.PpDR_Merges_10ms.DeDR_List.DR_List[54].heading "" VALUE 0x25512f4 __FLOAT32_IEEE_S 0 NO_COMPU_METHOD 0 3.402823e+38 ECU_ADDRESS_EXTENSION 0x80 /end CHARACTERISTIC
/begin CHARACTERISTIC CtApImageProcess_FreeRunning.PpDR_Merges_10ms.DeDR_List.DR_List[54].delta_x "" VALUE 0x25512f8 __FLOAT32_IEEE_S 0 NO_COMPU_METHOD 0 3.402823e+38 ECU_ADDRESS_EXTENSION 0x80 /end CHARACTERISTIC
/begin CHARACTERISTIC CtApImageProcess_FreeRunning.PpDR_Merges_10ms.DeDR_List.DR_List[54].delta_y "" VALUE 0x25512fc __FLOAT32_IEEE_S 0 NO_COMPU_METHOD 0 3.402823e+38 ECU_ADDRESS_EXTENSION 0x80 /end CHARACTERISTIC
/begin CHARACTERISTIC CtApImageProcess_FreeRunning.PpDR_Merges_10ms.DeDR_List.DR_List[54].delta_z "" VALUE 0x2551300 __FLOAT32_IEEE_S 0 NO_COMPU_METHOD 0 3.402823e+38 ECU_ADDRESS_EXTENSION 0x80 /end CHARACTERISTIC
/begin CHARACTERISTIC CtApImageProcess_FreeRunning.PpDR_Merges_10ms.DeDR_List.DR_List[54].delta_yaw "" VALUE 0x2551304 __FLOAT32_IEEE_S 0 NO_COMPU_METHOD 0 3.402823e+38 ECU_ADDRESS_EXTENSION 0x80 /end CHARACTERISTIC
/begin CHARACTERISTIC CtApImageProcess_FreeRunning.PpDR_Merges_10ms.DeDR_List.DR_List[54].belif "" VALUE 0x2551308 __FLOAT32_IEEE_S 0 NO_COMPU_METHOD 0 3.402823e+38 ECU_ADDRESS_EXTENSION 0x80 /end CHARACTERISTIC
/begin CHARACTERISTIC CtApImageProcess_FreeRunning.PpDR_Merges_10ms.DeDR_List.DR_List[54].reserved_int "5 uint32 array" VAL_BLK 0x255130c __ULONG_S 0 NO_COMPU_METHOD 0 4294967295 ECU_ADDRESS_EXTENSION 0x80 MATRIX_DIM 5 1 1 /end CHARACTERISTIC
/begin CHARACTERISTIC CtApImageProcess_FreeRunning.PpDR_Merges_10ms.DeDR_List.DR_List[55].stHeader.Counter "" VALUE 0x2551320 __UWORD_S 0 NO_COMPU_METHOD 0 65535 ECU_ADDRESS_EXTENSION 0x80 /end CHARACTERISTIC
/begin CHARACTERISTIC CtApImageProcess_FreeRunning.PpDR_Merges_10ms.DeDR_List.DR_List[55].stHeader.FrameID "" VALUE 0x2551322 __UBYTE_S 0 NO_COMPU_METHOD 0 255 ECU_ADDRESS_EXTENSION 0x80 /end CHARACTERISTIC
/begin CHARACTERISTIC CtApImageProcess_FreeRunning.PpDR_Merges_10ms.DeDR_List.DR_List[55].stHeader.TimeStamp "2 uint32 array" VAL_BLK 0x2551324 __ULONG_S 0 NO_COMPU_METHOD 0 4294967295 ECU_ADDRESS_EXTENSION 0x80 MATRIX_DIM 2 1 1 /end CHARACTERISTIC
/begin CHARACTERISTIC CtApImageProcess_FreeRunning.PpDR_Merges_10ms.DeDR_List.DR_List[55].count "" VALUE 0x255132c __UBYTE_S 0 NO_COMPU_METHOD 0 255 ECU_ADDRESS_EXTENSION 0x80 /end CHARACTERISTIC
/begin CHARACTERISTIC CtApImageProcess_FreeRunning.PpDR_Merges_10ms.DeDR_List.DR_List[55].time_sec "" VALUE 0x2551330 __FLOAT64_IEEE_S 0 NO_COMPU_METHOD 0 3.402823e+38 ECU_ADDRESS_EXTENSION 0x80 /end CHARACTERISTIC
/begin CHARACTERISTIC CtApImageProcess_FreeRunning.PpDR_Merges_10ms.DeDR_List.DR_List[55].utm_x "" VALUE 0x2551338 __FLOAT64_IEEE_S 0 NO_COMPU_METHOD 0 3.402823e+38 ECU_ADDRESS_EXTENSION 0x80 /end CHARACTERISTIC
/begin CHARACTERISTIC CtApImageProcess_FreeRunning.PpDR_Merges_10ms.DeDR_List.DR_List[55].utm_y "" VALUE 0x2551340 __FLOAT64_IEEE_S 0 NO_COMPU_METHOD 0 3.402823e+38 ECU_ADDRESS_EXTENSION 0x80 /end CHARACTERISTIC
/begin CHARACTERISTIC CtApImageProcess_FreeRunning.PpDR_Merges_10ms.DeDR_List.DR_List[55].utm_z "" VALUE 0x2551348 __FLOAT32_IEEE_S 0 NO_COMPU_METHOD 0 3.402823e+38 ECU_ADDRESS_EXTENSION 0x80 /end CHARACTERISTIC
/begin CHARACTERISTIC CtApImageProcess_FreeRunning.PpDR_Merges_10ms.DeDR_List.DR_List[55].heading "" VALUE 0x255134c __FLOAT32_IEEE_S 0 NO_COMPU_METHOD 0 3.402823e+38 ECU_ADDRESS_EXTENSION 0x80 /end CHARACTERISTIC
/begin CHARACTERISTIC CtApImageProcess_FreeRunning.PpDR_Merges_10ms.DeDR_List.DR_List[55].delta_x "" VALUE 0x2551350 __FLOAT32_IEEE_S 0 NO_COMPU_METHOD 0 3.402823e+38 ECU_ADDRESS_EXTENSION 0x80 /end CHARACTERISTIC
/begin CHARACTERISTIC CtApImageProcess_FreeRunning.PpDR_Merges_10ms.DeDR_List.DR_List[55].delta_y "" VALUE 0x2551354 __FLOAT32_IEEE_S 0 NO_COMPU_METHOD 0 3.402823e+38 ECU_ADDRESS_EXTENSION 0x80 /end CHARACTERISTIC
/begin CHARACTERISTIC CtApImageProcess_FreeRunning.PpDR_Merges_10ms.DeDR_List.DR_List[55].delta_z "" VALUE 0x2551358 __FLOAT32_IEEE_S 0 NO_COMPU_METHOD 0 3.402823e+38 ECU_ADDRESS_EXTENSION 0x80 /end CHARACTERISTIC
/begin CHARACTERISTIC CtApImageProcess_FreeRunning.PpDR_Merges_10ms.DeDR_List.DR_List[55].delta_yaw "" VALUE 0x255135c __FLOAT32_IEEE_S 0 NO_COMPU_METHOD 0 3.402823e+38 ECU_ADDRESS_EXTENSION 0x80 /end CHARACTERISTIC
/begin CHARACTERISTIC CtApImageProcess_FreeRunning.PpDR_Merges_10ms.DeDR_List.DR_List[55].belif "" VALUE 0x2551360 __FLOAT32_IEEE_S 0 NO_COMPU_METHOD 0 3.402823e+38 ECU_ADDRESS_EXTENSION 0x80 /end CHARACTERISTIC
/begin CHARACTERISTIC CtApImageProcess_FreeRunning.PpDR_Merges_10ms.DeDR_List.DR_List[55].reserved_int "5 uint32 array" VAL_BLK 0x2551364 __ULONG_S 0 NO_COMPU_METHOD 0 4294967295 ECU_ADDRESS_EXTENSION 0x80 MATRIX_DIM 5 1 1 /end CHARACTERISTIC
/begin CHARACTERISTIC CtApImageProcess_FreeRunning.PpDR_Merges_10ms.DeDR_List.DR_List[56].stHeader.Counter "" VALUE 0x2551378 __UWORD_S 0 NO_COMPU_METHOD 0 65535 ECU_ADDRESS_EXTENSION 0x80 /end CHARACTERISTIC
/begin CHARACTERISTIC CtApImageProcess_FreeRunning.PpDR_Merges_10ms.DeDR_List.DR_List[56].stHeader.FrameID "" VALUE 0x255137a __UBYTE_S 0 NO_COMPU_METHOD 0 255 ECU_ADDRESS_EXTENSION 0x80 /end CHARACTERISTIC
/begin CHARACTERISTIC CtApImageProcess_FreeRunning.PpDR_Merges_10ms.DeDR_List.DR_List[56].stHeader.TimeStamp "2 uint32 array" VAL_BLK 0x255137c __ULONG_S 0 NO_COMPU_METHOD 0 4294967295 ECU_ADDRESS_EXTENSION 0x80 MATRIX_DIM 2 1 1 /end CHARACTERISTIC
/begin CHARACTERISTIC CtApImageProcess_FreeRunning.PpDR_Merges_10ms.DeDR_List.DR_List[56].count "" VALUE 0x2551384 __UBYTE_S 0 NO_COMPU_METHOD 0 255 ECU_ADDRESS_EXTENSION 0x80 /end CHARACTERISTIC
/begin CHARACTERISTIC CtApImageProcess_FreeRunning.PpDR_Merges_10ms.DeDR_List.DR_List[56].time_sec "" VALUE 0x2551388 __FLOAT64_IEEE_S 0 NO_COMPU_METHOD 0 3.402823e+38 ECU_ADDRESS_EXTENSION 0x80 /end CHARACTERISTIC
/begin CHARACTERISTIC CtApImageProcess_FreeRunning.PpDR_Merges_10ms.DeDR_List.DR_List[56].utm_x "" VALUE 0x2551390 __FLOAT64_IEEE_S 0 NO_COMPU_METHOD 0 3.402823e+38 ECU_ADDRESS_EXTENSION 0x80 /end CHARACTERISTIC
/begin CHARACTERISTIC CtApImageProcess_FreeRunning.PpDR_Merges_10ms.DeDR_List.DR_List[56].utm_y "" VALUE 0x2551398 __FLOAT64_IEEE_S 0 NO_COMPU_METHOD 0 3.402823e+38 ECU_ADDRESS_EXTENSION 0x80 /end CHARACTERISTIC
/begin CHARACTERISTIC CtApImageProcess_FreeRunning.PpDR_Merges_10ms.DeDR_List.DR_List[56].utm_z "" VALUE 0x25513a0 __FLOAT32_IEEE_S 0 NO_COMPU_METHOD 0 3.402823e+38 ECU_ADDRESS_EXTENSION 0x80 /end CHARACTERISTIC
/begin CHARACTERISTIC CtApImageProcess_FreeRunning.PpDR_Merges_10ms.DeDR_List.DR_List[56].heading "" VALUE 0x25513a4 __FLOAT32_IEEE_S 0 NO_COMPU_METHOD 0 3.402823e+38 ECU_ADDRESS_EXTENSION 0x80 /end CHARACTERISTIC
/begin CHARACTERISTIC CtApImageProcess_FreeRunning.PpDR_Merges_10ms.DeDR_List.DR_List[56].delta_x "" VALUE 0x25513a8 __FLOAT32_IEEE_S 0 NO_COMPU_METHOD 0 3.402823e+38 ECU_ADDRESS_EXTENSION 0x80 /end CHARACTERISTIC
/begin CHARACTERISTIC CtApImageProcess_FreeRunning.PpDR_Merges_10ms.DeDR_List.DR_List[56].delta_y "" VALUE 0x25513ac __FLOAT32_IEEE_S 0 NO_COMPU_METHOD 0 3.402823e+38 ECU_ADDRESS_EXTENSION 0x80 /end CHARACTERISTIC
/begin CHARACTERISTIC CtApImageProcess_FreeRunning.PpDR_Merges_10ms.DeDR_List.DR_List[56].delta_z "" VALUE 0x25513b0 __FLOAT32_IEEE_S 0 NO_COMPU_METHOD 0 3.402823e+38 ECU_ADDRESS_EXTENSION 0x80 /end CHARACTERISTIC
/begin CHARACTERISTIC CtApImageProcess_FreeRunning.PpDR_Merges_10ms.DeDR_List.DR_List[56].delta_yaw "" VALUE 0x25513b4 __FLOAT32_IEEE_S 0 NO_COMPU_METHOD 0 3.402823e+38 ECU_ADDRESS_EXTENSION 0x80 /end CHARACTERISTIC
/begin CHARACTERISTIC CtApImageProcess_FreeRunning.PpDR_Merges_10ms.DeDR_List.DR_List[56].belif "" VALUE 0x25513b8 __FLOAT32_IEEE_S 0 NO_COMPU_METHOD 0 3.402823e+38 ECU_ADDRESS_EXTENSION 0x80 /end CHARACTERISTIC
/begin CHARACTERISTIC CtApImageProcess_FreeRunning.PpDR_Merges_10ms.DeDR_List.DR_List[56].reserved_int "5 uint32 array" VAL_BLK 0x25513bc __ULONG_S 0 NO_COMPU_METHOD 0 4294967295 ECU_ADDRESS_EXTENSION 0x80 MATRIX_DIM 5 1 1 /end CHARACTERISTIC
/begin CHARACTERISTIC CtApImageProcess_FreeRunning.PpDR_Merges_10ms.DeDR_List.DR_List[57].stHeader.Counter "" VALUE 0x25513d0 __UWORD_S 0 NO_COMPU_METHOD 0 65535 ECU_ADDRESS_EXTENSION 0x80 /end CHARACTERISTIC
/begin CHARACTERISTIC CtApImageProcess_FreeRunning.PpDR_Merges_10ms.DeDR_List.DR_List[57].stHeader.FrameID "" VALUE 0x25513d2 __UBYTE_S 0 NO_COMPU_METHOD 0 255 ECU_ADDRESS_EXTENSION 0x80 /end CHARACTERISTIC
/begin CHARACTERISTIC CtApImageProcess_FreeRunning.PpDR_Merges_10ms.DeDR_List.DR_List[57].stHeader.TimeStamp "2 uint32 array" VAL_BLK 0x25513d4 __ULONG_S 0 NO_COMPU_METHOD 0 4294967295 ECU_ADDRESS_EXTENSION 0x80 MATRIX_DIM 2 1 1 /end CHARACTERISTIC
/begin CHARACTERISTIC CtApImageProcess_FreeRunning.PpDR_Merges_10ms.DeDR_List.DR_List[57].count "" VALUE 0x25513dc __UBYTE_S 0 NO_COMPU_METHOD 0 255 ECU_ADDRESS_EXTENSION 0x80 /end CHARACTERISTIC
/begin CHARACTERISTIC CtApImageProcess_FreeRunning.PpDR_Merges_10ms.DeDR_List.DR_List[57].time_sec "" VALUE 0x25513e0 __FLOAT64_IEEE_S 0 NO_COMPU_METHOD 0 3.402823e+38 ECU_ADDRESS_EXTENSION 0x80 /end CHARACTERISTIC
/begin CHARACTERISTIC CtApImageProcess_FreeRunning.PpDR_Merges_10ms.DeDR_List.DR_List[57].utm_x "" VALUE 0x25513e8 __FLOAT64_IEEE_S 0 NO_COMPU_METHOD 0 3.402823e+38 ECU_ADDRESS_EXTENSION 0x80 /end CHARACTERISTIC
/begin CHARACTERISTIC CtApImageProcess_FreeRunning.PpDR_Merges_10ms.DeDR_List.DR_List[57].utm_y "" VALUE 0x25513f0 __FLOAT64_IEEE_S 0 NO_COMPU_METHOD 0 3.402823e+38 ECU_ADDRESS_EXTENSION 0x80 /end CHARACTERISTIC
/begin CHARACTERISTIC CtApImageProcess_FreeRunning.PpDR_Merges_10ms.DeDR_List.DR_List[57].utm_z "" VALUE 0x25513f8 __FLOAT32_IEEE_S 0 NO_COMPU_METHOD 0 3.402823e+38 ECU_ADDRESS_EXTENSION 0x80 /end CHARACTERISTIC
/begin CHARACTERISTIC CtApImageProcess_FreeRunning.PpDR_Merges_10ms.DeDR_List.DR_List[57].heading "" VALUE 0x25513fc __FLOAT32_IEEE_S 0 NO_COMPU_METHOD 0 3.402823e+38 ECU_ADDRESS_EXTENSION 0x80 /end CHARACTERISTIC
/begin CHARACTERISTIC CtApImageProcess_FreeRunning.PpDR_Merges_10ms.DeDR_List.DR_List[57].delta_x "" VALUE 0x2551400 __FLOAT32_IEEE_S 0 NO_COMPU_METHOD 0 3.402823e+38 ECU_ADDRESS_EXTENSION 0x80 /end CHARACTERISTIC
/begin CHARACTERISTIC CtApImageProcess_FreeRunning.PpDR_Merges_10ms.DeDR_List.DR_List[57].delta_y "" VALUE 0x2551404 __FLOAT32_IEEE_S 0 NO_COMPU_METHOD 0 3.402823e+38 ECU_ADDRESS_EXTENSION 0x80 /end CHARACTERISTIC
/begin CHARACTERISTIC CtApImageProcess_FreeRunning.PpDR_Merges_10ms.DeDR_List.DR_List[57].delta_z "" VALUE 0x2551408 __FLOAT32_IEEE_S 0 NO_COMPU_METHOD 0 3.402823e+38 ECU_ADDRESS_EXTENSION 0x80 /end CHARACTERISTIC
/begin CHARACTERISTIC CtApImageProcess_FreeRunning.PpDR_Merges_10ms.DeDR_List.DR_List[57].delta_yaw "" VALUE 0x255140c __FLOAT32_IEEE_S 0 NO_COMPU_METHOD 0 3.402823e+38 ECU_ADDRESS_EXTENSION 0x80 /end CHARACTERISTIC
/begin CHARACTERISTIC CtApImageProcess_FreeRunning.PpDR_Merges_10ms.DeDR_List.DR_List[57].belif "" VALUE 0x2551410 __FLOAT32_IEEE_S 0 NO_COMPU_METHOD 0 3.402823e+38 ECU_ADDRESS_EXTENSION 0x80 /end CHARACTERISTIC
/begin CHARACTERISTIC CtApImageProcess_FreeRunning.PpDR_Merges_10ms.DeDR_List.DR_List[57].reserved_int "5 uint32 array" VAL_BLK 0x2551414 __ULONG_S 0 NO_COMPU_METHOD 0 4294967295 ECU_ADDRESS_EXTENSION 0x80 MATRIX_DIM 5 1 1 /end CHARACTERISTIC
/begin CHARACTERISTIC CtApImageProcess_FreeRunning.PpDR_Merges_10ms.DeDR_List.DR_List[58].stHeader.Counter "" VALUE 0x2551428 __UWORD_S 0 NO_COMPU_METHOD 0 65535 ECU_ADDRESS_EXTENSION 0x80 /end CHARACTERISTIC
/begin CHARACTERISTIC CtApImageProcess_FreeRunning.PpDR_Merges_10ms.DeDR_List.DR_List[58].stHeader.FrameID "" VALUE 0x255142a __UBYTE_S 0 NO_COMPU_METHOD 0 255 ECU_ADDRESS_EXTENSION 0x80 /end CHARACTERISTIC
/begin CHARACTERISTIC CtApImageProcess_FreeRunning.PpDR_Merges_10ms.DeDR_List.DR_List[58].stHeader.TimeStamp "2 uint32 array" VAL_BLK 0x255142c __ULONG_S 0 NO_COMPU_METHOD 0 4294967295 ECU_ADDRESS_EXTENSION 0x80 MATRIX_DIM 2 1 1 /end CHARACTERISTIC
/begin CHARACTERISTIC CtApImageProcess_FreeRunning.PpDR_Merges_10ms.DeDR_List.DR_List[58].count "" VALUE 0x2551434 __UBYTE_S 0 NO_COMPU_METHOD 0 255 ECU_ADDRESS_EXTENSION 0x80 /end CHARACTERISTIC
/begin CHARACTERISTIC CtApImageProcess_FreeRunning.PpDR_Merges_10ms.DeDR_List.DR_List[58].time_sec "" VALUE 0x2551438 __FLOAT64_IEEE_S 0 NO_COMPU_METHOD 0 3.402823e+38 ECU_ADDRESS_EXTENSION 0x80 /end CHARACTERISTIC
/begin CHARACTERISTIC CtApImageProcess_FreeRunning.PpDR_Merges_10ms.DeDR_List.DR_List[58].utm_x "" VALUE 0x2551440 __FLOAT64_IEEE_S 0 NO_COMPU_METHOD 0 3.402823e+38 ECU_ADDRESS_EXTENSION 0x80 /end CHARACTERISTIC
/begin CHARACTERISTIC CtApImageProcess_FreeRunning.PpDR_Merges_10ms.DeDR_List.DR_List[58].utm_y "" VALUE 0x2551448 __FLOAT64_IEEE_S 0 NO_COMPU_METHOD 0 3.402823e+38 ECU_ADDRESS_EXTENSION 0x80 /end CHARACTERISTIC
/begin CHARACTERISTIC CtApImageProcess_FreeRunning.PpDR_Merges_10ms.DeDR_List.DR_List[58].utm_z "" VALUE 0x2551450 __FLOAT32_IEEE_S 0 NO_COMPU_METHOD 0 3.402823e+38 ECU_ADDRESS_EXTENSION 0x80 /end CHARACTERISTIC
/begin CHARACTERISTIC CtApImageProcess_FreeRunning.PpDR_Merges_10ms.DeDR_List.DR_List[58].heading "" VALUE 0x2551454 __FLOAT32_IEEE_S 0 NO_COMPU_METHOD 0 3.402823e+38 ECU_ADDRESS_EXTENSION 0x80 /end CHARACTERISTIC
/begin CHARACTERISTIC CtApImageProcess_FreeRunning.PpDR_Merges_10ms.DeDR_List.DR_List[58].delta_x "" VALUE 0x2551458 __FLOAT32_IEEE_S 0 NO_COMPU_METHOD 0 3.402823e+38 ECU_ADDRESS_EXTENSION 0x80 /end CHARACTERISTIC
/begin CHARACTERISTIC CtApImageProcess_FreeRunning.PpDR_Merges_10ms.DeDR_List.DR_List[58].delta_y "" VALUE 0x255145c __FLOAT32_IEEE_S 0 NO_COMPU_METHOD 0 3.402823e+38 ECU_ADDRESS_EXTENSION 0x80 /end CHARACTERISTIC
/begin CHARACTERISTIC CtApImageProcess_FreeRunning.PpDR_Merges_10ms.DeDR_List.DR_List[58].delta_z "" VALUE 0x2551460 __FLOAT32_IEEE_S 0 NO_COMPU_METHOD 0 3.402823e+38 ECU_ADDRESS_EXTENSION 0x80 /end CHARACTERISTIC
/begin CHARACTERISTIC CtApImageProcess_FreeRunning.PpDR_Merges_10ms.DeDR_List.DR_List[58].delta_yaw "" VALUE 0x2551464 __FLOAT32_IEEE_S 0 NO_COMPU_METHOD 0 3.402823e+38 ECU_ADDRESS_EXTENSION 0x80 /end CHARACTERISTIC
/begin CHARACTERISTIC CtApImageProcess_FreeRunning.PpDR_Merges_10ms.DeDR_List.DR_List[58].belif "" VALUE 0x2551468 __FLOAT32_IEEE_S 0 NO_COMPU_METHOD 0 3.402823e+38 ECU_ADDRESS_EXTENSION 0x80 /end CHARACTERISTIC
/begin CHARACTERISTIC CtApImageProcess_FreeRunning.PpDR_Merges_10ms.DeDR_List.DR_List[58].reserved_int "5 uint32 array" VAL_BLK 0x255146c __ULONG_S 0 NO_COMPU_METHOD 0 4294967295 ECU_ADDRESS_EXTENSION 0x80 MATRIX_DIM 5 1 1 /end CHARACTERISTIC
/begin CHARACTERISTIC CtApImageProcess_FreeRunning.PpDR_Merges_10ms.DeDR_List.DR_List[59].stHeader.Counter "" VALUE 0x2551480 __UWORD_S 0 NO_COMPU_METHOD 0 65535 ECU_ADDRESS_EXTENSION 0x80 /end CHARACTERISTIC
/begin CHARACTERISTIC CtApImageProcess_FreeRunning.PpDR_Merges_10ms.DeDR_List.DR_List[59].stHeader.FrameID "" VALUE 0x2551482 __UBYTE_S 0 NO_COMPU_METHOD 0 255 ECU_ADDRESS_EXTENSION 0x80 /end CHARACTERISTIC
/begin CHARACTERISTIC CtApImageProcess_FreeRunning.PpDR_Merges_10ms.DeDR_List.DR_List[59].stHeader.TimeStamp "2 uint32 array" VAL_BLK 0x2551484 __ULONG_S 0 NO_COMPU_METHOD 0 4294967295 ECU_ADDRESS_EXTENSION 0x80 MATRIX_DIM 2 1 1 /end CHARACTERISTIC
/begin CHARACTERISTIC CtApImageProcess_FreeRunning.PpDR_Merges_10ms.DeDR_List.DR_List[59].count "" VALUE 0x255148c __UBYTE_S 0 NO_COMPU_METHOD 0 255 ECU_ADDRESS_EXTENSION 0x80 /end CHARACTERISTIC
/begin CHARACTERISTIC CtApImageProcess_FreeRunning.PpDR_Merges_10ms.DeDR_List.DR_List[59].time_sec "" VALUE 0x2551490 __FLOAT64_IEEE_S 0 NO_COMPU_METHOD 0 3.402823e+38 ECU_ADDRESS_EXTENSION 0x80 /end CHARACTERISTIC
/begin CHARACTERISTIC CtApImageProcess_FreeRunning.PpDR_Merges_10ms.DeDR_List.DR_List[59].utm_x "" VALUE 0x2551498 __FLOAT64_IEEE_S 0 NO_COMPU_METHOD 0 3.402823e+38 ECU_ADDRESS_EXTENSION 0x80 /end CHARACTERISTIC
/begin CHARACTERISTIC CtApImageProcess_FreeRunning.PpDR_Merges_10ms.DeDR_List.DR_List[59].utm_y "" VALUE 0x25514a0 __FLOAT64_IEEE_S 0 NO_COMPU_METHOD 0 3.402823e+38 ECU_ADDRESS_EXTENSION 0x80 /end CHARACTERISTIC
/begin CHARACTERISTIC CtApImageProcess_FreeRunning.PpDR_Merges_10ms.DeDR_List.DR_List[59].utm_z "" VALUE 0x25514a8 __FLOAT32_IEEE_S 0 NO_COMPU_METHOD 0 3.402823e+38 ECU_ADDRESS_EXTENSION 0x80 /end CHARACTERISTIC
/begin CHARACTERISTIC CtApImageProcess_FreeRunning.PpDR_Merges_10ms.DeDR_List.DR_List[59].heading "" VALUE 0x25514ac __FLOAT32_IEEE_S 0 NO_COMPU_METHOD 0 3.402823e+38 ECU_ADDRESS_EXTENSION 0x80 /end CHARACTERISTIC
/begin CHARACTERISTIC CtApImageProcess_FreeRunning.PpDR_Merges_10ms.DeDR_List.DR_List[59].delta_x "" VALUE 0x25514b0 __FLOAT32_IEEE_S 0 NO_COMPU_METHOD 0 3.402823e+38 ECU_ADDRESS_EXTENSION 0x80 /end CHARACTERISTIC
/begin CHARACTERISTIC CtApImageProcess_FreeRunning.PpDR_Merges_10ms.DeDR_List.DR_List[59].delta_y "" VALUE 0x25514b4 __FLOAT32_IEEE_S 0 NO_COMPU_METHOD 0 3.402823e+38 ECU_ADDRESS_EXTENSION 0x80 /end CHARACTERISTIC
/begin CHARACTERISTIC CtApImageProcess_FreeRunning.PpDR_Merges_10ms.DeDR_List.DR_List[59].delta_z "" VALUE 0x25514b8 __FLOAT32_IEEE_S 0 NO_COMPU_METHOD 0 3.402823e+38 ECU_ADDRESS_EXTENSION 0x80 /end CHARACTERISTIC
/begin CHARACTERISTIC CtApImageProcess_FreeRunning.PpDR_Merges_10ms.DeDR_List.DR_List[59].delta_yaw "" VALUE 0x25514bc __FLOAT32_IEEE_S 0 NO_COMPU_METHOD 0 3.402823e+38 ECU_ADDRESS_EXTENSION 0x80 /end CHARACTERISTIC
/begin CHARACTERISTIC CtApImageProcess_FreeRunning.PpDR_Merges_10ms.DeDR_List.DR_List[59].belif "" VALUE 0x25514c0 __FLOAT32_IEEE_S 0 NO_COMPU_METHOD 0 3.402823e+38 ECU_ADDRESS_EXTENSION 0x80 /end CHARACTERISTIC
/begin CHARACTERISTIC CtApImageProcess_FreeRunning.PpDR_Merges_10ms.DeDR_List.DR_List[59].reserved_int "5 uint32 array" VAL_BLK 0x25514c4 __ULONG_S 0 NO_COMPU_METHOD 0 4294967295 ECU_ADDRESS_EXTENSION 0x80 MATRIX_DIM 5 1 1 /end CHARACTERISTIC
/begin CHARACTERISTIC CtApImageProcess_FreeRunning.PpDR_Merges_10ms.DeDR_List.DR_List[60].stHeader.Counter "" VALUE 0x25514d8 __UWORD_S 0 NO_COMPU_METHOD 0 65535 ECU_ADDRESS_EXTENSION 0x80 /end CHARACTERISTIC
/begin CHARACTERISTIC CtApImageProcess_FreeRunning.PpDR_Merges_10ms.DeDR_List.DR_List[60].stHeader.FrameID "" VALUE 0x25514da __UBYTE_S 0 NO_COMPU_METHOD 0 255 ECU_ADDRESS_EXTENSION 0x80 /end CHARACTERISTIC
/begin CHARACTERISTIC CtApImageProcess_FreeRunning.PpDR_Merges_10ms.DeDR_List.DR_List[60].stHeader.TimeStamp "2 uint32 array" VAL_BLK 0x25514dc __ULONG_S 0 NO_COMPU_METHOD 0 4294967295 ECU_ADDRESS_EXTENSION 0x80 MATRIX_DIM 2 1 1 /end CHARACTERISTIC
/begin CHARACTERISTIC CtApImageProcess_FreeRunning.PpDR_Merges_10ms.DeDR_List.DR_List[60].count "" VALUE 0x25514e4 __UBYTE_S 0 NO_COMPU_METHOD 0 255 ECU_ADDRESS_EXTENSION 0x80 /end CHARACTERISTIC
/begin CHARACTERISTIC CtApImageProcess_FreeRunning.PpDR_Merges_10ms.DeDR_List.DR_List[60].time_sec "" VALUE 0x25514e8 __FLOAT64_IEEE_S 0 NO_COMPU_METHOD 0 3.402823e+38 ECU_ADDRESS_EXTENSION 0x80 /end CHARACTERISTIC
/begin CHARACTERISTIC CtApImageProcess_FreeRunning.PpDR_Merges_10ms.DeDR_List.DR_List[60].utm_x "" VALUE 0x25514f0 __FLOAT64_IEEE_S 0 NO_COMPU_METHOD 0 3.402823e+38 ECU_ADDRESS_EXTENSION 0x80 /end CHARACTERISTIC
/begin CHARACTERISTIC CtApImageProcess_FreeRunning.PpDR_Merges_10ms.DeDR_List.DR_List[60].utm_y "" VALUE 0x25514f8 __FLOAT64_IEEE_S 0 NO_COMPU_METHOD 0 3.402823e+38 ECU_ADDRESS_EXTENSION 0x80 /end CHARACTERISTIC
/begin CHARACTERISTIC CtApImageProcess_FreeRunning.PpDR_Merges_10ms.DeDR_List.DR_List[60].utm_z "" VALUE 0x2551500 __FLOAT32_IEEE_S 0 NO_COMPU_METHOD 0 3.402823e+38 ECU_ADDRESS_EXTENSION 0x80 /end CHARACTERISTIC
/begin CHARACTERISTIC CtApImageProcess_FreeRunning.PpDR_Merges_10ms.DeDR_List.DR_List[60].heading "" VALUE 0x2551504 __FLOAT32_IEEE_S 0 NO_COMPU_METHOD 0 3.402823e+38 ECU_ADDRESS_EXTENSION 0x80 /end CHARACTERISTIC
/begin CHARACTERISTIC CtApImageProcess_FreeRunning.PpDR_Merges_10ms.DeDR_List.DR_List[60].delta_x "" VALUE 0x2551508 __FLOAT32_IEEE_S 0 NO_COMPU_METHOD 0 3.402823e+38 ECU_ADDRESS_EXTENSION 0x80 /end CHARACTERISTIC
/begin CHARACTERISTIC CtApImageProcess_FreeRunning.PpDR_Merges_10ms.DeDR_List.DR_List[60].delta_y "" VALUE 0x255150c __FLOAT32_IEEE_S 0 NO_COMPU_METHOD 0 3.402823e+38 ECU_ADDRESS_EXTENSION 0x80 /end CHARACTERISTIC
/begin CHARACTERISTIC CtApImageProcess_FreeRunning.PpDR_Merges_10ms.DeDR_List.DR_List[60].delta_z "" VALUE 0x2551510 __FLOAT32_IEEE_S 0 NO_COMPU_METHOD 0 3.402823e+38 ECU_ADDRESS_EXTENSION 0x80 /end CHARACTERISTIC
/begin CHARACTERISTIC CtApImageProcess_FreeRunning.PpDR_Merges_10ms.DeDR_List.DR_List[60].delta_yaw "" VALUE 0x2551514 __FLOAT32_IEEE_S 0 NO_COMPU_METHOD 0 3.402823e+38 ECU_ADDRESS_EXTENSION 0x80 /end CHARACTERISTIC
/begin CHARACTERISTIC CtApImageProcess_FreeRunning.PpDR_Merges_10ms.DeDR_List.DR_List[60].belif "" VALUE 0x2551518 __FLOAT32_IEEE_S 0 NO_COMPU_METHOD 0 3.402823e+38 ECU_ADDRESS_EXTENSION 0x80 /end CHARACTERISTIC
/begin CHARACTERISTIC CtApImageProcess_FreeRunning.PpDR_Merges_10ms.DeDR_List.DR_List[60].reserved_int "5 uint32 array" VAL_BLK 0x255151c __ULONG_S 0 NO_COMPU_METHOD 0 4294967295 ECU_ADDRESS_EXTENSION 0x80 MATRIX_DIM 5 1 1 /end CHARACTERISTIC
/begin CHARACTERISTIC CtApImageProcess_FreeRunning.PpDR_Merges_10ms.DeDR_List.DR_List[61].stHeader.Counter "" VALUE 0x2551530 __UWORD_S 0 NO_COMPU_METHOD 0 65535 ECU_ADDRESS_EXTENSION 0x80 /end CHARACTERISTIC
/begin CHARACTERISTIC CtApImageProcess_FreeRunning.PpDR_Merges_10ms.DeDR_List.DR_List[61].stHeader.FrameID "" VALUE 0x2551532 __UBYTE_S 0 NO_COMPU_METHOD 0 255 ECU_ADDRESS_EXTENSION 0x80 /end CHARACTERISTIC
/begin CHARACTERISTIC CtApImageProcess_FreeRunning.PpDR_Merges_10ms.DeDR_List.DR_List[61].stHeader.TimeStamp "2 uint32 array" VAL_BLK 0x2551534 __ULONG_S 0 NO_COMPU_METHOD 0 4294967295 ECU_ADDRESS_EXTENSION 0x80 MATRIX_DIM 2 1 1 /end CHARACTERISTIC
/begin CHARACTERISTIC CtApImageProcess_FreeRunning.PpDR_Merges_10ms.DeDR_List.DR_List[61].count "" VALUE 0x255153c __UBYTE_S 0 NO_COMPU_METHOD 0 255 ECU_ADDRESS_EXTENSION 0x80 /end CHARACTERISTIC
/begin CHARACTERISTIC CtApImageProcess_FreeRunning.PpDR_Merges_10ms.DeDR_List.DR_List[61].time_sec "" VALUE 0x2551540 __FLOAT64_IEEE_S 0 NO_COMPU_METHOD 0 3.402823e+38 ECU_ADDRESS_EXTENSION 0x80 /end CHARACTERISTIC
/begin CHARACTERISTIC CtApImageProcess_FreeRunning.PpDR_Merges_10ms.DeDR_List.DR_List[61].utm_x "" VALUE 0x2551548 __FLOAT64_IEEE_S 0 NO_COMPU_METHOD 0 3.402823e+38 ECU_ADDRESS_EXTENSION 0x80 /end CHARACTERISTIC
/begin CHARACTERISTIC CtApImageProcess_FreeRunning.PpDR_Merges_10ms.DeDR_List.DR_List[61].utm_y "" VALUE 0x2551550 __FLOAT64_IEEE_S 0 NO_COMPU_METHOD 0 3.402823e+38 ECU_ADDRESS_EXTENSION 0x80 /end CHARACTERISTIC
/begin CHARACTERISTIC CtApImageProcess_FreeRunning.PpDR_Merges_10ms.DeDR_List.DR_List[61].utm_z "" VALUE 0x2551558 __FLOAT32_IEEE_S 0 NO_COMPU_METHOD 0 3.402823e+38 ECU_ADDRESS_EXTENSION 0x80 /end CHARACTERISTIC
/begin CHARACTERISTIC CtApImageProcess_FreeRunning.PpDR_Merges_10ms.DeDR_List.DR_List[61].heading "" VALUE 0x255155c __FLOAT32_IEEE_S 0 NO_COMPU_METHOD 0 3.402823e+38 ECU_ADDRESS_EXTENSION 0x80 /end CHARACTERISTIC
/begin CHARACTERISTIC CtApImageProcess_FreeRunning.PpDR_Merges_10ms.DeDR_List.DR_List[61].delta_x "" VALUE 0x2551560 __FLOAT32_IEEE_S 0 NO_COMPU_METHOD 0 3.402823e+38 ECU_ADDRESS_EXTENSION 0x80 /end CHARACTERISTIC
/begin CHARACTERISTIC CtApImageProcess_FreeRunning.PpDR_Merges_10ms.DeDR_List.DR_List[61].delta_y "" VALUE 0x2551564 __FLOAT32_IEEE_S 0 NO_COMPU_METHOD 0 3.402823e+38 ECU_ADDRESS_EXTENSION 0x80 /end CHARACTERISTIC
/begin CHARACTERISTIC CtApImageProcess_FreeRunning.PpDR_Merges_10ms.DeDR_List.DR_List[61].delta_z "" VALUE 0x2551568 __FLOAT32_IEEE_S 0 NO_COMPU_METHOD 0 3.402823e+38 ECU_ADDRESS_EXTENSION 0x80 /end CHARACTERISTIC
/begin CHARACTERISTIC CtApImageProcess_FreeRunning.PpDR_Merges_10ms.DeDR_List.DR_List[61].delta_yaw "" VALUE 0x255156c __FLOAT32_IEEE_S 0 NO_COMPU_METHOD 0 3.402823e+38 ECU_ADDRESS_EXTENSION 0x80 /end CHARACTERISTIC
/begin CHARACTERISTIC CtApImageProcess_FreeRunning.PpDR_Merges_10ms.DeDR_List.DR_List[61].belif "" VALUE 0x2551570 __FLOAT32_IEEE_S 0 NO_COMPU_METHOD 0 3.402823e+38 ECU_ADDRESS_EXTENSION 0x80 /end CHARACTERISTIC
/begin CHARACTERISTIC CtApImageProcess_FreeRunning.PpDR_Merges_10ms.DeDR_List.DR_List[61].reserved_int "5 uint32 array" VAL_BLK 0x2551574 __ULONG_S 0 NO_COMPU_METHOD 0 4294967295 ECU_ADDRESS_EXTENSION 0x80 MATRIX_DIM 5 1 1 /end CHARACTERISTIC
/begin CHARACTERISTIC CtApImageProcess_FreeRunning.PpDR_Merges_10ms.DeDR_List.DR_List[62].stHeader.Counter "" VALUE 0x2551588 __UWORD_S 0 NO_COMPU_METHOD 0 65535 ECU_ADDRESS_EXTENSION 0x80 /end CHARACTERISTIC
/begin CHARACTERISTIC CtApImageProcess_FreeRunning.PpDR_Merges_10ms.DeDR_List.DR_List[62].stHeader.FrameID "" VALUE 0x255158a __UBYTE_S 0 NO_COMPU_METHOD 0 255 ECU_ADDRESS_EXTENSION 0x80 /end CHARACTERISTIC
/begin CHARACTERISTIC CtApImageProcess_FreeRunning.PpDR_Merges_10ms.DeDR_List.DR_List[62].stHeader.TimeStamp "2 uint32 array" VAL_BLK 0x255158c __ULONG_S 0 NO_COMPU_METHOD 0 4294967295 ECU_ADDRESS_EXTENSION 0x80 MATRIX_DIM 2 1 1 /end CHARACTERISTIC
/begin CHARACTERISTIC CtApImageProcess_FreeRunning.PpDR_Merges_10ms.DeDR_List.DR_List[62].count "" VALUE 0x2551594 __UBYTE_S 0 NO_COMPU_METHOD 0 255 ECU_ADDRESS_EXTENSION 0x80 /end CHARACTERISTIC
/begin CHARACTERISTIC CtApImageProcess_FreeRunning.PpDR_Merges_10ms.DeDR_List.DR_List[62].time_sec "" VALUE 0x2551598 __FLOAT64_IEEE_S 0 NO_COMPU_METHOD 0 3.402823e+38 ECU_ADDRESS_EXTENSION 0x80 /end CHARACTERISTIC
/begin CHARACTERISTIC CtApImageProcess_FreeRunning.PpDR_Merges_10ms.DeDR_List.DR_List[62].utm_x "" VALUE 0x25515a0 __FLOAT64_IEEE_S 0 NO_COMPU_METHOD 0 3.402823e+38 ECU_ADDRESS_EXTENSION 0x80 /end CHARACTERISTIC
/begin CHARACTERISTIC CtApImageProcess_FreeRunning.PpDR_Merges_10ms.DeDR_List.DR_List[62].utm_y "" VALUE 0x25515a8 __FLOAT64_IEEE_S 0 NO_COMPU_METHOD 0 3.402823e+38 ECU_ADDRESS_EXTENSION 0x80 /end CHARACTERISTIC
/begin CHARACTERISTIC CtApImageProcess_FreeRunning.PpDR_Merges_10ms.DeDR_List.DR_List[62].utm_z "" VALUE 0x25515b0 __FLOAT32_IEEE_S 0 NO_COMPU_METHOD 0 3.402823e+38 ECU_ADDRESS_EXTENSION 0x80 /end CHARACTERISTIC
/begin CHARACTERISTIC CtApImageProcess_FreeRunning.PpDR_Merges_10ms.DeDR_List.DR_List[62].heading "" VALUE 0x25515b4 __FLOAT32_IEEE_S 0 NO_COMPU_METHOD 0 3.402823e+38 ECU_ADDRESS_EXTENSION 0x80 /end CHARACTERISTIC
/begin CHARACTERISTIC CtApImageProcess_FreeRunning.PpDR_Merges_10ms.DeDR_List.DR_List[62].delta_x "" VALUE 0x25515b8 __FLOAT32_IEEE_S 0 NO_COMPU_METHOD 0 3.402823e+38 ECU_ADDRESS_EXTENSION 0x80 /end CHARACTERISTIC
/begin CHARACTERISTIC CtApImageProcess_FreeRunning.PpDR_Merges_10ms.DeDR_List.DR_List[62].delta_y "" VALUE 0x25515bc __FLOAT32_IEEE_S 0 NO_COMPU_METHOD 0 3.402823e+38 ECU_ADDRESS_EXTENSION 0x80 /end CHARACTERISTIC
/begin GROUP CtApImageProcess_FreeRunning_xcp_kvs_group "MotinWise KVS characteristic group" ROOT
 /begin REF_CHARACTERISTIC CtApImageProcess_FreeRunning.PpDR_Merges_10ms.DeDR_List.DR_List[19].stHeader.TimeStamp CtApImageProcess_FreeRunning.PpDR_Merges_10ms.DeDR_List.DR_List[19].count CtApImageProcess_FreeRunning.PpDR_Merges_10ms.DeDR_List.DR_List[19].time_sec CtApImageProcess_FreeRunning.PpDR_Merges_10ms.DeDR_List.DR_List[19].utm_x CtApImageProcess_FreeRunning.PpDR_Merges_10ms.DeDR_List.DR_List[19].utm_y CtApImageProcess_FreeRunning.PpDR_Merges_10ms.DeDR_List.DR_List[19].utm_z CtApImageProcess_FreeRunning.PpDR_Merges_10ms.DeDR_List.DR_List[19].heading CtApImageProcess_FreeRunning.PpDR_Merges_10ms.DeDR_List.DR_List[19].delta_x CtApImageProcess_FreeRunning.PpDR_Merges_10ms.DeDR_List.DR_List[19].delta_y CtApImageProcess_FreeRunning.PpDR_Merges_10ms.DeDR_List.DR_List[19].delta_z CtApImageProcess_FreeRunning.PpDR_Merges_10ms.DeDR_List.DR_List[19].delta_yaw CtApImageProcess_FreeRunning.PpDR_Merges_10ms.DeDR_List.DR_List[19].belif CtApImageProcess_FreeRunning.PpDR_Merges_10ms.DeDR_List.DR_List[19].reserved_int CtApImageProcess_FreeRunning.PpDR_Merges_10ms.DeDR_List.DR_List[20].stHeader.Counter CtApImageProcess_FreeRunning.PpDR_Merges_10ms.DeDR_List.DR_List[20].stHeader.FrameID CtApImageProcess_FreeRunning.PpDR_Merges_10ms.DeDR_List.DR_List[20].stHeader.TimeStamp CtApImageProcess_FreeRunning.PpDR_Merges_10ms.DeDR_List.DR_List[20].count CtApImageProcess_FreeRunning.PpDR_Merges_10ms.DeDR_List.DR_List[20].time_sec CtApImageProcess_FreeRunning.PpDR_Merges_10ms.DeDR_List.DR_List[20].utm_x CtApImageProcess_FreeRunning.PpDR_Merges_10ms.DeDR_List.DR_List[20].utm_y CtApImageProcess_FreeRunning.PpDR_Merges_10ms.DeDR_List.DR_List[20].utm_z CtApImageProcess_FreeRunning.PpDR_Merges_10ms.DeDR_List.DR_List[20].heading CtApImageProcess_FreeRunning.PpDR_Merges_10ms.DeDR_List.DR_List[20].delta_x CtApImageProcess_FreeRunning.PpDR_Merges_10ms.DeDR_List.DR_List[20].delta_y CtApImageProcess_FreeRunning.PpDR_Merges_10ms.DeDR_List.DR_List[20].delta_z CtApImageProcess_FreeRunning.PpDR_Merges_10ms.DeDR_List.DR_List[20].delta_yaw CtApImageProcess_FreeRunning.PpDR_Merges_10ms.DeDR_List.DR_List[20].belif CtApImageProcess_FreeRunning.PpDR_Merges_10ms.DeDR_List.DR_List[20].reserved_int CtApImageProcess_FreeRunning.PpDR_Merges_10ms.DeDR_List.DR_List[21].stHeader.Counter CtApImageProcess_FreeRunning.PpDR_Merges_10ms.DeDR_List.DR_List[21].stHeader.FrameID CtApImageProcess_FreeRunning.PpDR_Merges_10ms.DeDR_List.DR_List[21].stHeader.TimeStamp CtApImageProcess_FreeRunning.PpDR_Merges_10ms.DeDR_List.DR_List[21].count CtApImageProcess_FreeRunning.PpDR_Merges_10ms.DeDR_List.DR_List[21].time_sec CtApImageProcess_FreeRunning.PpDR_Merges_10ms.DeDR_List.DR_List[21].utm_x CtApImageProcess_FreeRunning.PpDR_Merges_10ms.DeDR_List.DR_List[21].utm_y CtApImageProcess_FreeRunning.PpDR_Merges_10ms.DeDR_List.DR_List[21].utm_z CtApImageProcess_FreeRunning.PpDR_Merges_10ms.DeDR_List.DR_List[21].heading CtApImageProcess_FreeRunning.PpDR_Merges_10ms.DeDR_List.DR_List[21].delta_x CtApImageProcess_FreeRunning.PpDR_Merges_10ms.DeDR_List.DR_List[21].delta_y CtApImageProcess_FreeRunning.PpDR_Merges_10ms.DeDR_List.DR_List[21].delta_z CtApImageProcess_FreeRunning.PpDR_Merges_10ms.DeDR_List.DR_List[21].delta_yaw CtApImageProcess_FreeRunning.PpDR_Merges_10ms.DeDR_List.DR_List[21].belif CtApImageProcess_FreeRunning.PpDR_Merges_10ms.DeDR_List.DR_List[21].reserved_int CtApImageProcess_FreeRunning.PpDR_Merges_10ms.DeDR_List.DR_List[22].stHeader.Counter CtApImageProcess_FreeRunning.PpDR_Merges_10ms.DeDR_List.DR_List[22].stHeader.FrameID CtApImageProcess_FreeRunning.PpDR_Merges_10ms.DeDR_List.DR_List[22].stHeader.TimeStamp CtApImageProcess_FreeRunning.PpDR_Merges_10ms.DeDR_List.DR_List[22].count CtApImageProcess_FreeRunning.PpDR_Merges_10ms.DeDR_List.DR_List[22].time_sec CtApImageProcess_FreeRunning.PpDR_Merges_10ms.DeDR_List.DR_List[22].utm_x CtApImageProcess_FreeRunning.PpDR_Merges_10ms.DeDR_List.DR_List[22].utm_y CtApImageProcess_FreeRunning.PpDR_Merges_10ms.DeDR_List.DR_List[22].utm_z CtApImageProcess_FreeRunning.PpDR_Merges_10ms.DeDR_List.DR_List[22].heading CtApImageProcess_FreeRunning.PpDR_Merges_10ms.DeDR_List.DR_List[22].delta_x CtApImageProcess_FreeRunning.PpDR_Merges_10ms.DeDR_List.DR_List[22].delta_y CtApImageProcess_FreeRunning.PpDR_Merges_10ms.DeDR_List.DR_List[22].delta_z CtApImageProcess_FreeRunning.PpDR_Merges_10ms.DeDR_List.DR_List[22].delta_yaw CtApImageProcess_FreeRunning.PpDR_Merges_10ms.DeDR_List.DR_List[22].belif CtApImageProcess_FreeRunning.PpDR_Merges_10ms.DeDR_List.DR_List[22].reserved_int CtApImageProcess_FreeRunning.PpDR_Merges_10ms.DeDR_List.DR_List[23].stHeader.Counter CtApImageProcess_FreeRunning.PpDR_Merges_10ms.DeDR_List.DR_List[23].stHeader.FrameID CtApImageProcess_FreeRunning.PpDR_Merges_10ms.DeDR_List.DR_List[23].stHeader.TimeStamp CtApImageProcess_FreeRunning.PpDR_Merges_10ms.DeDR_List.DR_List[23].count CtApImageProcess_FreeRunning.PpDR_Merges_10ms.DeDR_List.DR_List[23].time_sec CtApImageProcess_FreeRunning.PpDR_Merges_10ms.DeDR_List.DR_List[23].utm_x CtApImageProcess_FreeRunning.PpDR_Merges_10ms.DeDR_List.DR_List[23].utm_y CtApImageProcess_FreeRunning.PpDR_Merges_10ms.DeDR_List.DR_List[23].utm_z CtApImageProcess_FreeRunning.PpDR_Merges_10ms.DeDR_List.DR_List[23].heading CtApImageProcess_FreeRunning.PpDR_Merges_10ms.DeDR_List.DR_List[23].delta_x CtApImageProcess_FreeRunning.PpDR_Merges_10ms.DeDR_List.DR_List[23].delta_y CtApImageProcess_FreeRunning.PpDR_Merges_10ms.DeDR_List.DR_List[23].delta_z CtApImageProcess_FreeRunning.PpDR_Merges_10ms.DeDR_List.DR_List[23].delta_yaw CtApImageProcess_FreeRunning.PpDR_Merges_10ms.DeDR_List.DR_List[23].belif CtApImageProcess_FreeRunning.PpDR_Merges_10ms.DeDR_List.DR_List[23].reserved_int CtApImageProcess_FreeRunning.PpDR_Merges_10ms.DeDR_List.DR_List[24].stHeader.Counter CtApImageProcess_FreeRunning.PpDR_Merges_10ms.DeDR_List.DR_List[24].stHeader.FrameID CtApImageProcess_FreeRunning.PpDR_Merges_10ms.DeDR_List.DR_List[24].stHeader.TimeStamp CtApImageProcess_FreeRunning.PpDR_Merges_10ms.DeDR_List.DR_List[24].count CtApImageProcess_FreeRunning.PpDR_Merges_10ms.DeDR_List.DR_List[24].time_sec CtApImageProcess_FreeRunning.PpDR_Merges_10ms.DeDR_List.DR_List[24].utm_x CtApImageProcess_FreeRunning.PpDR_Merges_10ms.DeDR_List.DR_List[24].utm_y CtApImageProcess_FreeRunning.PpDR_Merges_10ms.DeDR_List.DR_List[24].utm_z CtApImageProcess_FreeRunning.PpDR_Merges_10ms.DeDR_List.DR_List[24].heading CtApImageProcess_FreeRunning.PpDR_Merges_10ms.DeDR_List.DR_List[24].delta_x CtApImageProcess_FreeRunning.PpDR_Merges_10ms.DeDR_List.DR_List[24].delta_y CtApImageProcess_FreeRunning.PpDR_Merges_10ms.DeDR_List.DR_List[24].delta_z CtApImageProcess_FreeRunning.PpDR_Merges_10ms.DeDR_List.DR_List[24].delta_yaw CtApImageProcess_FreeRunning.PpDR_Merges_10ms.DeDR_List.DR_List[24].belif CtApImageProcess_FreeRunning.PpDR_Merges_10ms.DeDR_List.DR_List[24].reserved_int CtApImageProcess_FreeRunning.PpDR_Merges_10ms.DeDR_List.DR_List[25].stHeader.Counter CtApImageProcess_FreeRunning.PpDR_Merges_10ms.DeDR_List.DR_List[25].stHeader.FrameID CtApImageProcess_FreeRunning.PpDR_Merges_10ms.DeDR_List.DR_List[25].stHeader.TimeStamp CtApImageProcess_FreeRunning.PpDR_Merges_10ms.DeDR_List.DR_List[25].count CtApImageProcess_FreeRunning.PpDR_Merges_10ms.DeDR_List.DR_List[25].time_sec CtApImageProcess_FreeRunning.PpDR_Merges_10ms.DeDR_List.DR_List[25].utm_x CtApImageProcess_FreeRunning.PpDR_Merges_10ms.DeDR_List.DR_List[25].utm_y CtApImageProcess_FreeRunning.PpDR_Merges_10ms.DeDR_List.DR_List[25].utm_z CtApImageProcess_FreeRunning.PpDR_Merges_10ms.DeDR_List.DR_List[25].heading CtApImageProcess_FreeRunning.PpDR_Merges_10ms.DeDR_List.DR_List[25].delta_x CtApImageProcess_FreeRunning.PpDR_Merges_10ms.DeDR_List.DR_List[25].delta_y CtApImageProcess_FreeRunning.PpDR_Merges_10ms.DeDR_List.DR_List[25].delta_z CtApImageProcess_FreeRunning.PpDR_Merges_10ms.DeDR_List.DR_List[25].delta_yaw CtApImageProcess_FreeRunning.PpDR_Merges_10ms.DeDR_List.DR_List[25].belif CtApImageProcess_FreeRunning.PpDR_Merges_10ms.DeDR_List.DR_List[25].reserved_int CtApImageProcess_FreeRunning.PpDR_Merges_10ms.DeDR_List.DR_List[26].stHeader.Counter CtApImageProcess_FreeRunning.PpDR_Merges_10ms.DeDR_List.DR_List[26].stHeader.FrameID CtApImageProcess_FreeRunning.PpDR_Merges_10ms.DeDR_List.DR_List[26].stHeader.TimeStamp CtApImageProcess_FreeRunning.PpDR_Merges_10ms.DeDR_List.DR_List[26].count CtApImageProcess_FreeRunning.PpDR_Merges_10ms.DeDR_List.DR_List[26].time_sec CtApImageProcess_FreeRunning.PpDR_Merges_10ms.DeDR_List.DR_List[26].utm_x CtApImageProcess_FreeRunning.PpDR_Merges_10ms.DeDR_List.DR_List[26].utm_y CtApImageProcess_FreeRunning.PpDR_Merges_10ms.DeDR_List.DR_List[26].utm_z CtApImageProcess_FreeRunning.PpDR_Merges_10ms.DeDR_List.DR_List[26].heading CtApImageProcess_FreeRunning.PpDR_Merges_10ms.DeDR_List.DR_List[26].delta_x CtApImageProcess_FreeRunning.PpDR_Merges_10ms.DeDR_List.DR_List[26].delta_y CtApImageProcess_FreeRunning.PpDR_Merges_10ms.DeDR_List.DR_List[26].delta_z CtApImageProcess_FreeRunning.PpDR_Merges_10ms.DeDR_List.DR_List[26].delta_yaw CtApImageProcess_FreeRunning.PpDR_Merges_10ms.DeDR_List.DR_List[26].belif CtApImageProcess_FreeRunning.PpDR_Merges_10ms.DeDR_List.DR_List[26].reserved_int CtApImageProcess_FreeRunning.PpDR_Merges_10ms.DeDR_List.DR_List[27].stHeader.Counter CtApImageProcess_FreeRunning.PpDR_Merges_10ms.DeDR_List.DR_List[27].stHeader.FrameID CtApImageProcess_FreeRunning.PpDR_Merges_10ms.DeDR_List.DR_List[27].stHeader.TimeStamp CtApImageProcess_FreeRunning.PpDR_Merges_10ms.DeDR_List.DR_List[27].count CtApImageProcess_FreeRunning.PpDR_Merges_10ms.DeDR_List.DR_List[27].time_sec CtApImageProcess_FreeRunning.PpDR_Merges_10ms.DeDR_List.DR_List[27].utm_x CtApImageProcess_FreeRunning.PpDR_Merges_10ms.DeDR_List.DR_List[27].utm_y CtApImageProcess_FreeRunning.PpDR_Merges_10ms.DeDR_List.DR_List[27].utm_z CtApImageProcess_FreeRunning.PpDR_Merges_10ms.DeDR_List.DR_List[27].heading CtApImageProcess_FreeRunning.PpDR_Merges_10ms.DeDR_List.DR_List[27].delta_x CtApImageProcess_FreeRunning.PpDR_Merges_10ms.DeDR_List.DR_List[27].delta_y CtApImageProcess_FreeRunning.PpDR_Merges_10ms.DeDR_List.DR_List[27].delta_z CtApImageProcess_FreeRunning.PpDR_Merges_10ms.DeDR_List.DR_List[27].delta_yaw CtApImageProcess_FreeRunning.PpDR_Merges_10ms.DeDR_List.DR_List[27].belif CtApImageProcess_FreeRunning.PpDR_Merges_10ms.DeDR_List.DR_List[27].reserved_int CtApImageProcess_FreeRunning.PpDR_Merges_10ms.DeDR_List.DR_List[28].stHeader.Counter CtApImageProcess_FreeRunning.PpDR_Merges_10ms.DeDR_List.DR_List[28].stHeader.FrameID CtApImageProcess_FreeRunning.PpDR_Merges_10ms.DeDR_List.DR_List[28].stHeader.TimeStamp CtApImageProcess_FreeRunning.PpDR_Merges_10ms.DeDR_List.DR_List[28].count CtApImageProcess_FreeRunning.PpDR_Merges_10ms.DeDR_List.DR_List[28].time_sec CtApImageProcess_FreeRunning.PpDR_Merges_10ms.DeDR_List.DR_List[28].utm_x CtApImageProcess_FreeRunning.PpDR_Merges_10ms.DeDR_List.DR_List[28].utm_y CtApImageProcess_FreeRunning.PpDR_Merges_10ms.DeDR_List.DR_List[28].utm_z CtApImageProcess_FreeRunning.PpDR_Merges_10ms.DeDR_List.DR_List[28].heading CtApImageProcess_FreeRunning.PpDR_Merges_10ms.DeDR_List.DR_List[28].delta_x CtApImageProcess_FreeRunning.PpDR_Merges_10ms.DeDR_List.DR_List[28].delta_y CtApImageProcess_FreeRunning.PpDR_Merges_10ms.DeDR_List.DR_List[28].delta_z CtApImageProcess_FreeRunning.PpDR_Merges_10ms.DeDR_List.DR_List[28].delta_yaw CtApImageProcess_FreeRunning.PpDR_Merges_10ms.DeDR_List.DR_List[28].belif CtApImageProcess_FreeRunning.PpDR_Merges_10ms.DeDR_List.DR_List[28].reserved_int CtApImageProcess_FreeRunning.PpDR_Merges_10ms.DeDR_List.DR_List[29].stHeader.Counter CtApImageProcess_FreeRunning.PpDR_Merges_10ms.DeDR_List.DR_List[29].stHeader.FrameID CtApImageProcess_FreeRunning.PpDR_Merges_10ms.DeDR_List.DR_List[29].stHeader.TimeStamp CtApImageProcess_FreeRunning.PpDR_Merges_10ms.DeDR_List.DR_List[29].count CtApImageProcess_FreeRunning.PpDR_Merges_10ms.DeDR_List.DR_List[29].time_sec CtApImageProcess_FreeRunning.PpDR_Merges_10ms.DeDR_List.DR_List[29].utm_x CtApImageProcess_FreeRunning.PpDR_Merges_10ms.DeDR_List.DR_List[29].utm_y CtApImageProcess_FreeRunning.PpDR_Merges_10ms.DeDR_List.DR_List[29].utm_z CtApImageProcess_FreeRunning.PpDR_Merges_10ms.DeDR_List.DR_List[29].heading CtApImageProcess_FreeRunning.PpDR_Merges_10ms.DeDR_List.DR_List[29].delta_x CtApImageProcess_FreeRunning.PpDR_Merges_10ms.DeDR_List.DR_List[29].delta_y CtApImageProcess_FreeRunning.PpDR_Merges_10ms.DeDR_List.DR_List[29].delta_z CtApImageProcess_FreeRunning.PpDR_Merges_10ms.DeDR_List.DR_List[29].delta_yaw CtApImageProcess_FreeRunning.PpDR_Merges_10ms.DeDR_List.DR_List[29].belif CtApImageProcess_FreeRunning.PpDR_Merges_10ms.DeDR_List.DR_List[29].reserved_int CtApImageProcess_FreeRunning.PpDR_Merges_10ms.DeDR_List.DR_List[30].stHeader.Counter CtApImageProcess_FreeRunning.PpDR_Merges_10ms.DeDR_List.DR_List[30].stHeader.FrameID CtApImageProcess_FreeRunning.PpDR_Merges_10ms.DeDR_List.DR_List[30].stHeader.TimeStamp CtApImageProcess_FreeRunning.PpDR_Merges_10ms.DeDR_List.DR_List[30].count CtApImageProcess_FreeRunning.PpDR_Merges_10ms.DeDR_List.DR_List[30].time_sec CtApImageProcess_FreeRunning.PpDR_Merges_10ms.DeDR_List.DR_List[30].utm_x CtApImageProcess_FreeRunning.PpDR_Merges_10ms.DeDR_List.DR_List[30].utm_y CtApImageProcess_FreeRunning.PpDR_Merges_10ms.DeDR_List.DR_List[30].utm_z CtApImageProcess_FreeRunning.PpDR_Merges_10ms.DeDR_List.DR_List[30].heading CtApImageProcess_FreeRunning.PpDR_Merges_10ms.DeDR_List.DR_List[30].delta_x CtApImageProcess_FreeRunning.PpDR_Merges_10ms.DeDR_List.DR_List[30].delta_y CtApImageProcess_FreeRunning.PpDR_Merges_10ms.DeDR_List.DR_List[30].delta_z CtApImageProcess_FreeRunning.PpDR_Merges_10ms.DeDR_List.DR_List[30].delta_yaw CtApImageProcess_FreeRunning.PpDR_Merges_10ms.DeDR_List.DR_List[30].belif CtApImageProcess_FreeRunning.PpDR_Merges_10ms.DeDR_List.DR_List[30].reserved_int CtApImageProcess_FreeRunning.PpDR_Merges_10ms.DeDR_List.DR_List[31].stHeader.Counter CtApImageProcess_FreeRunning.PpDR_Merges_10ms.DeDR_List.DR_List[31].stHeader.FrameID CtApImageProcess_FreeRunning.PpDR_Merges_10ms.DeDR_List.DR_List[31].stHeader.TimeStamp CtApImageProcess_FreeRunning.PpDR_Merges_10ms.DeDR_List.DR_List[31].count CtApImageProcess_FreeRunning.PpDR_Merges_10ms.DeDR_List.DR_List[31].time_sec CtApImageProcess_FreeRunning.PpDR_Merges_10ms.DeDR_List.DR_List[31].utm_x CtApImageProcess_FreeRunning.PpDR_Merges_10ms.DeDR_List.DR_List[31].utm_y CtApImageProcess_FreeRunning.PpDR_Merges_10ms.DeDR_List.DR_List[31].utm_z CtApImageProcess_FreeRunning.PpDR_Merges_10ms.DeDR_List.DR_List[31].heading CtApImageProcess_FreeRunning.PpDR_Merges_10ms.DeDR_List.DR_List[31].delta_x CtApImageProcess_FreeRunning.PpDR_Merges_10ms.DeDR_List.DR_List[31].delta_y CtApImageProcess_FreeRunning.PpDR_Merges_10ms.DeDR_List.DR_List[31].delta_z CtApImageProcess_FreeRunning.PpDR_Merges_10ms.DeDR_List.DR_List[31].delta_yaw CtApImageProcess_FreeRunning.PpDR_Merges_10ms.DeDR_List.DR_List[31].belif CtApImageProcess_FreeRunning.PpDR_Merges_10ms.DeDR_List.DR_List[31].reserved_int CtApImageProcess_FreeRunning.PpDR_Merges_10ms.DeDR_List.DR_List[32].stHeader.Counter CtApImageProcess_FreeRunning.PpDR_Merges_10ms.DeDR_List.DR_List[32].stHeader.FrameID CtApImageProcess_FreeRunning.PpDR_Merges_10ms.DeDR_List.DR_List[32].stHeader.TimeStamp CtApImageProcess_FreeRunning.PpDR_Merges_10ms.DeDR_List.DR_List[32].count CtApImageProcess_FreeRunning.PpDR_Merges_10ms.DeDR_List.DR_List[32].time_sec CtApImageProcess_FreeRunning.PpDR_Merges_10ms.DeDR_List.DR_List[32].utm_x CtApImageProcess_FreeRunning.PpDR_Merges_10ms.DeDR_List.DR_List[32].utm_y CtApImageProcess_FreeRunning.PpDR_Merges_10ms.DeDR_List.DR_List[32].utm_z CtApImageProcess_FreeRunning.PpDR_Merges_10ms.DeDR_List.DR_List[32].heading CtApImageProcess_FreeRunning.PpDR_Merges_10ms.DeDR_List.DR_List[32].delta_x CtApImageProcess_FreeRunning.PpDR_Merges_10ms.DeDR_List.DR_List[32].delta_y CtApImageProcess_FreeRunning.PpDR_Merges_10ms.DeDR_List.DR_List[32].delta_z CtApImageProcess_FreeRunning.PpDR_Merges_10ms.DeDR_List.DR_List[32].delta_yaw CtApImageProcess_FreeRunning.PpDR_Merges_10ms.DeDR_List.DR_List[32].belif CtApImageProcess_FreeRunning.PpDR_Merges_10ms.DeDR_List.DR_List[32].reserved_int CtApImageProcess_FreeRunning.PpDR_Merges_10ms.DeDR_List.DR_List[33].stHeader.Counter CtApImageProcess_FreeRunning.PpDR_Merges_10ms.DeDR_List.DR_List[33].stHeader.FrameID CtApImageProcess_FreeRunning.PpDR_Merges_10ms.DeDR_List.DR_List[33].stHeader.TimeStamp CtApImageProcess_FreeRunning.PpDR_Merges_10ms.DeDR_List.DR_List[33].count CtApImageProcess_FreeRunning.PpDR_Merges_10ms.DeDR_List.DR_List[33].time_sec CtApImageProcess_FreeRunning.PpDR_Merges_10ms.DeDR_List.DR_List[33].utm_x CtApImageProcess_FreeRunning.PpDR_Merges_10ms.DeDR_List.DR_List[33].utm_y CtApImageProcess_FreeRunning.PpDR_Merges_10ms.DeDR_List.DR_List[33].utm_z CtApImageProcess_FreeRunning.PpDR_Merges_10ms.DeDR_List.DR_List[33].heading CtApImageProcess_FreeRunning.PpDR_Merges_10ms.DeDR_List.DR_List[33].delta_x CtApImageProcess_FreeRunning.PpDR_Merges_10ms.DeDR_List.DR_List[33].delta_y CtApImageProcess_FreeRunning.PpDR_Merges_10ms.DeDR_List.DR_List[33].delta_z CtApImageProcess_FreeRunning.PpDR_Merges_10ms.DeDR_List.DR_List[33].delta_yaw CtApImageProcess_FreeRunning.PpDR_Merges_10ms.DeDR_List.DR_List[33].belif CtApImageProcess_FreeRunning.PpDR_Merges_10ms.DeDR_List.DR_List[33].reserved_int CtApImageProcess_FreeRunning.PpDR_Merges_10ms.DeDR_List.DR_List[34].stHeader.Counter CtApImageProcess_FreeRunning.PpDR_Merges_10ms.DeDR_List.DR_List[34].stHeader.FrameID CtApImageProcess_FreeRunning.PpDR_Merges_10ms.DeDR_List.DR_List[34].stHeader.TimeStamp CtApImageProcess_FreeRunning.PpDR_Merges_10ms.DeDR_List.DR_List[34].count CtApImageProcess_FreeRunning.PpDR_Merges_10ms.DeDR_List.DR_List[34].time_sec CtApImageProcess_FreeRunning.PpDR_Merges_10ms.DeDR_List.DR_List[34].utm_x CtApImageProcess_FreeRunning.PpDR_Merges_10ms.DeDR_List.DR_List[34].utm_y CtApImageProcess_FreeRunning.PpDR_Merges_10ms.DeDR_List.DR_List[34].utm_z CtApImageProcess_FreeRunning.PpDR_Merges_10ms.DeDR_List.DR_List[34].heading CtApImageProcess_FreeRunning.PpDR_Merges_10ms.DeDR_List.DR_List[34].delta_x CtApImageProcess_FreeRunning.PpDR_Merges_10ms.DeDR_List.DR_List[34].delta_y CtApImageProcess_FreeRunning.PpDR_Merges_10ms.DeDR_List.DR_List[34].delta_z CtApImageProcess_FreeRunning.PpDR_Merges_10ms.DeDR_List.DR_List[34].delta_yaw CtApImageProcess_FreeRunning.PpDR_Merges_10ms.DeDR_List.DR_List[34].belif CtApImageProcess_FreeRunning.PpDR_Merges_10ms.DeDR_List.DR_List[34].reserved_int CtApImageProcess_FreeRunning.PpDR_Merges_10ms.DeDR_List.DR_List[35].stHeader.Counter CtApImageProcess_FreeRunning.PpDR_Merges_10ms.DeDR_List.DR_List[35].stHeader.FrameID CtApImageProcess_FreeRunning.PpDR_Merges_10ms.DeDR_List.DR_List[35].stHeader.TimeStamp CtApImageProcess_FreeRunning.PpDR_Merges_10ms.DeDR_List.DR_List[35].count CtApImageProcess_FreeRunning.PpDR_Merges_10ms.DeDR_List.DR_List[35].time_sec CtApImageProcess_FreeRunning.PpDR_Merges_10ms.DeDR_List.DR_List[35].utm_x CtApImageProcess_FreeRunning.PpDR_Merges_10ms.DeDR_List.DR_List[35].utm_y CtApImageProcess_FreeRunning.PpDR_Merges_10ms.DeDR_List.DR_List[35].utm_z CtApImageProcess_FreeRunning.PpDR_Merges_10ms.DeDR_List.DR_List[35].heading CtApImageProcess_FreeRunning.PpDR_Merges_10ms.DeDR_List.DR_List[35].delta_x CtApImageProcess_FreeRunning.PpDR_Merges_10ms.DeDR_List.DR_List[35].delta_y CtApImageProcess_FreeRunning.PpDR_Merges_10ms.DeDR_List.DR_List[35].delta_z CtApImageProcess_FreeRunning.PpDR_Merges_10ms.DeDR_List.DR_List[35].delta_yaw CtApImageProcess_FreeRunning.PpDR_Merges_10ms.DeDR_List.DR_List[35].belif CtApImageProcess_FreeRunning.PpDR_Merges_10ms.DeDR_List.DR_List[35].reserved_int CtApImageProcess_FreeRunning.PpDR_Merges_10ms.DeDR_List.DR_List[36].stHeader.Counter CtApImageProcess_FreeRunning.PpDR_Merges_10ms.DeDR_List.DR_List[36].stHeader.FrameID CtApImageProcess_FreeRunning.PpDR_Merges_10ms.DeDR_List.DR_List[36].stHeader.TimeStamp CtApImageProcess_FreeRunning.PpDR_Merges_10ms.DeDR_List.DR_List[36].count CtApImageProcess_FreeRunning.PpDR_Merges_10ms.DeDR_List.DR_List[36].time_sec CtApImageProcess_FreeRunning.PpDR_Merges_10ms.DeDR_List.DR_List[36].utm_x CtApImageProcess_FreeRunning.PpDR_Merges_10ms.DeDR_List.DR_List[36].utm_y CtApImageProcess_FreeRunning.PpDR_Merges_10ms.DeDR_List.DR_List[36].utm_z CtApImageProcess_FreeRunning.PpDR_Merges_10ms.DeDR_List.DR_List[36].heading CtApImageProcess_FreeRunning.PpDR_Merges_10ms.DeDR_List.DR_List[36].delta_x CtApImageProcess_FreeRunning.PpDR_Merges_10ms.DeDR_List.DR_List[36].delta_y CtApImageProcess_FreeRunning.PpDR_Merges_10ms.DeDR_List.DR_List[36].delta_z CtApImageProcess_FreeRunning.PpDR_Merges_10ms.DeDR_List.DR_List[36].delta_yaw CtApImageProcess_FreeRunning.PpDR_Merges_10ms.DeDR_List.DR_List[36].belif CtApImageProcess_FreeRunning.PpDR_Merges_10ms.DeDR_List.DR_List[36].reserved_int CtApImageProcess_FreeRunning.PpDR_Merges_10ms.DeDR_List.DR_List[37].stHeader.Counter CtApImageProcess_FreeRunning.PpDR_Merges_10ms.DeDR_List.DR_List[37].stHeader.FrameID CtApImageProcess_FreeRunning.PpDR_Merges_10ms.DeDR_List.DR_List[37].stHeader.TimeStamp CtApImageProcess_FreeRunning.PpDR_Merges_10ms.DeDR_List.DR_List[37].count CtApImageProcess_FreeRunning.PpDR_Merges_10ms.DeDR_List.DR_List[37].time_sec CtApImageProcess_FreeRunning.PpDR_Merges_10ms.DeDR_List.DR_List[37].utm_x CtApImageProcess_FreeRunning.PpDR_Merges_10ms.DeDR_List.DR_List[37].utm_y CtApImageProcess_FreeRunning.PpDR_Merges_10ms.DeDR_List.DR_List[37].utm_z CtApImageProcess_FreeRunning.PpDR_Merges_10ms.DeDR_List.DR_List[37].heading CtApImageProcess_FreeRunning.PpDR_Merges_10ms.DeDR_List.DR_List[37].delta_x CtApImageProcess_FreeRunning.PpDR_Merges_10ms.DeDR_List.DR_List[37].delta_y CtApImageProcess_FreeRunning.PpDR_Merges_10ms.DeDR_List.DR_List[37].delta_z CtApImageProcess_FreeRunning.PpDR_Merges_10ms.DeDR_List.DR_List[37].delta_yaw CtApImageProcess_FreeRunning.PpDR_Merges_10ms.DeDR_List.DR_List[37].belif CtApImageProcess_FreeRunning.PpDR_Merges_10ms.DeDR_List.DR_List[37].reserved_int CtApImageProcess_FreeRunning.PpDR_Merges_10ms.DeDR_List.DR_List[38].stHeader.Counter CtApImageProcess_FreeRunning.PpDR_Merges_10ms.DeDR_List.DR_List[38].stHeader.FrameID CtApImageProcess_FreeRunning.PpDR_Merges_10ms.DeDR_List.DR_List[38].stHeader.TimeStamp CtApImageProcess_FreeRunning.PpDR_Merges_10ms.DeDR_List.DR_List[38].count CtApImageProcess_FreeRunning.PpDR_Merges_10ms.DeDR_List.DR_List[38].time_sec CtApImageProcess_FreeRunning.PpDR_Merges_10ms.DeDR_List.DR_List[38].utm_x CtApImageProcess_FreeRunning.PpDR_Merges_10ms.DeDR_List.DR_List[38].utm_y CtApImageProcess_FreeRunning.PpDR_Merges_10ms.DeDR_List.DR_List[38].utm_z CtApImageProcess_FreeRunning.PpDR_Merges_10ms.DeDR_List.DR_List[38].heading CtApImageProcess_FreeRunning.PpDR_Merges_10ms.DeDR_List.DR_List[38].delta_x CtApImageProcess_FreeRunning.PpDR_Merges_10ms.DeDR_List.DR_List[38].delta_y CtApImageProcess_FreeRunning.PpDR_Merges_10ms.DeDR_List.DR_List[38].delta_z CtApImageProcess_FreeRunning.PpDR_Merges_10ms.DeDR_List.DR_List[38].delta_yaw CtApImageProcess_FreeRunning.PpDR_Merges_10ms.DeDR_List.DR_List[38].belif CtApImageProcess_FreeRunning.PpDR_Merges_10ms.DeDR_List.DR_List[38].reserved_int CtApImageProcess_FreeRunning.PpDR_Merges_10ms.DeDR_List.DR_List[39].stHeader.Counter CtApImageProcess_FreeRunning.PpDR_Merges_10ms.DeDR_List.DR_List[39].stHeader.FrameID CtApImageProcess_FreeRunning.PpDR_Merges_10ms.DeDR_List.DR_List[39].stHeader.TimeStamp CtApImageProcess_FreeRunning.PpDR_Merges_10ms.DeDR_List.DR_List[39].count CtApImageProcess_FreeRunning.PpDR_Merges_10ms.DeDR_List.DR_List[39].time_sec CtApImageProcess_FreeRunning.PpDR_Merges_10ms.DeDR_List.DR_List[39].utm_x CtApImageProcess_FreeRunning.PpDR_Merges_10ms.DeDR_List.DR_List[39].utm_y CtApImageProcess_FreeRunning.PpDR_Merges_10ms.DeDR_List.DR_List[39].utm_z CtApImageProcess_FreeRunning.PpDR_Merges_10ms.DeDR_List.DR_List[39].heading CtApImageProcess_FreeRunning.PpDR_Merges_10ms.DeDR_List.DR_List[39].delta_x CtApImageProcess_FreeRunning.PpDR_Merges_10ms.DeDR_List.DR_List[39].delta_y CtApImageProcess_FreeRunning.PpDR_Merges_10ms.DeDR_List.DR_List[39].delta_z CtApImageProcess_FreeRunning.PpDR_Merges_10ms.DeDR_List.DR_List[39].delta_yaw CtApImageProcess_FreeRunning.PpDR_Merges_10ms.DeDR_List.DR_List[39].belif CtApImageProcess_FreeRunning.PpDR_Merges_10ms.DeDR_List.DR_List[39].reserved_int CtApImageProcess_FreeRunning.PpDR_Merges_10ms.DeDR_List.DR_List[40].stHeader.Counter CtApImageProcess_FreeRunning.PpDR_Merges_10ms.DeDR_List.DR_List[40].stHeader.FrameID CtApImageProcess_FreeRunning.PpDR_Merges_10ms.DeDR_List.DR_List[40].stHeader.TimeStamp CtApImageProcess_FreeRunning.PpDR_Merges_10ms.DeDR_List.DR_List[40].count CtApImageProcess_FreeRunning.PpDR_Merges_10ms.DeDR_List.DR_List[40].time_sec CtApImageProcess_FreeRunning.PpDR_Merges_10ms.DeDR_List.DR_List[40].utm_x CtApImageProcess_FreeRunning.PpDR_Merges_10ms.DeDR_List.DR_List[40].utm_y CtApImageProcess_FreeRunning.PpDR_Merges_10ms.DeDR_List.DR_List[40].utm_z CtApImageProcess_FreeRunning.PpDR_Merges_10ms.DeDR_List.DR_List[40].heading CtApImageProcess_FreeRunning.PpDR_Merges_10ms.DeDR_List.DR_List[40].delta_x CtApImageProcess_FreeRunning.PpDR_Merges_10ms.DeDR_List.DR_List[40].delta_y CtApImageProcess_FreeRunning.PpDR_Merges_10ms.DeDR_List.DR_List[40].delta_z CtApImageProcess_FreeRunning.PpDR_Merges_10ms.DeDR_List.DR_List[40].delta_yaw CtApImageProcess_FreeRunning.PpDR_Merges_10ms.DeDR_List.DR_List[40].belif CtApImageProcess_FreeRunning.PpDR_Merges_10ms.DeDR_List.DR_List[40].reserved_int CtApImageProcess_FreeRunning.PpDR_Merges_10ms.DeDR_List.DR_List[41].stHeader.Counter CtApImageProcess_FreeRunning.PpDR_Merges_10ms.DeDR_List.DR_List[41].stHeader.FrameID CtApImageProcess_FreeRunning.PpDR_Merges_10ms.DeDR_List.DR_List[41].stHeader.TimeStamp CtApImageProcess_FreeRunning.PpDR_Merges_10ms.DeDR_List.DR_List[41].count CtApImageProcess_FreeRunning.PpDR_Merges_10ms.DeDR_List.DR_List[41].time_sec CtApImageProcess_FreeRunning.PpDR_Merges_10ms.DeDR_List.DR_List[41].utm_x CtApImageProcess_FreeRunning.PpDR_Merges_10ms.DeDR_List.DR_List[41].utm_y CtApImageProcess_FreeRunning.PpDR_Merges_10ms.DeDR_List.DR_List[41].utm_z CtApImageProcess_FreeRunning.PpDR_Merges_10ms.DeDR_List.DR_List[41].heading CtApImageProcess_FreeRunning.PpDR_Merges_10ms.DeDR_List.DR_List[41].delta_x CtApImageProcess_FreeRunning.PpDR_Merges_10ms.DeDR_List.DR_List[41].delta_y CtApImageProcess_FreeRunning.PpDR_Merges_10ms.DeDR_List.DR_List[41].delta_z CtApImageProcess_FreeRunning.PpDR_Merges_10ms.DeDR_List.DR_List[41].delta_yaw CtApImageProcess_FreeRunning.PpDR_Merges_10ms.DeDR_List.DR_List[41].belif CtApImageProcess_FreeRunning.PpDR_Merges_10ms.DeDR_List.DR_List[41].reserved_int CtApImageProcess_FreeRunning.PpDR_Merges_10ms.DeDR_List.DR_List[42].stHeader.Counter CtApImageProcess_FreeRunning.PpDR_Merges_10ms.DeDR_List.DR_List[42].stHeader.FrameID CtApImageProcess_FreeRunning.PpDR_Merges_10ms.DeDR_List.DR_List[42].stHeader.TimeStamp CtApImageProcess_FreeRunning.PpDR_Merges_10ms.DeDR_List.DR_List[42].count CtApImageProcess_FreeRunning.PpDR_Merges_10ms.DeDR_List.DR_List[42].time_sec CtApImageProcess_FreeRunning.PpDR_Merges_10ms.DeDR_List.DR_List[42].utm_x CtApImageProcess_FreeRunning.PpDR_Merges_10ms.DeDR_List.DR_List[42].utm_y CtApImageProcess_FreeRunning.PpDR_Merges_10ms.DeDR_List.DR_List[42].utm_z CtApImageProcess_FreeRunning.PpDR_Merges_10ms.DeDR_List.DR_List[42].heading CtApImageProcess_FreeRunning.PpDR_Merges_10ms.DeDR_List.DR_List[42].delta_x CtApImageProcess_FreeRunning.PpDR_Merges_10ms.DeDR_List.DR_List[42].delta_y CtApImageProcess_FreeRunning.PpDR_Merges_10ms.DeDR_List.DR_List[42].delta_z CtApImageProcess_FreeRunning.PpDR_Merges_10ms.DeDR_List.DR_List[42].delta_yaw CtApImageProcess_FreeRunning.PpDR_Merges_10ms.DeDR_List.DR_List[42].belif CtApImageProcess_FreeRunning.PpDR_Merges_10ms.DeDR_List.DR_List[42].reserved_int CtApImageProcess_FreeRunning.PpDR_Merges_10ms.DeDR_List.DR_List[43].stHeader.Counter CtApImageProcess_FreeRunning.PpDR_Merges_10ms.DeDR_List.DR_List[43].stHeader.FrameID CtApImageProcess_FreeRunning.PpDR_Merges_10ms.DeDR_List.DR_List[43].stHeader.TimeStamp CtApImageProcess_FreeRunning.PpDR_Merges_10ms.DeDR_List.DR_List[43].count CtApImageProcess_FreeRunning.PpDR_Merges_10ms.DeDR_List.DR_List[43].time_sec CtApImageProcess_FreeRunning.PpDR_Merges_10ms.DeDR_List.DR_List[43].utm_x CtApImageProcess_FreeRunning.PpDR_Merges_10ms.DeDR_List.DR_List[43].utm_y CtApImageProcess_FreeRunning.PpDR_Merges_10ms.DeDR_List.DR_List[43].utm_z CtApImageProcess_FreeRunning.PpDR_Merges_10ms.DeDR_List.DR_List[43].heading CtApImageProcess_FreeRunning.PpDR_Merges_10ms.DeDR_List.DR_List[43].delta_x CtApImageProcess_FreeRunning.PpDR_Merges_10ms.DeDR_List.DR_List[43].delta_y CtApImageProcess_FreeRunning.PpDR_Merges_10ms.DeDR_List.DR_List[43].delta_z CtApImageProcess_FreeRunning.PpDR_Merges_10ms.DeDR_List.DR_List[43].delta_yaw CtApImageProcess_FreeRunning.PpDR_Merges_10ms.DeDR_List.DR_List[43].belif CtApImageProcess_FreeRunning.PpDR_Merges_10ms.DeDR_List.DR_List[43].reserved_int CtApImageProcess_FreeRunning.PpDR_Merges_10ms.DeDR_List.DR_List[44].stHeader.Counter CtApImageProcess_FreeRunning.PpDR_Merges_10ms.DeDR_List.DR_List[44].stHeader.FrameID CtApImageProcess_FreeRunning.PpDR_Merges_10ms.DeDR_List.DR_List[44].stHeader.TimeStamp CtApImageProcess_FreeRunning.PpDR_Merges_10ms.DeDR_List.DR_List[44].count CtApImageProcess_FreeRunning.PpDR_Merges_10ms.DeDR_List.DR_List[44].time_sec CtApImageProcess_FreeRunning.PpDR_Merges_10ms.DeDR_List.DR_List[44].utm_x CtApImageProcess_FreeRunning.PpDR_Merges_10ms.DeDR_List.DR_List[44].utm_y CtApImageProcess_FreeRunning.PpDR_Merges_10ms.DeDR_List.DR_List[44].utm_z CtApImageProcess_FreeRunning.PpDR_Merges_10ms.DeDR_List.DR_List[44].heading CtApImageProcess_FreeRunning.PpDR_Merges_10ms.DeDR_List.DR_List[44].delta_x CtApImageProcess_FreeRunning.PpDR_Merges_10ms.DeDR_List.DR_List[44].delta_y CtApImageProcess_FreeRunning.PpDR_Merges_10ms.DeDR_List.DR_List[44].delta_z CtApImageProcess_FreeRunning.PpDR_Merges_10ms.DeDR_List.DR_List[44].delta_yaw CtApImageProcess_FreeRunning.PpDR_Merges_10ms.DeDR_List.DR_List[44].belif CtApImageProcess_FreeRunning.PpDR_Merges_10ms.DeDR_List.DR_List[44].reserved_int CtApImageProcess_FreeRunning.PpDR_Merges_10ms.DeDR_List.DR_List[45].stHeader.Counter CtApImageProcess_FreeRunning.PpDR_Merges_10ms.DeDR_List.DR_List[45].stHeader.FrameID CtApImageProcess_FreeRunning.PpDR_Merges_10ms.DeDR_List.DR_List[45].stHeader.TimeStamp CtApImageProcess_FreeRunning.PpDR_Merges_10ms.DeDR_List.DR_List[45].count CtApImageProcess_FreeRunning.PpDR_Merges_10ms.DeDR_List.DR_List[45].time_sec CtApImageProcess_FreeRunning.PpDR_Merges_10ms.DeDR_List.DR_List[45].utm_x CtApImageProcess_FreeRunning.PpDR_Merges_10ms.DeDR_List.DR_List[45].utm_y CtApImageProcess_FreeRunning.PpDR_Merges_10ms.DeDR_List.DR_List[45].utm_z CtApImageProcess_FreeRunning.PpDR_Merges_10ms.DeDR_List.DR_List[45].heading CtApImageProcess_FreeRunning.PpDR_Merges_10ms.DeDR_List.DR_List[45].delta_x CtApImageProcess_FreeRunning.PpDR_Merges_10ms.DeDR_List.DR_List[45].delta_y CtApImageProcess_FreeRunning.PpDR_Merges_10ms.DeDR_List.DR_List[45].delta_z CtApImageProcess_FreeRunning.PpDR_Merges_10ms.DeDR_List.DR_List[45].delta_yaw CtApImageProcess_FreeRunning.PpDR_Merges_10ms.DeDR_List.DR_List[45].belif CtApImageProcess_FreeRunning.PpDR_Merges_10ms.DeDR_List.DR_List[45].reserved_int CtApImageProcess_FreeRunning.PpDR_Merges_10ms.DeDR_List.DR_List[46].stHeader.Counter CtApImageProcess_FreeRunning.PpDR_Merges_10ms.DeDR_List.DR_List[46].stHeader.FrameID CtApImageProcess_FreeRunning.PpDR_Merges_10ms.DeDR_List.DR_List[46].stHeader.TimeStamp CtApImageProcess_FreeRunning.PpDR_Merges_10ms.DeDR_List.DR_List[46].count CtApImageProcess_FreeRunning.PpDR_Merges_10ms.DeDR_List.DR_List[46].time_sec CtApImageProcess_FreeRunning.PpDR_Merges_10ms.DeDR_List.DR_List[46].utm_x CtApImageProcess_FreeRunning.PpDR_Merges_10ms.DeDR_List.DR_List[46].utm_y CtApImageProcess_FreeRunning.PpDR_Merges_10ms.DeDR_List.DR_List[46].utm_z CtApImageProcess_FreeRunning.PpDR_Merges_10ms.DeDR_List.DR_List[46].heading CtApImageProcess_FreeRunning.PpDR_Merges_10ms.DeDR_List.DR_List[46].delta_x CtApImageProcess_FreeRunning.PpDR_Merges_10ms.DeDR_List.DR_List[46].delta_y CtApImageProcess_FreeRunning.PpDR_Merges_10ms.DeDR_List.DR_List[46].delta_z CtApImageProcess_FreeRunning.PpDR_Merges_10ms.DeDR_List.DR_List[46].delta_yaw CtApImageProcess_FreeRunning.PpDR_Merges_10ms.DeDR_List.DR_List[46].belif CtApImageProcess_FreeRunning.PpDR_Merges_10ms.DeDR_List.DR_List[46].reserved_int CtApImageProcess_FreeRunning.PpDR_Merges_10ms.DeDR_List.DR_List[47].stHeader.Counter CtApImageProcess_FreeRunning.PpDR_Merges_10ms.DeDR_List.DR_List[47].stHeader.FrameID CtApImageProcess_FreeRunning.PpDR_Merges_10ms.DeDR_List.DR_List[47].stHeader.TimeStamp CtApImageProcess_FreeRunning.PpDR_Merges_10ms.DeDR_List.DR_List[47].count CtApImageProcess_FreeRunning.PpDR_Merges_10ms.DeDR_List.DR_List[47].time_sec CtApImageProcess_FreeRunning.PpDR_Merges_10ms.DeDR_List.DR_List[47].utm_x CtApImageProcess_FreeRunning.PpDR_Merges_10ms.DeDR_List.DR_List[47].utm_y CtApImageProcess_FreeRunning.PpDR_Merges_10ms.DeDR_List.DR_List[47].utm_z CtApImageProcess_FreeRunning.PpDR_Merges_10ms.DeDR_List.DR_List[47].heading CtApImageProcess_FreeRunning.PpDR_Merges_10ms.DeDR_List.DR_List[47].delta_x CtApImageProcess_FreeRunning.PpDR_Merges_10ms.DeDR_List.DR_List[47].delta_y CtApImageProcess_FreeRunning.PpDR_Merges_10ms.DeDR_List.DR_List[47].delta_z CtApImageProcess_FreeRunning.PpDR_Merges_10ms.DeDR_List.DR_List[47].delta_yaw CtApImageProcess_FreeRunning.PpDR_Merges_10ms.DeDR_List.DR_List[47].belif CtApImageProcess_FreeRunning.PpDR_Merges_10ms.DeDR_List.DR_List[47].reserved_int CtApImageProcess_FreeRunning.PpDR_Merges_10ms.DeDR_List.DR_List[48].stHeader.Counter CtApImageProcess_FreeRunning.PpDR_Merges_10ms.DeDR_List.DR_List[48].stHeader.FrameID CtApImageProcess_FreeRunning.PpDR_Merges_10ms.DeDR_List.DR_List[48].stHeader.TimeStamp CtApImageProcess_FreeRunning.PpDR_Merges_10ms.DeDR_List.DR_List[48].count CtApImageProcess_FreeRunning.PpDR_Merges_10ms.DeDR_List.DR_List[48].time_sec CtApImageProcess_FreeRunning.PpDR_Merges_10ms.DeDR_List.DR_List[48].utm_x CtApImageProcess_FreeRunning.PpDR_Merges_10ms.DeDR_List.DR_List[48].utm_y CtApImageProcess_FreeRunning.PpDR_Merges_10ms.DeDR_List.DR_List[48].utm_z CtApImageProcess_FreeRunning.PpDR_Merges_10ms.DeDR_List.DR_List[48].heading CtApImageProcess_FreeRunning.PpDR_Merges_10ms.DeDR_List.DR_List[48].delta_x CtApImageProcess_FreeRunning.PpDR_Merges_10ms.DeDR_List.DR_List[48].delta_y CtApImageProcess_FreeRunning.PpDR_Merges_10ms.DeDR_List.DR_List[48].delta_z CtApImageProcess_FreeRunning.PpDR_Merges_10ms.DeDR_List.DR_List[48].delta_yaw CtApImageProcess_FreeRunning.PpDR_Merges_10ms.DeDR_List.DR_List[48].belif CtApImageProcess_FreeRunning.PpDR_Merges_10ms.DeDR_List.DR_List[48].reserved_int CtApImageProcess_FreeRunning.PpDR_Merges_10ms.DeDR_List.DR_List[49].stHeader.Counter CtApImageProcess_FreeRunning.PpDR_Merges_10ms.DeDR_List.DR_List[49].stHeader.FrameID CtApImageProcess_FreeRunning.PpDR_Merges_10ms.DeDR_List.DR_List[49].stHeader.TimeStamp CtApImageProcess_FreeRunning.PpDR_Merges_10ms.DeDR_List.DR_List[49].count CtApImageProcess_FreeRunning.PpDR_Merges_10ms.DeDR_List.DR_List[49].time_sec CtApImageProcess_FreeRunning.PpDR_Merges_10ms.DeDR_List.DR_List[49].utm_x CtApImageProcess_FreeRunning.PpDR_Merges_10ms.DeDR_List.DR_List[49].utm_y CtApImageProcess_FreeRunning.PpDR_Merges_10ms.DeDR_List.DR_List[49].utm_z CtApImageProcess_FreeRunning.PpDR_Merges_10ms.DeDR_List.DR_List[49].heading CtApImageProcess_FreeRunning.PpDR_Merges_10ms.DeDR_List.DR_List[49].delta_x CtApImageProcess_FreeRunning.PpDR_Merges_10ms.DeDR_List.DR_List[49].delta_y CtApImageProcess_FreeRunning.PpDR_Merges_10ms.DeDR_List.DR_List[49].delta_z CtApImageProcess_FreeRunning.PpDR_Merges_10ms.DeDR_List.DR_List[49].delta_yaw CtApImageProcess_FreeRunning.PpDR_Merges_10ms.DeDR_List.DR_List[49].belif CtApImageProcess_FreeRunning.PpDR_Merges_10ms.DeDR_List.DR_List[49].reserved_int CtApImageProcess_FreeRunning.PpDR_Merges_10ms.DeDR_List.DR_List[50].stHeader.Counter CtApImageProcess_FreeRunning.PpDR_Merges_10ms.DeDR_List.DR_List[50].stHeader.FrameID CtApImageProcess_FreeRunning.PpDR_Merges_10ms.DeDR_List.DR_List[50].stHeader.TimeStamp CtApImageProcess_FreeRunning.PpDR_Merges_10ms.DeDR_List.DR_List[50].count CtApImageProcess_FreeRunning.PpDR_Merges_10ms.DeDR_List.DR_List[50].time_sec CtApImageProcess_FreeRunning.PpDR_Merges_10ms.DeDR_List.DR_List[50].utm_x CtApImageProcess_FreeRunning.PpDR_Merges_10ms.DeDR_List.DR_List[50].utm_y CtApImageProcess_FreeRunning.PpDR_Merges_10ms.DeDR_List.DR_List[50].utm_z CtApImageProcess_FreeRunning.PpDR_Merges_10ms.DeDR_List.DR_List[50].heading CtApImageProcess_FreeRunning.PpDR_Merges_10ms.DeDR_List.DR_List[50].delta_x CtApImageProcess_FreeRunning.PpDR_Merges_10ms.DeDR_List.DR_List[50].delta_y CtApImageProcess_FreeRunning.PpDR_Merges_10ms.DeDR_List.DR_List[50].delta_z CtApImageProcess_FreeRunning.PpDR_Merges_10ms.DeDR_List.DR_List[50].delta_yaw CtApImageProcess_FreeRunning.PpDR_Merges_10ms.DeDR_List.DR_List[50].belif CtApImageProcess_FreeRunning.PpDR_Merges_10ms.DeDR_List.DR_List[50].reserved_int CtApImageProcess_FreeRunning.PpDR_Merges_10ms.DeDR_List.DR_List[51].stHeader.Counter CtApImageProcess_FreeRunning.PpDR_Merges_10ms.DeDR_List.DR_List[51].stHeader.FrameID CtApImageProcess_FreeRunning.PpDR_Merges_10ms.DeDR_List.DR_List[51].stHeader.TimeStamp CtApImageProcess_FreeRunning.PpDR_Merges_10ms.DeDR_List.DR_List[51].count CtApImageProcess_FreeRunning.PpDR_Merges_10ms.DeDR_List.DR_List[51].time_sec CtApImageProcess_FreeRunning.PpDR_Merges_10ms.DeDR_List.DR_List[51].utm_x CtApImageProcess_FreeRunning.PpDR_Merges_10ms.DeDR_List.DR_List[51].utm_y CtApImageProcess_FreeRunning.PpDR_Merges_10ms.DeDR_List.DR_List[51].utm_z CtApImageProcess_FreeRunning.PpDR_Merges_10ms.DeDR_List.DR_List[51].heading CtApImageProcess_FreeRunning.PpDR_Merges_10ms.DeDR_List.DR_List[51].delta_x CtApImageProcess_FreeRunning.PpDR_Merges_10ms.DeDR_List.DR_List[51].delta_y CtApImageProcess_FreeRunning.PpDR_Merges_10ms.DeDR_List.DR_List[51].delta_z CtApImageProcess_FreeRunning.PpDR_Merges_10ms.DeDR_List.DR_List[51].delta_yaw CtApImageProcess_FreeRunning.PpDR_Merges_10ms.DeDR_List.DR_List[51].belif CtApImageProcess_FreeRunning.PpDR_Merges_10ms.DeDR_List.DR_List[51].reserved_int CtApImageProcess_FreeRunning.PpDR_Merges_10ms.DeDR_List.DR_List[52].stHeader.Counter CtApImageProcess_FreeRunning.PpDR_Merges_10ms.DeDR_List.DR_List[52].stHeader.FrameID CtApImageProcess_FreeRunning.PpDR_Merges_10ms.DeDR_List.DR_List[52].stHeader.TimeStamp CtApImageProcess_FreeRunning.PpDR_Merges_10ms.DeDR_List.DR_List[52].count CtApImageProcess_FreeRunning.PpDR_Merges_10ms.DeDR_List.DR_List[52].time_sec CtApImageProcess_FreeRunning.PpDR_Merges_10ms.DeDR_List.DR_List[52].utm_x CtApImageProcess_FreeRunning.PpDR_Merges_10ms.DeDR_List.DR_List[52].utm_y CtApImageProcess_FreeRunning.PpDR_Merges_10ms.DeDR_List.DR_List[52].utm_z CtApImageProcess_FreeRunning.PpDR_Merges_10ms.DeDR_List.DR_List[52].heading CtApImageProcess_FreeRunning.PpDR_Merges_10ms.DeDR_List.DR_List[52].delta_x CtApImageProcess_FreeRunning.PpDR_Merges_10ms.DeDR_List.DR_List[52].delta_y CtApImageProcess_FreeRunning.PpDR_Merges_10ms.DeDR_List.DR_List[52].delta_z CtApImageProcess_FreeRunning.PpDR_Merges_10ms.DeDR_List.DR_List[52].delta_yaw CtApImageProcess_FreeRunning.PpDR_Merges_10ms.DeDR_List.DR_List[52].belif CtApImageProcess_FreeRunning.PpDR_Merges_10ms.DeDR_List.DR_List[52].reserved_int CtApImageProcess_FreeRunning.PpDR_Merges_10ms.DeDR_List.DR_List[53].stHeader.Counter CtApImageProcess_FreeRunning.PpDR_Merges_10ms.DeDR_List.DR_List[53].stHeader.FrameID CtApImageProcess_FreeRunning.PpDR_Merges_10ms.DeDR_List.DR_List[53].stHeader.TimeStamp CtApImageProcess_FreeRunning.PpDR_Merges_10ms.DeDR_List.DR_List[53].count CtApImageProcess_FreeRunning.PpDR_Merges_10ms.DeDR_List.DR_List[53].time_sec CtApImageProcess_FreeRunning.PpDR_Merges_10ms.DeDR_List.DR_List[53].utm_x CtApImageProcess_FreeRunning.PpDR_Merges_10ms.DeDR_List.DR_List[53].utm_y CtApImageProcess_FreeRunning.PpDR_Merges_10ms.DeDR_List.DR_List[53].utm_z CtApImageProcess_FreeRunning.PpDR_Merges_10ms.DeDR_List.DR_List[53].heading CtApImageProcess_FreeRunning.PpDR_Merges_10ms.DeDR_List.DR_List[53].delta_x CtApImageProcess_FreeRunning.PpDR_Merges_10ms.DeDR_List.DR_List[53].delta_y CtApImageProcess_FreeRunning.PpDR_Merges_10ms.DeDR_List.DR_List[53].delta_z CtApImageProcess_FreeRunning.PpDR_Merges_10ms.DeDR_List.DR_List[53].delta_yaw CtApImageProcess_FreeRunning.PpDR_Merges_10ms.DeDR_List.DR_List[53].belif CtApImageProcess_FreeRunning.PpDR_Merges_10ms.DeDR_List.DR_List[53].reserved_int CtApImageProcess_FreeRunning.PpDR_Merges_10ms.DeDR_List.DR_List[54].stHeader.Counter CtApImageProcess_FreeRunning.PpDR_Merges_10ms.DeDR_List.DR_List[54].stHeader.FrameID CtApImageProcess_FreeRunning.PpDR_Merges_10ms.DeDR_List.DR_List[54].stHeader.TimeStamp CtApImageProcess_FreeRunning.PpDR_Merges_10ms.DeDR_List.DR_List[54].count CtApImageProcess_FreeRunning.PpDR_Merges_10ms.DeDR_List.DR_List[54].time_sec CtApImageProcess_FreeRunning.PpDR_Merges_10ms.DeDR_List.DR_List[54].utm_x CtApImageProcess_FreeRunning.PpDR_Merges_10ms.DeDR_List.DR_List[54].utm_y CtApImageProcess_FreeRunning.PpDR_Merges_10ms.DeDR_List.DR_List[54].utm_z CtApImageProcess_FreeRunning.PpDR_Merges_10ms.DeDR_List.DR_List[54].heading CtApImageProcess_FreeRunning.PpDR_Merges_10ms.DeDR_List.DR_List[54].delta_x CtApImageProcess_FreeRunning.PpDR_Merges_10ms.DeDR_List.DR_List[54].delta_y CtApImageProcess_FreeRunning.PpDR_Merges_10ms.DeDR_List.DR_List[54].delta_z CtApImageProcess_FreeRunning.PpDR_Merges_10ms.DeDR_List.DR_List[54].delta_yaw CtApImageProcess_FreeRunning.PpDR_Merges_10ms.DeDR_List.DR_List[54].belif CtApImageProcess_FreeRunning.PpDR_Merges_10ms.DeDR_List.DR_List[54].reserved_int CtApImageProcess_FreeRunning.PpDR_Merges_10ms.DeDR_List.DR_List[55].stHeader.Counter CtApImageProcess_FreeRunning.PpDR_Merges_10ms.DeDR_List.DR_List[55].stHeader.FrameID CtApImageProcess_FreeRunning.PpDR_Merges_10ms.DeDR_List.DR_List[55].stHeader.TimeStamp CtApImageProcess_FreeRunning.PpDR_Merges_10ms.DeDR_List.DR_List[55].count CtApImageProcess_FreeRunning.PpDR_Merges_10ms.DeDR_List.DR_List[55].time_sec CtApImageProcess_FreeRunning.PpDR_Merges_10ms.DeDR_List.DR_List[55].utm_x CtApImageProcess_FreeRunning.PpDR_Merges_10ms.DeDR_List.DR_List[55].utm_y CtApImageProcess_FreeRunning.PpDR_Merges_10ms.DeDR_List.DR_List[55].utm_z CtApImageProcess_FreeRunning.PpDR_Merges_10ms.DeDR_List.DR_List[55].heading CtApImageProcess_FreeRunning.PpDR_Merges_10ms.DeDR_List.DR_List[55].delta_x CtApImageProcess_FreeRunning.PpDR_Merges_10ms.DeDR_List.DR_List[55].delta_y CtApImageProcess_FreeRunning.PpDR_Merges_10ms.DeDR_List.DR_List[55].delta_z CtApImageProcess_FreeRunning.PpDR_Merges_10ms.DeDR_List.DR_List[55].delta_yaw CtApImageProcess_FreeRunning.PpDR_Merges_10ms.DeDR_List.DR_List[55].belif CtApImageProcess_FreeRunning.PpDR_Merges_10ms.DeDR_List.DR_List[55].reserved_int CtApImageProcess_FreeRunning.PpDR_Merges_10ms.DeDR_List.DR_List[56].stHeader.Counter CtApImageProcess_FreeRunning.PpDR_Merges_10ms.DeDR_List.DR_List[56].stHeader.FrameID CtApImageProcess_FreeRunning.PpDR_Merges_10ms.DeDR_List.DR_List[56].stHeader.TimeStamp CtApImageProcess_FreeRunning.PpDR_Merges_10ms.DeDR_List.DR_List[56].count CtApImageProcess_FreeRunning.PpDR_Merges_10ms.DeDR_List.DR_List[56].time_sec CtApImageProcess_FreeRunning.PpDR_Merges_10ms.DeDR_List.DR_List[56].utm_x CtApImageProcess_FreeRunning.PpDR_Merges_10ms.DeDR_List.DR_List[56].utm_y CtApImageProcess_FreeRunning.PpDR_Merges_10ms.DeDR_List.DR_List[56].utm_z CtApImageProcess_FreeRunning.PpDR_Merges_10ms.DeDR_List.DR_List[56].heading CtApImageProcess_FreeRunning.PpDR_Merges_10ms.DeDR_List.DR_List[56].delta_x CtApImageProcess_FreeRunning.PpDR_Merges_10ms.DeDR_List.DR_List[56].delta_y CtApImageProcess_FreeRunning.PpDR_Merges_10ms.DeDR_List.DR_List[56].delta_z CtApImageProcess_FreeRunning.PpDR_Merges_10ms.DeDR_List.DR_List[56].delta_yaw CtApImageProcess_FreeRunning.PpDR_Merges_10ms.DeDR_List.DR_List[56].belif CtApImageProcess_FreeRunning.PpDR_Merges_10ms.DeDR_List.DR_List[56].reserved_int CtApImageProcess_FreeRunning.PpDR_Merges_10ms.DeDR_List.DR_List[57].stHeader.Counter CtApImageProcess_FreeRunning.PpDR_Merges_10ms.DeDR_List.DR_List[57].stHeader.FrameID CtApImageProcess_FreeRunning.PpDR_Merges_10ms.DeDR_List.DR_List[57].stHeader.TimeStamp CtApImageProcess_FreeRunning.PpDR_Merges_10ms.DeDR_List.DR_List[57].count CtApImageProcess_FreeRunning.PpDR_Merges_10ms.DeDR_List.DR_List[57].time_sec CtApImageProcess_FreeRunning.PpDR_Merges_10ms.DeDR_List.DR_List[57].utm_x CtApImageProcess_FreeRunning.PpDR_Merges_10ms.DeDR_List.DR_List[57].utm_y CtApImageProcess_FreeRunning.PpDR_Merges_10ms.DeDR_List.DR_List[57].utm_z CtApImageProcess_FreeRunning.PpDR_Merges_10ms.DeDR_List.DR_List[57].heading CtApImageProcess_FreeRunning.PpDR_Merges_10ms.DeDR_List.DR_List[57].delta_x CtApImageProcess_FreeRunning.PpDR_Merges_10ms.DeDR_List.DR_List[57].delta_y CtApImageProcess_FreeRunning.PpDR_Merges_10ms.DeDR_List.DR_List[57].delta_z CtApImageProcess_FreeRunning.PpDR_Merges_10ms.DeDR_List.DR_List[57].delta_yaw CtApImageProcess_FreeRunning.PpDR_Merges_10ms.DeDR_List.DR_List[57].belif CtApImageProcess_FreeRunning.PpDR_Merges_10ms.DeDR_List.DR_List[57].reserved_int CtApImageProcess_FreeRunning.PpDR_Merges_10ms.DeDR_List.DR_List[58].stHeader.Counter CtApImageProcess_FreeRunning.PpDR_Merges_10ms.DeDR_List.DR_List[58].stHeader.FrameID CtApImageProcess_FreeRunning.PpDR_Merges_10ms.DeDR_List.DR_List[58].stHeader.TimeStamp CtApImageProcess_FreeRunning.PpDR_Merges_10ms.DeDR_List.DR_List[58].count CtApImageProcess_FreeRunning.PpDR_Merges_10ms.DeDR_List.DR_List[58].time_sec CtApImageProcess_FreeRunning.PpDR_Merges_10ms.DeDR_List.DR_List[58].utm_x CtApImageProcess_FreeRunning.PpDR_Merges_10ms.DeDR_List.DR_List[58].utm_y CtApImageProcess_FreeRunning.PpDR_Merges_10ms.DeDR_List.DR_List[58].utm_z CtApImageProcess_FreeRunning.PpDR_Merges_10ms.DeDR_List.DR_List[58].heading CtApImageProcess_FreeRunning.PpDR_Merges_10ms.DeDR_List.DR_List[58].delta_x CtApImageProcess_FreeRunning.PpDR_Merges_10ms.DeDR_List.DR_List[58].delta_y CtApImageProcess_FreeRunning.PpDR_Merges_10ms.DeDR_List.DR_List[58].delta_z CtApImageProcess_FreeRunning.PpDR_Merges_10ms.DeDR_List.DR_List[58].delta_yaw CtApImageProcess_FreeRunning.PpDR_Merges_10ms.DeDR_List.DR_List[58].belif CtApImageProcess_FreeRunning.PpDR_Merges_10ms.DeDR_List.DR_List[58].reserved_int CtApImageProcess_FreeRunning.PpDR_Merges_10ms.DeDR_List.DR_List[59].stHeader.Counter CtApImageProcess_FreeRunning.PpDR_Merges_10ms.DeDR_List.DR_List[59].stHeader.FrameID CtApImageProcess_FreeRunning.PpDR_Merges_10ms.DeDR_List.DR_List[59].stHeader.TimeStamp CtApImageProcess_FreeRunning.PpDR_Merges_10ms.DeDR_List.DR_List[59].count CtApImageProcess_FreeRunning.PpDR_Merges_10ms.DeDR_List.DR_List[59].time_sec CtApImageProcess_FreeRunning.PpDR_Merges_10ms.DeDR_List.DR_List[59].utm_x CtApImageProcess_FreeRunning.PpDR_Merges_10ms.DeDR_List.DR_List[59].utm_y CtApImageProcess_FreeRunning.PpDR_Merges_10ms.DeDR_List.DR_List[59].utm_z CtApImageProcess_FreeRunning.PpDR_Merges_10ms.DeDR_List.DR_List[59].heading CtApImageProcess_FreeRunning.PpDR_Merges_10ms.DeDR_List.DR_List[59].delta_x CtApImageProcess_FreeRunning.PpDR_Merges_10ms.DeDR_List.DR_List[59].delta_y CtApImageProcess_FreeRunning.PpDR_Merges_10ms.DeDR_List.DR_List[59].delta_z CtApImageProcess_FreeRunning.PpDR_Merges_10ms.DeDR_List.DR_List[59].delta_yaw CtApImageProcess_FreeRunning.PpDR_Merges_10ms.DeDR_List.DR_List[59].belif CtApImageProcess_FreeRunning.PpDR_Merges_10ms.DeDR_List.DR_List[59].reserved_int CtApImageProcess_FreeRunning.PpDR_Merges_10ms.DeDR_List.DR_List[60].stHeader.Counter CtApImageProcess_FreeRunning.PpDR_Merges_10ms.DeDR_List.DR_List[60].stHeader.FrameID CtApImageProcess_FreeRunning.PpDR_Merges_10ms.DeDR_List.DR_List[60].stHeader.TimeStamp CtApImageProcess_FreeRunning.PpDR_Merges_10ms.DeDR_List.DR_List[60].count CtApImageProcess_FreeRunning.PpDR_Merges_10ms.DeDR_List.DR_List[60].time_sec CtApImageProcess_FreeRunning.PpDR_Merges_10ms.DeDR_List.DR_List[60].utm_x CtApImageProcess_FreeRunning.PpDR_Merges_10ms.DeDR_List.DR_List[60].utm_y CtApImageProcess_FreeRunning.PpDR_Merges_10ms.DeDR_List.DR_List[60].utm_z CtApImageProcess_FreeRunning.PpDR_Merges_10ms.DeDR_List.DR_List[60].heading CtApImageProcess_FreeRunning.PpDR_Merges_10ms.DeDR_List.DR_List[60].delta_x CtApImageProcess_FreeRunning.PpDR_Merges_10ms.DeDR_List.DR_List[60].delta_y CtApImageProcess_FreeRunning.PpDR_Merges_10ms.DeDR_List.DR_List[60].delta_z CtApImageProcess_FreeRunning.PpDR_Merges_10ms.DeDR_List.DR_List[60].delta_yaw CtApImageProcess_FreeRunning.PpDR_Merges_10ms.DeDR_List.DR_List[60].belif CtApImageProcess_FreeRunning.PpDR_Merges_10ms.DeDR_List.DR_List[60].reserved_int CtApImageProcess_FreeRunning.PpDR_Merges_10ms.DeDR_List.DR_List[61].stHeader.Counter CtApImageProcess_FreeRunning.PpDR_Merges_10ms.DeDR_List.DR_List[61].stHeader.FrameID CtApImageProcess_FreeRunning.PpDR_Merges_10ms.DeDR_List.DR_List[61].stHeader.TimeStamp CtApImageProcess_FreeRunning.PpDR_Merges_10ms.DeDR_List.DR_List[61].count CtApImageProcess_FreeRunning.PpDR_Merges_10ms.DeDR_List.DR_List[61].time_sec CtApImageProcess_FreeRunning.PpDR_Merges_10ms.DeDR_List.DR_List[61].utm_x CtApImageProcess_FreeRunning.PpDR_Merges_10ms.DeDR_List.DR_List[61].utm_y CtApImageProcess_FreeRunning.PpDR_Merges_10ms.DeDR_List.DR_List[61].utm_z CtApImageProcess_FreeRunning.PpDR_Merges_10ms.DeDR_List.DR_List[61].heading CtApImageProcess_FreeRunning.PpDR_Merges_10ms.DeDR_List.DR_List[61].delta_x CtApImageProcess_FreeRunning.PpDR_Merges_10ms.DeDR_List.DR_List[61].delta_y CtApImageProcess_FreeRunning.PpDR_Merges_10ms.DeDR_List.DR_List[61].delta_z CtApImageProcess_FreeRunning.PpDR_Merges_10ms.DeDR_List.DR_List[61].delta_yaw CtApImageProcess_FreeRunning.PpDR_Merges_10ms.DeDR_List.DR_List[61].belif CtApImageProcess_FreeRunning.PpDR_Merges_10ms.DeDR_List.DR_List[61].reserved_int CtApImageProcess_FreeRunning.PpDR_Merges_10ms.DeDR_List.DR_List[62].stHeader.Counter CtApImageProcess_FreeRunning.PpDR_Merges_10ms.DeDR_List.DR_List[62].stHeader.FrameID CtApImageProcess_FreeRunning.PpDR_Merges_10ms.DeDR_List.DR_List[62].stHeader.TimeStamp CtApImageProcess_FreeRunning.PpDR_Merges_10ms.DeDR_List.DR_List[62].count CtApImageProcess_FreeRunning.PpDR_Merges_10ms.DeDR_List.DR_List[62].time_sec CtApImageProcess_FreeRunning.PpDR_Merges_10ms.DeDR_List.DR_List[62].utm_x CtApImageProcess_FreeRunning.PpDR_Merges_10ms.DeDR_List.DR_List[62].utm_y CtApImageProcess_FreeRunning.PpDR_Merges_10ms.DeDR_List.DR_List[62].utm_z CtApImageProcess_FreeRunning.PpDR_Merges_10ms.DeDR_List.DR_List[62].heading CtApImageProcess_FreeRunning.PpDR_Merges_10ms.DeDR_List.DR_List[62].delta_x CtApImageProcess_FreeRunning.PpDR_Merges_10ms.DeDR_List.DR_List[62].delta_y /end REF_CHARACTERISTIC
/end GROUP
/begin RECORD_LAYOUT __UBYTE_S FNC_VALUES 1 UBYTE COLUMN_DIR DIRECT /end RECORD_LAYOUT
/begin RECORD_LAYOUT __UWORD_S FNC_VALUES 1 UWORD COLUMN_DIR DIRECT /end RECORD_LAYOUT
/begin RECORD_LAYOUT __ULONG_S FNC_VALUES 1 ULONG COLUMN_DIR DIRECT /end RECORD_LAYOUT
/begin RECORD_LAYOUT __FLOAT32_IEEE_S FNC_VALUES 1 FLOAT32_IEEE COLUMN_DIR DIRECT /end RECORD_LAYOUT
/begin RECORD_LAYOUT __FLOAT64_IEEE_S FNC_VALUES 1 FLOAT64_IEEE COLUMN_DIR DIRECT /end RECORD_LAYOUT
/end MODULE
/end PROJECT
